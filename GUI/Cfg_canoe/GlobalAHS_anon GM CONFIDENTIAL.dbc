VERSION ""

NS_ :

BS_:

BU_: TestTool_HS BCP_HS ECM_HS TCM_HS CGM_HS BCM_HS EBCM_OBD_HS ACCM_HS EBCM_HS TCCM_HS SAS_HS ICCM_OBD_HS ICCM_HS EPS_HS EPB_HS HMIM_HS ONSTAR_HS

BO_ 3221225472 VECTOR__INDEPENDENT_SIG_MSG: 0 Vector__XXX
 SG_ ChrgSysAudblIndRq : 0|3@0+ (1,0) [0|7] "" Vector__XXX
 SG_ RdHVBatLwParMdReq : 0|1@0+ (1,0) [0|1] "" Vector__XXX
 SG_ RdHVBtClOVFFTstRq : 0|1@0+ (1,0) [0|1] "" Vector__XXX
 SG_ RdHVBtClOVFFTstIdx : 0|7@0+ (1,0) [0|127] "" Vector__XXX
 SG_ ThrmlRefCompSpdReqARC : 0|2@0+ (1,0) [0|3] " " Vector__XXX
 SG_ VICMHVEnMgCmEnTrS : 0|1@0+ (1,0) [0|1] "" Vector__XXX
 SG_ ClimCtrlHVDvcShtdwnCmdARC : 0|2@0+ (1,0) [0|3] " " Vector__XXX
 SG_ ThrmlRefCompSpdReq : 0|14@0+ (1,0) [0|16383] "rpm" Vector__XXX
 SG_ a_12VSysVlt : 0|8@0+ (0.125,0) [0|31.875] "volts" Vector__XXX
 SG_ HybVehHiVltSysDisbld_236 : 0|1@0+ (1,0) [0|1] "" Vector__XXX
 SG_ DTCI_DTCFaultType_771 : 0|8@0+ (1,0) [0|255] "" Vector__XXX
 SG_ DTCI_CodeSupported_771 : 0|1@0+ (1,0) [0|1] "" Vector__XXX
 SG_ DTCI_CurrentStatus_771 : 0|1@0+ (1,0) [0|1] "" Vector__XXX
 SG_ DTCI_TstNPsdCdClrdSt_771 : 0|1@0+ (1,0) [0|1] "" Vector__XXX
 SG_ DTCI_TstFldCdClrdStat_771 : 0|1@0+ (1,0) [0|1] "" Vector__XXX
 SG_ DTCI_HistStat_771 : 0|1@0+ (1,0) [0|1] "" Vector__XXX
 SG_ DTCI_TstNPsdPwrUpSt_771 : 0|1@0+ (1,0) [0|1] "" Vector__XXX
 SG_ DTCI_TstFldPwrUpSt_771 : 0|1@0+ (1,0) [0|1] "" Vector__XXX
 SG_ DTCI_WrnIndRqdSt_771 : 0|1@0+ (1,0) [0|1] "" Vector__XXX
 SG_ DTCI_DTCFailType_771 : 0|8@0+ (1,0) [0|255] "" Vector__XXX
 SG_ DTCI_DTCNumber_771 : 0|16@0+ (1,0) [0|65535] "" Vector__XXX
 SG_ DTCI_DTCSource_771 : 0|8@0+ (1,0) [0|255] "" Vector__XXX
 SG_ DTCI_DTCTriggered_771 : 0|1@0+ (1,0) [0|1] "" Vector__XXX
 SG_ DTCIUnused7_771 : 0|1@0+ (1,0) [0|1] "" Vector__XXX
 SG_ DTCIUnused6_771 : 0|1@0+ (1,0) [0|1] "" Vector__XXX
 SG_ DTCIUnused5_771 : 0|1@0+ (1,0) [0|1] "" Vector__XXX
 SG_ DTCIUnused4_771 : 0|1@0+ (1,0) [0|1] "" Vector__XXX
 SG_ DTCIUnused3_771 : 0|1@0+ (1,0) [0|1] "" Vector__XXX
 SG_ DTCIUnused2_771 : 0|1@0+ (1,0) [0|1] "" Vector__XXX
 SG_ DTCIUnused1_771 : 0|1@0+ (1,0) [0|1] "" Vector__XXX
 SG_ DTCI_DTCSource_78F : 0|8@0+ (1,0) [0|255] "" Vector__XXX
 SG_ DTCI_DTCTriggered_78F : 0|1@0+ (1,0) [0|1] "" Vector__XXX
 SG_ DTCIUnused1_78F : 0|1@0+ (1,0) [0|1] "" Vector__XXX
 SG_ DTCIUnused2_78F : 0|1@0+ (1,0) [0|1] "" Vector__XXX
 SG_ DTCIUnused3_78F : 0|1@0+ (1,0) [0|1] "" Vector__XXX
 SG_ DTCIUnused4_78F : 0|1@0+ (1,0) [0|1] "" Vector__XXX
 SG_ DTCIUnused5_78F : 0|1@0+ (1,0) [0|1] "" Vector__XXX
 SG_ DTCIUnused6_78F : 0|1@0+ (1,0) [0|1] "" Vector__XXX
 SG_ DTCIUnused7_78F : 0|1@0+ (1,0) [0|1] "" Vector__XXX
 SG_ DTCI_CodeSupported_78F : 0|1@0+ (1,0) [0|1] "" Vector__XXX
 SG_ DTCI_CurrentStatus_78F : 0|1@0+ (1,0) [0|1] "" Vector__XXX
 SG_ DTCI_DTCFaultType_78F : 0|8@0+ (1,0) [0|255] "" Vector__XXX
 SG_ DTCI_TstFldCdClrdStat_78F : 0|1@0+ (1,0) [0|1] "" Vector__XXX
 SG_ DTCI_TstNPsdCdClrdSt_78F : 0|1@0+ (1,0) [0|1] "" Vector__XXX
 SG_ DTCI_HistStat_78F : 0|1@0+ (1,0) [0|1] "" Vector__XXX
 SG_ DTCI_TstNPsdPwrUpSt_78F : 0|1@0+ (1,0) [0|1] "" Vector__XXX
 SG_ DTCI_TstFldPwrUpSt_78F : 0|1@0+ (1,0) [0|1] "" Vector__XXX
 SG_ DTCI_WrnIndRqdSt_78F : 0|1@0+ (1,0) [0|1] "" Vector__XXX
 SG_ DTCI_DTCFailType_78F : 0|8@0+ (1,0) [0|255] "" Vector__XXX
 SG_ DTCI_DTCNumber_78F : 0|16@0+ (1,0) [0|65535] "" Vector__XXX
 SG_ DTCI_CodeSupported_78E : 0|1@0+ (1,0) [0|1] "" Vector__XXX
 SG_ DTCI_CurrentStatus_78E : 0|1@0+ (1,0) [0|1] "" Vector__XXX
 SG_ DTCI_DTCFailType_78E : 0|8@0+ (1,0) [0|255] "" Vector__XXX
 SG_ DTCI_DTCFaultType_78E : 0|8@0+ (1,0) [0|255] "" Vector__XXX
 SG_ DTCI_DTCNumber_78E : 0|16@0+ (1,0) [0|65535] "" Vector__XXX
 SG_ DTCI_DTCSource_78E : 0|8@0+ (1,0) [0|255] "" Vector__XXX
 SG_ DTCI_DTCTriggered_78E : 0|1@0+ (1,0) [0|1] "" Vector__XXX
 SG_ DTCI_TstFldPwrUpSt_78C : 0|1@0+ (1,0) [0|1] "" Vector__XXX
 SG_ DTCI_TstNPsdCdClrdSt_78C : 0|1@0+ (1,0) [0|1] "" Vector__XXX
 SG_ DTCI_TstNPsdPwrUpSt_78C : 0|1@0+ (1,0) [0|1] "" Vector__XXX
 SG_ DTCIUnused1_78C : 0|1@0+ (1,0) [0|1] "" Vector__XXX
 SG_ DTCIUnused2_78C : 0|1@0+ (1,0) [0|1] "" Vector__XXX
 SG_ DTCIUnused3_78C : 0|1@0+ (1,0) [0|1] "" Vector__XXX
 SG_ DTCIUnused4_78C : 0|1@0+ (1,0) [0|1] "" Vector__XXX
 SG_ DTCIUnused5_78C : 0|1@0+ (1,0) [0|1] "" Vector__XXX
 SG_ DTCIUnused6_78C : 0|1@0+ (1,0) [0|1] "" Vector__XXX
 SG_ DTCIUnused7_78C : 0|1@0+ (1,0) [0|1] "" Vector__XXX
 SG_ DTCI_WrnIndRqdSt_78C : 0|1@0+ (1,0) [0|1] "" Vector__XXX
 SG_ DTCI_CodeSupported_789 : 0|1@0+ (1,0) [0|1] "" Vector__XXX
 SG_ DTCI_CurrentStatus_789 : 0|1@0+ (1,0) [0|1] "" Vector__XXX
 SG_ DTCI_DTCFailType_789 : 0|8@0+ (1,0) [0|255] "" Vector__XXX
 SG_ DTCI_DTCFaultType_789 : 0|8@0+ (1,0) [0|255] "" Vector__XXX
 SG_ DTCI_DTCNumber_789 : 0|16@0+ (1,0) [0|65535] "" Vector__XXX
 SG_ DTCI_DTCSource_789 : 0|8@0+ (1,0) [0|255] "" Vector__XXX
 SG_ DTCI_DTCTriggered_789 : 0|1@0+ (1,0) [0|1] "" Vector__XXX
 SG_ DTCI_HistStat_789 : 0|1@0+ (1,0) [0|1] "" Vector__XXX
 SG_ DTCI_TstFldCdClrdStat_789 : 0|1@0+ (1,0) [0|1] "" Vector__XXX
 SG_ DTCI_TstFldPwrUpSt_789 : 0|1@0+ (1,0) [0|1] "" Vector__XXX
 SG_ DTCI_TstNPsdCdClrdSt_789 : 0|1@0+ (1,0) [0|1] "" Vector__XXX
 SG_ DTCI_TstNPsdPwrUpSt_789 : 0|1@0+ (1,0) [0|1] "" Vector__XXX
 SG_ DTCIUnused1_789 : 0|1@0+ (1,0) [0|1] "" Vector__XXX
 SG_ DTCIUnused2_789 : 0|1@0+ (1,0) [0|1] "" Vector__XXX
 SG_ DTCIUnused3_789 : 0|1@0+ (1,0) [0|1] "" Vector__XXX
 SG_ DTCIUnused4_789 : 0|1@0+ (1,0) [0|1] "" Vector__XXX
 SG_ DTCIUnused5_789 : 0|1@0+ (1,0) [0|1] "" Vector__XXX
 SG_ DTCIUnused6_789 : 0|1@0+ (1,0) [0|1] "" Vector__XXX
 SG_ DTCIUnused7_789 : 0|1@0+ (1,0) [0|1] "" Vector__XXX
 SG_ DTCI_WrnIndRqdSt_789 : 0|1@0+ (1,0) [0|1] "" Vector__XXX
 SG_ DTCI_CodeSupported_787 : 0|1@0+ (1,0) [0|1] "" Vector__XXX
 SG_ DTCI_CurrentStatus_787 : 0|1@0+ (1,0) [0|1] "" Vector__XXX
 SG_ DTCI_DTCFailType_787 : 0|8@0+ (1,0) [0|255] "" Vector__XXX
 SG_ DTCI_DTCFaultType_787 : 0|8@0+ (1,0) [0|255] "" Vector__XXX
 SG_ DTCI_DTCNumber_787 : 0|16@0+ (1,0) [0|65535] "" Vector__XXX
 SG_ DTCI_DTCSource_787 : 0|8@0+ (1,0) [0|255] "" Vector__XXX
 SG_ DTCI_DTCTriggered_787 : 0|1@0+ (1,0) [0|1] "" Vector__XXX
 SG_ DTCI_HistStat_787 : 0|1@0+ (1,0) [0|1] "" Vector__XXX
 SG_ DTCI_TstFldCdClrdStat_787 : 0|1@0+ (1,0) [0|1] "" Vector__XXX
 SG_ DTCI_TstFldPwrUpSt_787 : 0|1@0+ (1,0) [0|1] "" Vector__XXX
 SG_ DTCI_TstNPsdCdClrdSt_787 : 0|1@0+ (1,0) [0|1] "" Vector__XXX
 SG_ DTCI_TstNPsdPwrUpSt_787 : 0|1@0+ (1,0) [0|1] "" Vector__XXX
 SG_ DTCIUnused1_787 : 0|1@0+ (1,0) [0|1] "" Vector__XXX
 SG_ DTCI_HistStat_78E : 0|1@0+ (1,0) [0|1] "" Vector__XXX
 SG_ DTCI_TstFldCdClrdStat_78E : 0|1@0+ (1,0) [0|1] "" Vector__XXX
 SG_ DTCI_TstFldPwrUpSt_78E : 0|1@0+ (1,0) [0|1] "" Vector__XXX
 SG_ DTCI_TstNPsdCdClrdSt_78E : 0|1@0+ (1,0) [0|1] "" Vector__XXX
 SG_ DTCI_TstNPsdPwrUpSt_78E : 0|1@0+ (1,0) [0|1] "" Vector__XXX
 SG_ DTCIUnused1_78E : 0|1@0+ (1,0) [0|1] "" Vector__XXX
 SG_ DTCIUnused2_78E : 0|1@0+ (1,0) [0|1] "" Vector__XXX
 SG_ DTCIUnused3_78E : 0|1@0+ (1,0) [0|1] "" Vector__XXX
 SG_ DTCIUnused4_78E : 0|1@0+ (1,0) [0|1] "" Vector__XXX
 SG_ DTCIUnused5_78E : 0|1@0+ (1,0) [0|1] "" Vector__XXX
 SG_ DTCIUnused6_78E : 0|1@0+ (1,0) [0|1] "" Vector__XXX
 SG_ DTCIUnused7_78E : 0|1@0+ (1,0) [0|1] "" Vector__XXX
 SG_ DTCI_WrnIndRqdSt_78E : 0|1@0+ (1,0) [0|1] "" Vector__XXX
 SG_ DTCI_CodeSupported_78D : 0|1@0+ (1,0) [0|1] "" Vector__XXX
 SG_ DTCI_CurrentStatus_78D : 0|1@0+ (1,0) [0|1] "" Vector__XXX
 SG_ DTCI_DTCFailType_78D : 0|8@0+ (1,0) [0|255] "" Vector__XXX
 SG_ DTCI_DTCFaultType_78D : 0|8@0+ (1,0) [0|255] "" Vector__XXX
 SG_ DTCI_DTCNumber_78D : 0|16@0+ (1,0) [0|65535] "" Vector__XXX
 SG_ DTCI_DTCSource_78D : 0|8@0+ (1,0) [0|255] "" Vector__XXX
 SG_ DTCI_DTCTriggered_78D : 0|1@0+ (1,0) [0|1] "" Vector__XXX
 SG_ DTCI_HistStat_78D : 0|1@0+ (1,0) [0|1] "" Vector__XXX
 SG_ DTCIUnused2_787 : 0|1@0+ (1,0) [0|1] "" Vector__XXX
 SG_ DTCIUnused3_787 : 0|1@0+ (1,0) [0|1] "" Vector__XXX
 SG_ DTCIUnused4_787 : 0|1@0+ (1,0) [0|1] "" Vector__XXX
 SG_ DTCIUnused5_787 : 0|1@0+ (1,0) [0|1] "" Vector__XXX
 SG_ DTCIUnused6_787 : 0|1@0+ (1,0) [0|1] "" Vector__XXX
 SG_ DTCIUnused7_787 : 0|1@0+ (1,0) [0|1] "" Vector__XXX
 SG_ DTCI_WrnIndRqdSt_787 : 0|1@0+ (1,0) [0|1] "" Vector__XXX
 SG_ DTCI_CodeSupported_786 : 0|1@0+ (1,0) [0|1] "" Vector__XXX
 SG_ DTCI_CurrentStatus_786 : 0|1@0+ (1,0) [0|1] "" Vector__XXX
 SG_ DTCI_DTCFailType_786 : 0|8@0+ (1,0) [0|255] "" Vector__XXX
 SG_ DTCI_DTCFaultType_786 : 0|8@0+ (1,0) [0|255] "" Vector__XXX
 SG_ DTCI_DTCNumber_786 : 0|16@0+ (1,0) [0|65535] "" Vector__XXX
 SG_ DTCI_DTCSource_786 : 0|8@0+ (1,0) [0|255] "" Vector__XXX
 SG_ DTCI_DTCTriggered_786 : 0|1@0+ (1,0) [0|1] "" Vector__XXX
 SG_ DTCI_HistStat_786 : 0|1@0+ (1,0) [0|1] "" Vector__XXX
 SG_ DTCI_TstFldCdClrdStat_786 : 0|1@0+ (1,0) [0|1] "" Vector__XXX
 SG_ DTCI_TstFldPwrUpSt_786 : 0|1@0+ (1,0) [0|1] "" Vector__XXX
 SG_ DTCI_TstNPsdCdClrdSt_786 : 0|1@0+ (1,0) [0|1] "" Vector__XXX
 SG_ DTCI_TstNPsdPwrUpSt_786 : 0|1@0+ (1,0) [0|1] "" Vector__XXX
 SG_ DTCIUnused1_786 : 0|1@0+ (1,0) [0|1] "" Vector__XXX
 SG_ DTCIUnused2_786 : 0|1@0+ (1,0) [0|1] "" Vector__XXX
 SG_ DTCIUnused3_786 : 0|1@0+ (1,0) [0|1] "" Vector__XXX
 SG_ DTCIUnused4_786 : 0|1@0+ (1,0) [0|1] "" Vector__XXX
 SG_ DTCIUnused5_786 : 0|1@0+ (1,0) [0|1] "" Vector__XXX
 SG_ DTCIUnused6_786 : 0|1@0+ (1,0) [0|1] "" Vector__XXX
 SG_ DTCIUnused7_786 : 0|1@0+ (1,0) [0|1] "" Vector__XXX
 SG_ DTCI_WrnIndRqdSt_786 : 0|1@0+ (1,0) [0|1] "" Vector__XXX
 SG_ DTCI_HistStat_784 : 0|1@0+ (1,0) [0|1] "" Vector__XXX
 SG_ DTCI_TstFldCdClrdStat_784 : 0|1@0+ (1,0) [0|1] "" Vector__XXX
 SG_ DTCI_TstFldPwrUpSt_784 : 0|1@0+ (1,0) [0|1] "" Vector__XXX
 SG_ DTCI_TstNPsdCdClrdSt_784 : 0|1@0+ (1,0) [0|1] "" Vector__XXX
 SG_ DTCI_TstNPsdPwrUpSt_784 : 0|1@0+ (1,0) [0|1] "" Vector__XXX
 SG_ DTCIUnused1_784 : 0|1@0+ (1,0) [0|1] "" Vector__XXX
 SG_ DTCIUnused2_784 : 0|1@0+ (1,0) [0|1] "" Vector__XXX
 SG_ DTCIUnused3_784 : 0|1@0+ (1,0) [0|1] "" Vector__XXX
 SG_ DTCIUnused4_784 : 0|1@0+ (1,0) [0|1] "" Vector__XXX
 SG_ DTCIUnused5_784 : 0|1@0+ (1,0) [0|1] "" Vector__XXX
 SG_ DTCIUnused6_784 : 0|1@0+ (1,0) [0|1] "" Vector__XXX
 SG_ DTCIUnused7_784 : 0|1@0+ (1,0) [0|1] "" Vector__XXX
 SG_ DTCI_WrnIndRqdSt_784 : 0|1@0+ (1,0) [0|1] "" Vector__XXX
 SG_ DTCI_CodeSupported_784 : 0|1@0+ (1,0) [0|1] "" Vector__XXX
 SG_ DTCI_CurrentStatus_784 : 0|1@0+ (1,0) [0|1] "" Vector__XXX
 SG_ DTCI_DTCFailType_784 : 0|8@0+ (1,0) [0|255] "" Vector__XXX
 SG_ DTCI_DTCFaultType_784 : 0|8@0+ (1,0) [0|255] "" Vector__XXX
 SG_ DTCI_DTCFaultType_774 : 0|8@0+ (1,0) [0|255] "" Vector__XXX
 SG_ DTCI_CodeSupported_774 : 0|1@0+ (1,0) [0|1] "" Vector__XXX
 SG_ DTCI_CurrentStatus_774 : 0|1@0+ (1,0) [0|1] "" Vector__XXX
 SG_ DTCI_TstNPsdCdClrdSt_774 : 0|1@0+ (1,0) [0|1] "" Vector__XXX
 SG_ DTCI_TstFldCdClrdStat_774 : 0|1@0+ (1,0) [0|1] "" Vector__XXX
 SG_ DTCI_HistStat_774 : 0|1@0+ (1,0) [0|1] "" Vector__XXX
 SG_ DTCI_TstNPsdPwrUpSt_774 : 0|1@0+ (1,0) [0|1] "" Vector__XXX
 SG_ DTCI_TstFldPwrUpSt_774 : 0|1@0+ (1,0) [0|1] "" Vector__XXX
 SG_ DTCI_WrnIndRqdSt_774 : 0|1@0+ (1,0) [0|1] "" Vector__XXX
 SG_ DTCI_DTCFailType_774 : 0|8@0+ (1,0) [0|255] "" Vector__XXX
 SG_ DTCI_DTCNumber_774 : 0|16@0+ (1,0) [0|65535] "" Vector__XXX
 SG_ DTCI_DTCSource_774 : 0|8@0+ (1,0) [0|255] "" Vector__XXX
 SG_ DTCI_DTCTriggered_774 : 0|1@0+ (1,0) [0|1] "" Vector__XXX
 SG_ DTCIUnused7_774 : 0|1@0+ (1,0) [0|1] "" Vector__XXX
 SG_ DTCIUnused6_774 : 0|1@0+ (1,0) [0|1] "" Vector__XXX
 SG_ DTCIUnused5_774 : 0|1@0+ (1,0) [0|1] "" Vector__XXX
 SG_ DTCIUnused4_774 : 0|1@0+ (1,0) [0|1] "" Vector__XXX
 SG_ DTCIUnused3_774 : 0|1@0+ (1,0) [0|1] "" Vector__XXX
 SG_ DTCIUnused2_774 : 0|1@0+ (1,0) [0|1] "" Vector__XXX
 SG_ DTCIUnused1_774 : 0|1@0+ (1,0) [0|1] "" Vector__XXX
 SG_ DTCI_DTCFaultType_779 : 0|8@0+ (1,0) [0|255] "" Vector__XXX
 SG_ DTCI_CodeSupported_779 : 0|1@0+ (1,0) [0|1] "" Vector__XXX
 SG_ DTCI_CurrentStatus_779 : 0|1@0+ (1,0) [0|1] "" Vector__XXX
 SG_ DTCI_TstNPsdCdClrdSt_779 : 0|1@0+ (1,0) [0|1] "" Vector__XXX
 SG_ DTCI_TstFldCdClrdStat_779 : 0|1@0+ (1,0) [0|1] "" Vector__XXX
 SG_ DTCI_HistStat_779 : 0|1@0+ (1,0) [0|1] "" Vector__XXX
 SG_ DTCI_TstNPsdPwrUpSt_779 : 0|1@0+ (1,0) [0|1] "" Vector__XXX
 SG_ DTCI_TstFldPwrUpSt_779 : 0|1@0+ (1,0) [0|1] "" Vector__XXX
 SG_ DTCI_WrnIndRqdSt_779 : 0|1@0+ (1,0) [0|1] "" Vector__XXX
 SG_ DTCI_DTCFailType_779 : 0|8@0+ (1,0) [0|255] "" Vector__XXX
 SG_ DTCI_DTCNumber_779 : 0|16@0+ (1,0) [0|65535] "" Vector__XXX
 SG_ DTCI_DTCSource_779 : 0|8@0+ (1,0) [0|255] "" Vector__XXX
 SG_ DTCI_DTCTriggered_779 : 0|1@0+ (1,0) [0|1] "" Vector__XXX
 SG_ DTCIUnused7_779 : 0|1@0+ (1,0) [0|1] "" Vector__XXX
 SG_ DTCIUnused6_779 : 0|1@0+ (1,0) [0|1] "" Vector__XXX
 SG_ DTCIUnused5_779 : 0|1@0+ (1,0) [0|1] "" Vector__XXX
 SG_ DTCIUnused4_779 : 0|1@0+ (1,0) [0|1] "" Vector__XXX
 SG_ DTCIUnused3_779 : 0|1@0+ (1,0) [0|1] "" Vector__XXX
 SG_ DTCIUnused2_779 : 0|1@0+ (1,0) [0|1] "" Vector__XXX
 SG_ DTCIUnused1_779 : 0|1@0+ (1,0) [0|1] "" Vector__XXX
 SG_ DTCI_TstFldCdClrdStat_78D : 0|1@0+ (1,0) [0|1] "" Vector__XXX
 SG_ DTCI_TstFldPwrUpSt_78D : 0|1@0+ (1,0) [0|1] "" Vector__XXX
 SG_ DTCI_TstNPsdCdClrdSt_78D : 0|1@0+ (1,0) [0|1] "" Vector__XXX
 SG_ DTCI_TstNPsdPwrUpSt_78D : 0|1@0+ (1,0) [0|1] "" Vector__XXX
 SG_ DTCIUnused1_78D : 0|1@0+ (1,0) [0|1] "" Vector__XXX
 SG_ DTCIUnused2_78D : 0|1@0+ (1,0) [0|1] "" Vector__XXX
 SG_ DTCIUnused3_78D : 0|1@0+ (1,0) [0|1] "" Vector__XXX
 SG_ DTCIUnused4_78D : 0|1@0+ (1,0) [0|1] "" Vector__XXX
 SG_ DTCIUnused5_78D : 0|1@0+ (1,0) [0|1] "" Vector__XXX
 SG_ DTCIUnused6_78D : 0|1@0+ (1,0) [0|1] "" Vector__XXX
 SG_ DTCIUnused7_78D : 0|1@0+ (1,0) [0|1] "" Vector__XXX
 SG_ DTCI_WrnIndRqdSt_78D : 0|1@0+ (1,0) [0|1] "" Vector__XXX
 SG_ DTCI_CodeSupported_78C : 0|1@0+ (1,0) [0|1] "" Vector__XXX
 SG_ DTCI_CurrentStatus_78C : 0|1@0+ (1,0) [0|1] "" Vector__XXX
 SG_ DTCI_DTCFailType_78C : 0|8@0+ (1,0) [0|255] "" Vector__XXX
 SG_ DTCI_DTCFaultType_78C : 0|8@0+ (1,0) [0|255] "" Vector__XXX
 SG_ DTCI_DTCNumber_78C : 0|16@0+ (1,0) [0|65535] "" Vector__XXX
 SG_ DTCI_DTCSource_78C : 0|8@0+ (1,0) [0|255] "" Vector__XXX
 SG_ DTCI_DTCTriggered_78C : 0|1@0+ (1,0) [0|1] "" Vector__XXX
 SG_ DTCI_HistStat_78C : 0|1@0+ (1,0) [0|1] "" Vector__XXX
 SG_ DTCI_TstFldCdClrdStat_78C : 0|1@0+ (1,0) [0|1] "" Vector__XXX
 SG_ DTCI_DTCNumber_784 : 0|16@0+ (1,0) [0|65535] "" Vector__XXX
 SG_ DTCI_DTCSource_784 : 0|8@0+ (1,0) [0|255] "" Vector__XXX
 SG_ DTCI_DTCTriggered_784 : 0|1@0+ (1,0) [0|1] "" Vector__XXX
 SG_ DgnInf_HS55D : 0|64@0+ (1,0) [0|1.84467440737096E+019] "" Vector__XXX
 SG_ DgnInf_HS55A : 0|64@0+ (1,0) [0|1.84467440737096E+019] "" Vector__XXX
 SG_ DgnInf_HS558 : 0|64@0+ (1,0) [0|1.84467440737096E+019] "" Vector__XXX
 SG_ DgnInf_HS551 : 0|64@0+ (1,0) [0|1.84467440737096E+019] "" Vector__XXX
 SG_ DgnInf_HS555 : 0|64@0+ (1,0) [0|1.84467440737096E+019] "" Vector__XXX
 SG_ DgnInf_HS559 : 0|64@0+ (1,0) [0|1.84467440737096E+019] "" Vector__XXX
 SG_ DgnInf_HS550 : 0|64@0+ (1,0) [0|1.84467440737096E+019] "" Vector__XXX
 SG_ DgnInf_HS544 : 0|64@0+ (1,0) [0|1.84467440737096E+019] "" Vector__XXX
 SG_ DgnInf_HS548 : 0|64@0+ (1,0) [0|1.84467440737096E+019] "" Vector__XXX
 SG_ DgnInf_HS557 : 0|64@0+ (1,0) [0|1.84467440737096E+019] "" Vector__XXX
 SG_ DTCI_DTCFaultType_775 : 0|8@0+ (1,0) [0|255] "" Vector__XXX
 SG_ DTCI_CodeSupported_775 : 0|1@0+ (1,0) [0|1] "" Vector__XXX
 SG_ DTCI_CurrentStatus_775 : 0|1@0+ (1,0) [0|1] "" Vector__XXX
 SG_ DTCI_TstNPsdCdClrdSt_775 : 0|1@0+ (1,0) [0|1] "" Vector__XXX
 SG_ DTCI_TstFldCdClrdStat_775 : 0|1@0+ (1,0) [0|1] "" Vector__XXX
 SG_ DTCI_HistStat_775 : 0|1@0+ (1,0) [0|1] "" Vector__XXX
 SG_ DTCI_TstNPsdPwrUpSt_775 : 0|1@0+ (1,0) [0|1] "" Vector__XXX
 SG_ DTCI_TstFldPwrUpSt_775 : 0|1@0+ (1,0) [0|1] "" Vector__XXX
 SG_ DTCI_WrnIndRqdSt_775 : 0|1@0+ (1,0) [0|1] "" Vector__XXX
 SG_ DTCI_DTCFailType_775 : 0|8@0+ (1,0) [0|255] "" Vector__XXX
 SG_ DTCI_DTCNumber_775 : 0|16@0+ (1,0) [0|65535] "" Vector__XXX
 SG_ DTCI_DTCSource_775 : 0|8@0+ (1,0) [0|255] "" Vector__XXX
 SG_ DTCI_DTCTriggered_775 : 0|1@0+ (1,0) [0|1] "" Vector__XXX
 SG_ DTCIUnused7_775 : 0|1@0+ (1,0) [0|1] "" Vector__XXX
 SG_ DTCIUnused6_775 : 0|1@0+ (1,0) [0|1] "" Vector__XXX
 SG_ DTCIUnused5_775 : 0|1@0+ (1,0) [0|1] "" Vector__XXX
 SG_ DTCIUnused4_775 : 0|1@0+ (1,0) [0|1] "" Vector__XXX
 SG_ DTCIUnused3_775 : 0|1@0+ (1,0) [0|1] "" Vector__XXX
 SG_ DTCIUnused2_775 : 0|1@0+ (1,0) [0|1] "" Vector__XXX
 SG_ DTCIUnused1_775 : 0|1@0+ (1,0) [0|1] "" Vector__XXX
 SG_ DTCI_HistStat_783 : 0|1@0+ (1,0) [0|1] "" Vector__XXX
 SG_ DTCI_DTCTriggered_783 : 0|1@0+ (1,0) [0|1] "" Vector__XXX
 SG_ DTCI_DTCSource_783 : 0|8@0+ (1,0) [0|255] "" Vector__XXX
 SG_ DTCI_DTCNumber_783 : 0|16@0+ (1,0) [0|65535] "" Vector__XXX
 SG_ DTCI_DTCFaultType_783 : 0|8@0+ (1,0) [0|255] "" Vector__XXX
 SG_ DTCI_DTCFailType_783 : 0|8@0+ (1,0) [0|255] "" Vector__XXX
 SG_ DTCI_CurrentStatus_783 : 0|1@0+ (1,0) [0|1] "" Vector__XXX
 SG_ DTCI_CodeSupported_783 : 0|1@0+ (1,0) [0|1] "" Vector__XXX
 SG_ DTCIUnused7_783 : 0|1@0+ (1,0) [0|1] "" Vector__XXX
 SG_ DTCIUnused6_783 : 0|1@0+ (1,0) [0|1] "" Vector__XXX
 SG_ DTCIUnused5_783 : 0|1@0+ (1,0) [0|1] "" Vector__XXX
 SG_ DTCIUnused4_783 : 0|1@0+ (1,0) [0|1] "" Vector__XXX
 SG_ DTCIUnused3_783 : 0|1@0+ (1,0) [0|1] "" Vector__XXX
 SG_ DTCIUnused2_783 : 0|1@0+ (1,0) [0|1] "" Vector__XXX
 SG_ DTCIUnused1_783 : 0|1@0+ (1,0) [0|1] "" Vector__XXX
 SG_ DgnInf_HS545 : 0|64@0+ (1,0) [0|1.84467440737096E+019] "" Vector__XXX
 SG_ DTCI_WrnIndRqdSt_783 : 0|1@0+ (1,0) [0|1] "" Vector__XXX
 SG_ DTCI_TstNPsdPwrUpSt_783 : 0|1@0+ (1,0) [0|1] "" Vector__XXX
 SG_ DTCI_TstNPsdCdClrdSt_783 : 0|1@0+ (1,0) [0|1] "" Vector__XXX
 SG_ DTCI_TstFldPwrUpSt_783 : 0|1@0+ (1,0) [0|1] "" Vector__XXX
 SG_ DTCI_TstFldCdClrdStat_783 : 0|1@0+ (1,0) [0|1] "" Vector__XXX
 SG_ DTCI_DTCFaultType_77E : 0|8@0+ (1,0) [0|255] "" Vector__XXX
 SG_ DTCI_CodeSupported_77E : 0|1@0+ (1,0) [0|1] "" Vector__XXX
 SG_ DTCI_CurrentStatus_77E : 0|1@0+ (1,0) [0|1] "" Vector__XXX
 SG_ DTCI_TstNPsdCdClrdSt_77E : 0|1@0+ (1,0) [0|1] "" Vector__XXX
 SG_ DTCI_TstFldCdClrdStat_77E : 0|1@0+ (1,0) [0|1] "" Vector__XXX
 SG_ DTCI_HistStat_77E : 0|1@0+ (1,0) [0|1] "" Vector__XXX
 SG_ DTCI_TstNPsdPwrUpSt_77E : 0|1@0+ (1,0) [0|1] "" Vector__XXX
 SG_ DTCI_TstFldPwrUpSt_77E : 0|1@0+ (1,0) [0|1] "" Vector__XXX
 SG_ DTCI_WrnIndRqdSt_77E : 0|1@0+ (1,0) [0|1] "" Vector__XXX
 SG_ DTCI_DTCFailType_77E : 0|8@0+ (1,0) [0|255] "" Vector__XXX
 SG_ DTCI_DTCNumber_77E : 0|16@0+ (1,0) [0|65535] "" Vector__XXX
 SG_ DTCI_DTCSource_77E : 0|8@0+ (1,0) [0|255] "" Vector__XXX
 SG_ DTCI_DTCTriggered_77E : 0|1@0+ (1,0) [0|1] "" Vector__XXX
 SG_ DTCIUnused7_77E : 0|1@0+ (1,0) [0|1] "" Vector__XXX
 SG_ DTCIUnused6_77E : 0|1@0+ (1,0) [0|1] "" Vector__XXX
 SG_ DTCIUnused5_77E : 0|1@0+ (1,0) [0|1] "" Vector__XXX
 SG_ DTCIUnused4_77E : 0|1@0+ (1,0) [0|1] "" Vector__XXX
 SG_ DTCIUnused3_77E : 0|1@0+ (1,0) [0|1] "" Vector__XXX
 SG_ DTCIUnused2_77E : 0|1@0+ (1,0) [0|1] "" Vector__XXX
 SG_ DTCIUnused1_77E : 0|1@0+ (1,0) [0|1] "" Vector__XXX
 SG_ DgnInf_HS54E : 0|64@0+ (1,0) [0|1.84467440737096E+019] "" Vector__XXX
 SG_ DTCI_DTCFaultType_777 : 0|8@0+ (1,0) [0|255] "" Vector__XXX
 SG_ DTCI_CodeSupported_777 : 0|1@0+ (1,0) [0|1] "" Vector__XXX
 SG_ DTCI_CurrentStatus_777 : 0|1@0+ (1,0) [0|1] "" Vector__XXX
 SG_ DTCI_TstNPsdCdClrdSt_777 : 0|1@0+ (1,0) [0|1] "" Vector__XXX
 SG_ DTCI_TstFldCdClrdStat_777 : 0|1@0+ (1,0) [0|1] "" Vector__XXX
 SG_ DTCI_HistStat_777 : 0|1@0+ (1,0) [0|1] "" Vector__XXX
 SG_ DTCI_TstNPsdPwrUpSt_777 : 0|1@0+ (1,0) [0|1] "" Vector__XXX
 SG_ DTCI_TstFldPwrUpSt_777 : 0|1@0+ (1,0) [0|1] "" Vector__XXX
 SG_ DTCI_WrnIndRqdSt_777 : 0|1@0+ (1,0) [0|1] "" Vector__XXX
 SG_ DTCI_DTCFailType_777 : 0|8@0+ (1,0) [0|255] "" Vector__XXX
 SG_ DTCI_DTCNumber_777 : 0|16@0+ (1,0) [0|65535] "" Vector__XXX
 SG_ DTCI_DTCSource_777 : 0|8@0+ (1,0) [0|255] "" Vector__XXX
 SG_ DTCI_DTCTriggered_777 : 0|1@0+ (1,0) [0|1] "" Vector__XXX
 SG_ DTCIUnused7_777 : 0|1@0+ (1,0) [0|1] "" Vector__XXX
 SG_ DTCIUnused6_777 : 0|1@0+ (1,0) [0|1] "" Vector__XXX
 SG_ DTCIUnused5_777 : 0|1@0+ (1,0) [0|1] "" Vector__XXX
 SG_ PTOAudExtAlertReq : 0|1@0+ (1,0) [0|1] "" Vector__XXX
 SG_ DmpSysVehTopSpdLim : 0|8@0+ (2,0) [0|510] "km / h" Vector__XXX
 SG_ HybEstTransOilTmpM : 0|1@0+ (1,0) [0|1] "" Vector__XXX
 SG_ HybEstTransOilTmp : 0|8@0+ (1,-40) [-40|215] "deg C" Vector__XXX
 SG_ TransClch5_TorqCmnd : 0|12@0+ (0.5,-5) [-5|2042.5] "Nm" Vector__XXX
 SG_ TransCltch5MinPrsRq : 0|12@0+ (0.5,0) [0|2047.5] "kPa" Vector__XXX
 SG_ TransCltch5FillCmd : 0|2@0+ (1,0) [0|3] "" Vector__XXX
 SG_ TransClch4_TorqCmnd : 0|12@0+ (0.5,-5) [-5|2042.5] "Nm" Vector__XXX
 SG_ TransCltch4MinPrsRq : 0|12@0+ (0.5,0) [0|2047.5] "kPa" Vector__XXX
 SG_ TransCltch4FillCmd : 0|2@0+ (1,0) [0|3] "" Vector__XXX
 SG_ TransCltch1FillCmd : 0|2@0+ (1,0) [0|3] "" Vector__XXX
 SG_ TransCltch1CntlRqPVal : 0|2@0+ (1,0) [0|3] "" Vector__XXX
 SG_ MtrBCoolFlwCmd : 0|8@0+ (0.05,0) [0|12.75] "l/min" Vector__XXX
 SG_ MtrACoolFlwCmd : 0|8@0+ (0.05,0) [0|12.75] "l/min" Vector__XXX
 SG_ TransCltchCntlARC : 0|2@0+ (1,0) [0|3] "" Vector__XXX
 SG_ TransCltch5CntlRqPVal : 0|2@0+ (1,0) [0|3] "" Vector__XXX
 SG_ TransCltch4CntlRqPVal : 0|2@0+ (1,0) [0|3] "" Vector__XXX
 SG_ TransCltch3CntlRqPVal : 0|2@0+ (1,0) [0|3] "" Vector__XXX
 SG_ TransCltch2CntlRqPVal : 0|2@0+ (1,0) [0|3] "" Vector__XXX
 SG_ TransClch1_TorqCmnd : 0|12@0+ (0.5,-5) [-5|2042.5] "Nm" Vector__XXX
 SG_ TransCltch1MinPrsRq : 0|12@0+ (0.5,0) [0|2047.5] "kPa" Vector__XXX
 SG_ TransCltch5CntlRq : 0|2@0+ (1,0) [0|3] "" Vector__XXX
 SG_ TransCltch4CntlRq : 0|2@0+ (1,0) [0|3] "" Vector__XXX
 SG_ TransCltch3CntlRq : 0|2@0+ (1,0) [0|3] "" Vector__XXX
 SG_ TransCltch2CntlRq : 0|2@0+ (1,0) [0|3] "" Vector__XXX
 SG_ TransCltch1CntlRq : 0|2@0+ (1,0) [0|3] "" Vector__XXX
 SG_ TransAuxPmpPresDetcd : 0|1@0+ (1,0) [0|1] "" Vector__XXX
 SG_ TransClch3_TorqCmnd : 0|12@0+ (0.5,-5) [-5|2042.5] "Nm" Vector__XXX
 SG_ TransCltch3MinPrsRq : 0|12@0+ (0.5,0) [0|2047.5] "kPa" Vector__XXX
 SG_ TransCltch3FillCmd : 0|2@0+ (1,0) [0|3] "" Vector__XXX
 SG_ DgnInf_HS55E : 0|64@0+ (1,0) [0|1.84467440737096E+019] "" Vector__XXX
 SG_ DgnInf_HS54F : 0|64@0+ (1,0) [0|1.84467440737096E+019] "" Vector__XXX
 SG_ DTCIUnused4_777 : 0|1@0+ (1,0) [0|1] "" Vector__XXX
 SG_ DTCIUnused3_777 : 0|1@0+ (1,0) [0|1] "" Vector__XXX
 SG_ DTCIUnused2_777 : 0|1@0+ (1,0) [0|1] "" Vector__XXX
 SG_ DTCIUnused1_777 : 0|1@0+ (1,0) [0|1] "" Vector__XXX
 SG_ DgnInf_HS547 : 0|64@0+ (1,0) [0|1.84467440737096E+019] "" Vector__XXX
 SG_ EBrkAstStat : 0|3@0+ (1,0) [0|7] "" Vector__XXX
 SG_ Sig1877PVal : 0|2@0+ (1,0) [0|3] "" Vector__XXX
 SG_ Sig1877ARC : 0|2@0+ (1,0) [0|3] "" Vector__XXX
 SG_ Sig1877 : 0|1@0+ (1,0) [0|1] "" Vector__XXX
 SG_ TransClch2_TorqCmnd : 0|12@0+ (0.5,-5) [-5|2042.5] "Nm" Vector__XXX
 SG_ TransCltch2MinPrsRq : 0|12@0+ (0.5,0) [0|2047.5] "kPa" Vector__XXX
 SG_ TransCltch2FillCmd : 0|2@0+ (1,0) [0|3] "" Vector__XXX
 SG_ HybTrnsLubeFlwRqd : 0|8@0+ (0.0625,0) [0|15.9375] "l/min" Vector__XXX
 SG_ MtrBSpd : 0|15@0- (1,0) [-16384|16383] "rpm" Vector__XXX
 SG_ MtrASpd : 0|15@0- (1,0) [-16384|16383] "rpm" Vector__XXX
 SG_ HybTransStCmmnd : 0|4@0+ (1,0) [0|15] "" Vector__XXX
 SG_ HybTransStAchvd : 0|4@0+ (1,0) [0|15] "" Vector__XXX
 SG_ TransFldPmpCmd : 0|2@0+ (1,0) [0|3] "" Vector__XXX
 SG_ TnsClchFlLnePrsBstRq : 0|1@0+ (1,0) [0|1] "" Vector__XXX
 SG_ TransAuxPumpSpd : 0|8@0+ (0.392157,0) [0|100.000035] "%" Vector__XXX
 SG_ TransAuxPumpAvail : 0|1@0+ (1,0) [0|1] "" Vector__XXX
 SG_ MtrBSpdV : 0|1@0+ (1,0) [0|1] "" Vector__XXX
 SG_ MtrASpdV : 0|1@0+ (1,0) [0|1] "" Vector__XXX
 SG_ HybColdSoakTempM : 0|1@0+ (1,0) [0|1] "" Vector__XXX
 SG_ HybColdSoakTemp : 0|8@0+ (0.5,-40) [-40|87.5] "deg C" Vector__XXX
 SG_ BrkSyCtl2EmsRldMlfAct : 0|1@0+ (1,0) [0|1] "" Vector__XXX
 SG_ BSC2ERDTC_CdNum : 0|12@0+ (1,0) [0|4095] "" Vector__XXX
 SG_ BSC2ERDTC_SysDes : 0|4@0+ (1,0) [0|15] "" Vector__XXX
 SG_ RdGasFuelDevDisStat : 0|2@0+ (1,0) [0|3] "" Vector__XXX
 SG_ RdFInjCtrlMdIFltAct : 0|1@0+ (1,0) [0|1] "" Vector__XXX
 SG_ RdDistFuelMdReq : 0|3@0+ (1,0) [0|7] "" Vector__XXX
 SG_ RdDistFuelMdCmdResRC : 0|2@0+ (1,0) [0|3] "" Vector__XXX
 SG_ RdDistFuelMdCmdRes : 0|3@0+ (1,0) [0|7] "" Vector__XXX
 SG_ RdAltFuelSysStat : 0|2@0+ (1,0) [0|3] "" Vector__XXX
 SG_ RdAltFuelInjCmdRsp : 0|4@0+ (1,0) [0|15] "" Vector__XXX
 SG_ AltFuelInjRCRstOcc : 0|1@0+ (1,0) [0|1] "" Vector__XXX
 SG_ AltFuelInjRC : 0|16@0+ (3.0517578125E-005,0) [0|1.99996948242188] "liters" Vector__XXX
 SG_ CltTmpCntlMdEmRMAct : 0|1@0+ (1,0) [0|1] "" Vector__XXX
 SG_ CTCMERDTC_SysDes : 0|4@0+ (1,0) [0|15] "" Vector__XXX
 SG_ CTCMERDTC_CdNum : 0|12@0+ (1,0) [0|4095] "" Vector__XXX
 SG_ RHCS_RdctHtrCCurrV : 0|1@0+ (1,0) [0|1] "" Vector__XXX
 SG_ RHCS_RdctHtrBCurrV : 0|1@0+ (1,0) [0|1] "" Vector__XXX
 SG_ RHCS_RdctHtrACurrV : 0|1@0+ (1,0) [0|1] "" Vector__XXX
 SG_ RdctHtrCrntFdbckRC : 0|2@0+ (1,0) [0|3] "" Vector__XXX
 SG_ RdctHtrCctStatPV : 0|3@0+ (1,0) [0|7] "" Vector__XXX
 SG_ RdctHtrCCrntFdbckPVa : 0|8@0+ (1,0) [0|255] "" Vector__XXX
 SG_ RdctHtrBCrntFdbckPVa : 0|8@0+ (1,0) [0|255] "" Vector__XXX
 SG_ RdctHtrACrntFdbckPVa : 0|8@0+ (1,0) [0|255] "" Vector__XXX
 SG_ RdctHtrCCrntFdbck : 0|8@0+ (0.117647,0) [0|29.999985] "A" Vector__XXX
 SG_ RdctHtrBCrntFdbck : 0|8@0+ (0.117647,0) [0|29.999985] "A" Vector__XXX
 SG_ RdctHtrACrntFdbck : 0|8@0+ (0.117647,0) [0|29.999985] "A" Vector__XXX
 SG_ AltFuelLvlPrcnt : 0|8@0+ (0.392157,0) [0|100.000035] "%" Vector__XXX
 SG_ FuelInjCntrlModInjFltAct : 0|1@0+ (1,0) [0|1] "" Vector__XXX
 SG_ AFRP_RailPrs : 0|8@0+ (3,0) [0|765] "kPa" Vector__XXX
 SG_ AFRP_SnsTyp : 0|2@0+ (1,0) [0|3] "" Vector__XXX
 SG_ FICMDS3_DTCStatus : 0|3@0+ (1,0) [0|7] "" Vector__XXX
 SG_ FICMDS3_DTCIndx : 0|5@0+ (1,0) [0|31] "" Vector__XXX
 SG_ FICMDS2_DTCStatus : 0|3@0+ (1,0) [0|7] "" Vector__XXX
 SG_ FICMDS2_DTCIndx : 0|5@0+ (1,0) [0|31] "" Vector__XXX
 SG_ FICMDS1_DTCStatus : 0|3@0+ (1,0) [0|7] "" Vector__XXX
 SG_ FICMDS1_DTCIndx : 0|5@0+ (1,0) [0|31] "" Vector__XXX
 SG_ AltFuelRFuelTrmLmtOff : 0|6@0- (0.01,0) [-0.32|0.31] "" Vector__XXX
 SG_ AltFuelLnFuelTrmLmtOff : 0|6@0- (0.01,0) [-0.32|0.31] "" Vector__XXX
 SG_ AltFuelInjMinPlsOffst : 0|8@0- (0.0313725,0) [-4.01568|3.9843075] "grams/s" Vector__XXX
 SG_ AltFuelInjOpnOffst : 0|8@0- (0.0313725,0) [-4.01568|3.9843075] "grams/s" Vector__XXX
 SG_ AltFuelInjFlwOffst : 0|8@0- (0.0313725,0) [-4.01568|3.9843075] "grams/s" Vector__XXX
 SG_ AltFuelEqvlntRatBsOffst : 0|8@0- (0.000392157,0) [-0.050196096|0.049803939] "" Vector__XXX
 SG_ AltFuelPst02BsOffst : 0|8@0- (4,0) [-512|508] "mVolts" Vector__XXX
 SG_ BattThrmlCondOffTmeV : 0|1@0+ (1,0) [0|1] "" Vector__XXX
 SG_ BattThrmlCondOffTmeM : 0|1@0+ (1,0) [0|1] "" Vector__XXX
 SG_ BattThrmlCondOffTme : 0|12@0+ (0.5,0) [0|2047.5] "min" Vector__XXX
 SG_ OffBrdChrgOffTmeV : 0|1@0+ (1,0) [0|1] "" Vector__XXX
 SG_ OffBrdChrgOffTmeM : 0|1@0+ (1,0) [0|1] "" Vector__XXX
 SG_ OffBrdChrgOffTme : 0|12@0+ (0.5,0) [0|2047.5] "min" Vector__XXX
 SG_ RdctHtrCStat : 0|1@0+ (1,0) [0|1] "" Vector__XXX
 SG_ RdctHtrBStat : 0|1@0+ (1,0) [0|1] "" Vector__XXX
 SG_ RdctHtrAStat : 0|1@0+ (1,0) [0|1] "" Vector__XXX
 SG_ GPCMDS2_DTCStatus : 0|3@0+ (1,0) [0|7] "" Vector__XXX
 SG_ GPCMDS2_DTCIndex : 0|5@0+ (1,0) [0|31] "" Vector__XXX
 SG_ IntAirHtrPwrConsmp : 0|8@0+ (20,0) [0|5100] "W" Vector__XXX
 SG_ IntAirHtrPwrConsmpV : 0|1@0+ (1,0) [0|1] "" Vector__XXX
 SG_ DslGlwPlgMdOvTmOD : 0|1@0+ (1,0) [0|1] "" Vector__XXX
 SG_ IQAI_DataByte : 0|8@0+ (1,0) [0|255] "" Vector__XXX
 SG_ IQAI_DataSeqNmbr : 0|4@0+ (1,0) [0|15] "" Vector__XXX
 SG_ IQAI_InjIdInd : 0|3@0+ (1,0) [0|7] "" Vector__XXX
 SG_ IQAI_DataStat : 0|1@0+ (1,0) [0|1] "" Vector__XXX
 SG_ IntAirHtrTempSensVoltV : 0|1@0+ (1,0) [0|1] "" Vector__XXX
 SG_ IntAirHtrTempSensVolt : 0|8@0+ (0.0196078,0) [0|4.999989] "volts" Vector__XXX
 SG_ IntAirHtrSupVoltV : 0|1@0+ (1,0) [0|1] "" Vector__XXX
 SG_ IntAirHtrSupVolt : 0|8@0+ (0.1,0) [0|25.5] "volts" Vector__XXX
 SG_ GPCMDS_DTCStatus : 0|3@0+ (1,0) [0|7] "" Vector__XXX
 SG_ GPCMDS_DTCIndex : 0|5@0+ (1,0) [0|31] "" Vector__XXX
 SG_ EngCoolFanOpEnbl : 0|1@0+ (1,0) [0|1] "" Vector__XXX
 SG_ DiagFreeRunCntrV : 0|1@0+ (1,0) [0|1] "" Vector__XXX
 SG_ DiagFreeRunCntr : 0|23@0+ (1,0) [0|8388607] "min" Vector__XXX
 SG_ HybFanSpdRq : 0|8@0+ (0.392157,0) [0|100.000035] "%" Vector__XXX
 SG_ TransDirctnStV : 0|1@0+ (1,0) [0|1] "" Vector__XXX
 SG_ TransDirctnSt : 0|3@0+ (1,0) [0|7] "" Vector__XXX
 SG_ AuxClntHtrVlvStat : 0|3@0+ (1,0) [0|7] "" Vector__XXX
 SG_ FCAHptcStVbnRqSeqN : 0|2@0+ (1,0) [0|3] "" Vector__XXX
 SG_ FCAHptcStVbnReq : 0|6@0+ (1,0) [0|63] "" Vector__XXX
 SG_ ClimCtrlHVDvcShtdwnCmd : 0|1@0+ (1,0) [0|1] "" Vector__XXX
 SG_ ThrmlRefCompSpdV : 0|1@0+ (1,0) [0|1] "" Vector__XXX
 SG_ ThrmlRefCompSpd : 0|14@0+ (1,0) [0|16383] "rpm" Vector__XXX
 SG_ PTOTpStpSpdCsStAvl : 0|1@0+ (1,0) [0|1] "" Vector__XXX
 SG_ PTOTpStSpdCsCrStVal : 0|3@0+ (1,0) [0|7] "" Vector__XXX
 SG_ PTOStdbySpdCsStAvl : 0|1@0+ (1,0) [0|1] "" Vector__XXX

CM_ "Primary High Speed GMLAN";
CM_ BU_ BCP_HS "BAS+";
CM_ BU_ ECM_HS "Engine Control Module";
CM_ BU_ TCM_HS "Transmission Control Module";
CM_ BU_ CGM_HS "Communication Gateway";
CM_ BU_ BCM_HS "HS Side Global Architecture Gateway and Body Control Module";
CM_ BU_ EBCM_OBD_HS "Electronic Brake Control Module";
CM_ BU_ ACCM_HS "Air Conditioning Control Module";
CM_ BU_ EBCM_HS "Electronic Brake Control Module";
CM_ BU_ TCCM_HS "Transfer Case Control Module";
CM_ BU_ SAS_HS "Steering Angle Sensor";
CM_ BU_ ICCM_OBD_HS "Integrated Chassis Control Module";
CM_ BU_ ICCM_HS "Integrated Chassis Control Module";
CM_ BU_ EPS_HS "Electronic Power Steering";
CM_ BU_ EPB_HS "Electronic Park Brake";
CM_ BU_ HMIM_HS "Next-Gen Infotainment HMIModule ";
CM_ BU_ ONSTAR_HS "OnStar Module";
CM_ BO_ 3221225472 "This is a message for not used signals, created by Vector CANdb++ DBC OLE DB Provider.";
CM_ SG_ 3221225472 DTCI_DTCFaultType_771 "Based on Powertrain definition.  Not expected to be supported by all devices.";
CM_ SG_ 3221225472 DTCI_DTCFailType_771 "Assigned per GMW3110, Appendix E";
CM_ SG_ 3221225472 DTCI_DTCSource_771 "This shall be equal to the Diagnostic Address of the transmittting device.";
CM_ SG_ 3221225472 DTCI_DTCSource_78F "This shall be equal to the Diagnostic Address of the transmittting device.";
CM_ SG_ 3221225472 DTCI_DTCFaultType_78F "Based on Powertrain definition.  Not expected to be supported by all devices.";
CM_ SG_ 3221225472 DTCI_DTCFailType_78F "Assigned per GMW3110, Appendix E";
CM_ SG_ 3221225472 DTCI_DTCFailType_78E "Assigned per GMW3110, Appendix E";
CM_ SG_ 3221225472 DTCI_DTCFaultType_78E "Based on Powertrain definition.  Not expected to be supported by all devices.";
CM_ SG_ 3221225472 DTCI_DTCSource_78E "This shall be equal to the Diagnostic Address of the transmittting device.";
CM_ SG_ 3221225472 DTCI_DTCFailType_789 "Assigned per GMW3110, Appendix E";
CM_ SG_ 3221225472 DTCI_DTCFaultType_789 "Based on Powertrain definition.  Not expected to be supported by all devices.";
CM_ SG_ 3221225472 DTCI_DTCSource_789 "This shall be equal to the Diagnostic Address of the transmittting device.";
CM_ SG_ 3221225472 DTCI_DTCFailType_787 "Assigned per GMW3110, Appendix E";
CM_ SG_ 3221225472 DTCI_DTCFaultType_787 "Based on Powertrain definition.  Not expected to be supported by all devices.";
CM_ SG_ 3221225472 DTCI_DTCSource_787 "This shall be equal to the Diagnostic Address of the transmittting device.";
CM_ SG_ 3221225472 DTCI_DTCFailType_78D "Assigned per GMW3110, Appendix E";
CM_ SG_ 3221225472 DTCI_DTCFaultType_78D "Based on Powertrain definition.  Not expected to be supported by all devices.";
CM_ SG_ 3221225472 DTCI_DTCSource_78D "This shall be equal to the Diagnostic Address of the transmittting device.";
CM_ SG_ 3221225472 DTCI_DTCFailType_786 "Assigned per GMW3110, Appendix E";
CM_ SG_ 3221225472 DTCI_DTCFaultType_786 "Based on Powertrain definition.  Not expected to be supported by all devices.";
CM_ SG_ 3221225472 DTCI_DTCSource_786 "This shall be equal to the Diagnostic Address of the transmittting device.";
CM_ SG_ 3221225472 DTCI_DTCFailType_784 "Assigned per GMW3110, Appendix E";
CM_ SG_ 3221225472 DTCI_DTCFaultType_784 "Based on Powertrain definition.  Not expected to be supported by all devices.";
CM_ SG_ 3221225472 DTCI_DTCFaultType_774 "Based on Powertrain definition.  Not expected to be supported by all devices.";
CM_ SG_ 3221225472 DTCI_DTCFailType_774 "Assigned per GMW3110, Appendix E";
CM_ SG_ 3221225472 DTCI_DTCSource_774 "This shall be equal to the Diagnostic Address of the transmittting device.";
CM_ SG_ 3221225472 DTCI_DTCFaultType_779 "Based on Powertrain definition.  Not expected to be supported by all devices.";
CM_ SG_ 3221225472 DTCI_DTCFailType_779 "Assigned per GMW3110, Appendix E";
CM_ SG_ 3221225472 DTCI_DTCSource_779 "This shall be equal to the Diagnostic Address of the transmittting device.";
CM_ SG_ 3221225472 DTCI_DTCFailType_78C "Assigned per GMW3110, Appendix E";
CM_ SG_ 3221225472 DTCI_DTCFaultType_78C "Based on Powertrain definition.  Not expected to be supported by all devices.";
CM_ SG_ 3221225472 DTCI_DTCSource_78C "This shall be equal to the Diagnostic Address of the transmittting device.";
CM_ SG_ 3221225472 DTCI_DTCSource_784 "This shall be equal to the Diagnostic Address of the transmittting device.";
CM_ SG_ 3221225472 DTCI_DTCFaultType_775 "Based on Powertrain definition.  Not expected to be supported by all devices.";
CM_ SG_ 3221225472 DTCI_DTCFailType_775 "Assigned per GMW3110, Appendix E";
CM_ SG_ 3221225472 DTCI_DTCSource_775 "This shall be equal to the Diagnostic Address of the transmittting device.";
CM_ SG_ 3221225472 DTCI_DTCSource_783 "This shall be equal to the Diagnostic Address of the transmittting device.";
CM_ SG_ 3221225472 DTCI_DTCFaultType_783 "Based on Powertrain definition.  Not expected to be supported by all devices.";
CM_ SG_ 3221225472 DTCI_DTCFailType_783 "Assigned per GMW3110, Appendix E";
CM_ SG_ 3221225472 DTCI_DTCFaultType_77E "Based on Powertrain definition.  Not expected to be supported by all devices.";
CM_ SG_ 3221225472 DTCI_DTCFailType_77E "Assigned per GMW3110, Appendix E";
CM_ SG_ 3221225472 DTCI_DTCSource_77E "This shall be equal to the Diagnostic Address of the transmittting device.";
CM_ SG_ 3221225472 DTCI_DTCFaultType_777 "Based on Powertrain definition.  Not expected to be supported by all devices.";
CM_ SG_ 3221225472 DTCI_DTCFailType_777 "Assigned per GMW3110, Appendix E";
CM_ SG_ 3221225472 DTCI_DTCSource_777 "This shall be equal to the Diagnostic Address of the transmittting device.";
CM_ SG_ 3221225472 AltFuelEqvlntRatBsOffst "Units = Equivalence Ratio";
BA_DEF_ SG_  "VNSigSLHSSharedDiagnostic" ENUM  "No","Yes";
BA_DEF_ SG_  "VNSigSLHS_VNReq" ENUM  "No","Yes";
BA_DEF_ SG_  "GenSigSendOnInit" ENUM  "Not Initialized","Application","Handler";
BA_DEF_ SG_  "GenSigSendType" ENUM  "not used","not used","not used","not used","not used","not used","not used","NoSigSendType","not used","not used","OnAnyChange","OnChangeIfActive","OnDelta";
BA_DEF_ SG_  "GenSigDeltaValue" INT 0 0;
BA_DEF_ SG_  "VNSigAllNodes" ENUM  "No","Yes";
BA_DEF_ SG_  "SignalType" STRING ;
BA_DEF_ SG_  "PacketOrder" INT 0 65535;
BA_DEF_ SG_  "SignalLongName" STRING ;
BA_DEF_ SG_  "GenSigStartValue" INT 0 65535;
BA_DEF_ SG_  "TxSignalSendOnInit" ENUM  "Not Initialized","Application","Handler";
BA_DEF_ BO_  "GenMsgILSupport" ENUM  "No","Yes";
BA_DEF_ BO_  "AppGenMsgCycleTime" INT 0 0;
BA_DEF_ BO_  "TpApplType" STRING ;
BA_DEF_ BO_  "Prio" INT 0 7;
BA_DEF_ BO_  "MessageSubnet" ENUM  "LS","MS","HS","CE","PE","HV","FO","S1","HE","LE","HE2","vector_leerstring";
BA_DEF_ BO_  "DiagState" ENUM  "No","Yes";
BA_DEF_ BO_  "GenMsgIlSupport" ENUM  "No","Yes";
BA_DEF_ BO_  "GenMsgStartDelayTime" INT 0 100000;
BA_DEF_ BO_  "GenMsgDelayTime" INT 0 100000;
BA_DEF_ BO_  "GenMsgCycleTime" INT 0 100000;
BA_DEF_ BO_  "GenMsgSendType" ENUM  "cyclicX","spontanX","cyclicIfActiveX","spontanWithDelay","cyclicAndSpontanX","cyclicAndSpontanWithDelay","spontanWithRepitition","cyclicIfActiveAndSpontanWD";
BA_DEF_ BO_  "DiagResponse" ENUM  "No","Yes";
BA_DEF_ BO_  "DiagRequest" ENUM  "No","Yes";
BA_DEF_ BO_  "NmMessage" ENUM  "No","Yes";
BA_DEF_ BU_  "VNECUSLHSSharedDiagnostic" ENUM  "None","Activator","Remoted","Activator and Remoted","Shared Local";
BA_DEF_ BU_  "VNECUSLHS_VNReq" ENUM  "None","Activator","Remoted","Activator and Remoted","Shared Local";
BA_DEF_ BU_  "VNECUAllNodes" ENUM  "None","Activator","Remoted","Activator and Remoted","Shared Local";
BA_DEF_ BU_  "MessageManagerUsed" ENUM  "No","Yes";
BA_DEF_ BU_  "NmNode" ENUM  "No","Yes";
BA_DEF_ BU_  "ILUsed" ENUM  "No","Yes";
BA_DEF_ BU_  "FillCharacter" HEX 0 255;
BA_DEF_ BU_  "Flashstate0646Size" INT 0 256;
BA_DEF_ BU_  "NodeLayerModules" STRING ;
BA_DEF_  "VN_SLHSSharedDiagnostic" INT 0 255;
BA_DEF_  "VN_SLHS_VNReq" INT 0 255;
BA_DEF_  "VN_AllNodes" INT 0 255;
BA_DEF_  "VNInitActSLHSSharedDiagnostic" ENUM  "No","Yes";
BA_DEF_  "VNInitActSLHS_VNReq" ENUM  "No","Yes";
BA_DEF_  "VehicleArchitecture" STRING ;
BA_DEF_  "Baudrate" INT 0 1000000;
BA_DEF_  "SamplePointMin" FLOAT 0 100;
BA_DEF_  "SamplePointMax" FLOAT 0 100;
BA_DEF_  "SyncJumpWidthMin" INT 0 255;
BA_DEF_  "SyncJumpWidthMax" INT 0 255;
BA_DEF_  "BusType" STRING ;
BA_DEF_  "NmMessageCount" INT 0 32;
BA_DEF_  "NmBaseAddress" HEX 0 2032;
BA_DEF_  "NetworkType" STRING ;
BA_DEF_  "VNMFPeriodicInterval" INT 0 65535;
BA_DEF_  "BusWakeUpDelay" INT 0 65535;
BA_DEF_  "BusOffRecoveryTime" INT 0 65535;
BA_DEF_  "NodeStatusMsgID" HEX 0 536870911;
BA_DEF_  "NodeStatusMsgCycleTime" INT 0 65535;
BA_DEF_  "NodeStatusMsgTimeoutTime" INT 0 65535;
BA_DEF_  "UseGMParameterIDs" INT 0 1;
BA_DEF_  "VersionWeek" INT 0 255;
BA_DEF_  "VersionYear" INT 0 255;
BA_DEF_  "Manufacturer" ENUM  "DBAG","VAG","BMW","PAG","GM";
BA_DEF_  "NmType" STRING ;
BA_DEF_REL_ BU_SG_REL_  "GenSigSuprvResp" ENUM  "None","Notify App","Substitute Default";
BA_DEF_REL_ BU_SG_REL_  "GenSigSuprvRespSubValue" INT 0 65535;
BA_DEF_REL_ BU_SG_REL_  "GenSigRxStartValue" STRING ;
BA_DEF_REL_ BU_SG_REL_  "GenSigVDAFailResp" ENUM  "No","Yes";
BA_DEF_REL_ BU_SG_REL_  "GenSigVDAFailComment" STRING ;
BA_DEF_REL_ BU_SG_REL_  "GenSigVBitRespComment" STRING ;
BA_DEF_REL_ BU_SG_REL_  "GenSigVBitResp" ENUM  "No","Yes";
BA_DEF_REL_ BU_SG_REL_  "GenSigSuprvRespComment" STRING ;
BA_DEF_REL_ BU_SG_REL_  "GenSigTimeoutMsg" HEX 0 268435455;
BA_DEF_REL_ BU_SG_REL_  "GenSigTimeoutTime" INT 0 5000;
BA_DEF_DEF_  "VNSigSLHSSharedDiagnostic" "No";
BA_DEF_DEF_  "VNSigSLHS_VNReq" "No";
BA_DEF_DEF_  "GenSigSendOnInit" "Not Initialized";
BA_DEF_DEF_  "GenSigSendType" "NoSigSendType";
BA_DEF_DEF_  "GenSigDeltaValue" 0;
BA_DEF_DEF_  "VNSigAllNodes" "No";
BA_DEF_DEF_  "SignalType" "";
BA_DEF_DEF_  "PacketOrder" 0;
BA_DEF_DEF_  "SignalLongName" "";
BA_DEF_DEF_  "GenSigStartValue" 0;
BA_DEF_DEF_  "TxSignalSendOnInit" "Not Initialized";
BA_DEF_DEF_  "GenMsgILSupport" "Yes";
BA_DEF_DEF_  "AppGenMsgCycleTime" 0;
BA_DEF_DEF_  "TpApplType" "";
BA_DEF_DEF_  "Prio" 0;
BA_DEF_DEF_  "MessageSubnet" "LS";
BA_DEF_DEF_  "DiagState" "No";
BA_DEF_DEF_  "GenMsgIlSupport" "Yes";
BA_DEF_DEF_  "GenMsgStartDelayTime" 0;
BA_DEF_DEF_  "GenMsgDelayTime" 0;
BA_DEF_DEF_  "GenMsgCycleTime" 0;
BA_DEF_DEF_  "GenMsgSendType" "spontanX";
BA_DEF_DEF_  "DiagResponse" "No";
BA_DEF_DEF_  "DiagRequest" "No";
BA_DEF_DEF_  "NmMessage" "No";
BA_DEF_DEF_  "VNECUSLHSSharedDiagnostic" "None";
BA_DEF_DEF_  "VNECUSLHS_VNReq" "None";
BA_DEF_DEF_  "VNECUAllNodes" "None";
BA_DEF_DEF_  "MessageManagerUsed" "Yes";
BA_DEF_DEF_  "NmNode" "Yes";
BA_DEF_DEF_  "ILUsed" "Yes";
BA_DEF_DEF_  "FillCharacter" 255;
BA_DEF_DEF_  "Flashstate0646Size" 8;
BA_DEF_DEF_  "NodeLayerModules" "gmlan02.dll";
BA_DEF_DEF_  "VN_SLHSSharedDiagnostic" 0;
BA_DEF_DEF_  "VN_SLHS_VNReq" 2;
BA_DEF_DEF_  "VN_AllNodes" 1;
BA_DEF_DEF_  "VNInitActSLHSSharedDiagnostic" "No";
BA_DEF_DEF_  "VNInitActSLHS_VNReq" "No";
BA_DEF_DEF_  "VehicleArchitecture" "";
BA_DEF_DEF_  "Baudrate" 0;
BA_DEF_DEF_  "SamplePointMin" 0;
BA_DEF_DEF_  "SamplePointMax" 0;
BA_DEF_DEF_  "SyncJumpWidthMin" 0;
BA_DEF_DEF_  "SyncJumpWidthMax" 0;
BA_DEF_DEF_  "BusType" "";
BA_DEF_DEF_  "NmMessageCount" 32;
BA_DEF_DEF_  "NmBaseAddress" 1568;
BA_DEF_DEF_  "NetworkType" "";
BA_DEF_DEF_  "VNMFPeriodicInterval" 3000;
BA_DEF_DEF_  "BusWakeUpDelay" 100;
BA_DEF_DEF_  "BusOffRecoveryTime" 0;
BA_DEF_DEF_  "NodeStatusMsgID" 268433408;
BA_DEF_DEF_  "NodeStatusMsgCycleTime" 1200;
BA_DEF_DEF_  "NodeStatusMsgTimeoutTime" 3000;
BA_DEF_DEF_  "UseGMParameterIDs" 1;
BA_DEF_DEF_  "VersionWeek" 0;
BA_DEF_DEF_  "VersionYear" 0;
BA_DEF_DEF_  "Manufacturer" "GM";
BA_DEF_DEF_  "NmType" "GMLAN";
BA_DEF_DEF_REL_ "GenSigSuprvResp" "None";
BA_DEF_DEF_REL_ "GenSigSuprvRespSubValue" 0;
BA_DEF_DEF_REL_ "GenSigRxStartValue" "";
BA_DEF_DEF_REL_ "GenSigVDAFailResp" "No";
BA_DEF_DEF_REL_ "GenSigVDAFailComment" "";
BA_DEF_DEF_REL_ "GenSigVBitRespComment" "";
BA_DEF_DEF_REL_ "GenSigVBitResp" "No";
BA_DEF_DEF_REL_ "GenSigSuprvRespComment" "";
BA_DEF_DEF_REL_ "GenSigTimeoutMsg" 0;
BA_DEF_DEF_REL_ "GenSigTimeoutTime" 0;
BA_ "VNInitActSLHSSharedDiagnostic" 1;
BA_ "VNInitActSLHS_VNReq" 1;
BA_ "VehicleArchitecture" "Global A";
BA_ "Baudrate" 500000;
BA_ "SamplePointMin" 80;
BA_ "SamplePointMax" 81.25;
BA_ "SyncJumpWidthMin" 3;
BA_ "SyncJumpWidthMax" 4;
BA_ "BusType" "CAN";
BA_ "NmMessageCount" 16;
BA_ "NmBaseAddress" 1536;
BA_ "NetworkType" "Powertrain";
BA_ "BusOffRecoveryTime" 160;
BA_ "NodeStatusMsgID" 0;
BA_ "NodeStatusMsgTimeoutTime" 0;
BA_ "UseGMParameterIDs" 0;
BA_ "VersionWeek" 47;
BA_ "VersionYear" 8;
BA_ "VNECUSLHSSharedDiagnostic" BU_ TestTool_HS 4;
BA_ "VNECUSLHS_VNReq" BU_ TestTool_HS 4;
BA_ "VNECUAllNodes" BU_ TestTool_HS 4;
BA_ "VNECUSLHSSharedDiagnostic" BU_ BCP_HS 4;
BA_ "VNECUSLHS_VNReq" BU_ BCP_HS 4;
BA_ "VNECUAllNodes" BU_ BCP_HS 4;
BA_ "VNECUSLHSSharedDiagnostic" BU_ ECM_HS 4;
BA_ "VNECUSLHS_VNReq" BU_ ECM_HS 4;
BA_ "VNECUAllNodes" BU_ ECM_HS 4;
BA_ "VNECUSLHSSharedDiagnostic" BU_ TCM_HS 4;
BA_ "VNECUSLHS_VNReq" BU_ TCM_HS 4;
BA_ "VNECUAllNodes" BU_ TCM_HS 4;
BA_ "VNECUSLHSSharedDiagnostic" BU_ CGM_HS 4;
BA_ "VNECUSLHS_VNReq" BU_ CGM_HS 4;
BA_ "VNECUAllNodes" BU_ CGM_HS 4;
BA_ "VNECUSLHSSharedDiagnostic" BU_ BCM_HS 4;
BA_ "VNECUSLHS_VNReq" BU_ BCM_HS 4;
BA_ "VNECUAllNodes" BU_ BCM_HS 4;
BA_ "VNECUSLHSSharedDiagnostic" BU_ EBCM_OBD_HS 4;
BA_ "VNECUSLHS_VNReq" BU_ EBCM_OBD_HS 4;
BA_ "VNECUAllNodes" BU_ EBCM_OBD_HS 4;
BA_ "VNECUSLHSSharedDiagnostic" BU_ ACCM_HS 4;
BA_ "VNECUSLHS_VNReq" BU_ ACCM_HS 4;
BA_ "VNECUAllNodes" BU_ ACCM_HS 4;
BA_ "VNECUSLHSSharedDiagnostic" BU_ EBCM_HS 4;
BA_ "VNECUSLHS_VNReq" BU_ EBCM_HS 4;
BA_ "VNECUAllNodes" BU_ EBCM_HS 4;
BA_ "VNECUSLHSSharedDiagnostic" BU_ TCCM_HS 4;
BA_ "VNECUSLHS_VNReq" BU_ TCCM_HS 4;
BA_ "VNECUAllNodes" BU_ TCCM_HS 4;
BA_ "VNECUSLHSSharedDiagnostic" BU_ SAS_HS 4;
BA_ "VNECUSLHS_VNReq" BU_ SAS_HS 4;
BA_ "VNECUAllNodes" BU_ SAS_HS 4;
BA_ "VNECUSLHSSharedDiagnostic" BU_ ICCM_OBD_HS 4;
BA_ "VNECUSLHS_VNReq" BU_ ICCM_OBD_HS 4;
BA_ "VNECUAllNodes" BU_ ICCM_OBD_HS 4;
BA_ "VNECUSLHSSharedDiagnostic" BU_ ICCM_HS 4;
BA_ "VNECUSLHS_VNReq" BU_ ICCM_HS 4;
BA_ "VNECUAllNodes" BU_ ICCM_HS 4;
BA_ "VNECUSLHSSharedDiagnostic" BU_ EPS_HS 4;
BA_ "VNECUSLHS_VNReq" BU_ EPS_HS 4;
BA_ "VNECUAllNodes" BU_ EPS_HS 4;
BA_ "VNECUSLHSSharedDiagnostic" BU_ EPB_HS 4;
BA_ "VNECUSLHS_VNReq" BU_ EPB_HS 4;
BA_ "VNECUAllNodes" BU_ EPB_HS 4;
BA_ "VNECUSLHSSharedDiagnostic" BU_ HMIM_HS 4;
BA_ "VNECUSLHS_VNReq" BU_ HMIM_HS 4;
BA_ "VNECUAllNodes" BU_ HMIM_HS 4;
BA_ "VNECUSLHSSharedDiagnostic" BU_ ONSTAR_HS 4;
BA_ "VNECUSLHS_VNReq" BU_ ONSTAR_HS 4;
BA_ "VNECUAllNodes" BU_ ONSTAR_HS 4;
BA_ "VNSigAllNodes" SG_ 3221225472 ChrgSysAudblIndRq 1;
BA_ "SignalType" SG_ 3221225472 ChrgSysAudblIndRq "ENM";
BA_ "SignalLongName" SG_ 3221225472 ChrgSysAudblIndRq "Charging System Audible Indication Request";
BA_ "VNSigAllNodes" SG_ 3221225472 RdHVBatLwParMdReq 1;
BA_ "SignalType" SG_ 3221225472 RdHVBatLwParMdReq "BLN";
BA_ "SignalLongName" SG_ 3221225472 RdHVBatLwParMdReq "Redundant High Voltage Battery Low Parasitic Mode Requested";
BA_ "VNSigAllNodes" SG_ 3221225472 RdHVBtClOVFFTstRq 1;
BA_ "SignalType" SG_ 3221225472 RdHVBtClOVFFTstRq "BLN";
BA_ "SignalLongName" SG_ 3221225472 RdHVBtClOVFFTstRq "Redundant High Voltage Battery Cell Over Voltage Fault Flag Test Req";
BA_ "VNSigAllNodes" SG_ 3221225472 RdHVBtClOVFFTstIdx 1;
BA_ "SignalType" SG_ 3221225472 RdHVBtClOVFFTstIdx "UNM";
BA_ "SignalLongName" SG_ 3221225472 RdHVBtClOVFFTstIdx "Redundant High Voltage Battery Cell Over Voltage Fault Flag Test Index";
BA_ "VNSigAllNodes" SG_ 3221225472 ThrmlRefCompSpdReqARC 1;
BA_ "SignalType" SG_ 3221225472 ThrmlRefCompSpdReqARC "UNM";
BA_ "SignalLongName" SG_ 3221225472 ThrmlRefCompSpdReqARC "Thermal Refrigerant Compressor Speed Request Alive Rolling Count";
BA_ "VNSigAllNodes" SG_ 3221225472 VICMHVEnMgCmEnTrS 1;
BA_ "SignalType" SG_ 3221225472 VICMHVEnMgCmEnTrS "ENM";
BA_ "SignalLongName" SG_ 3221225472 VICMHVEnMgCmEnTrS "VICM High Voltage Energy Management Comm Enable Terminal Status";
BA_ "VNSigAllNodes" SG_ 3221225472 ClimCtrlHVDvcShtdwnCmdARC 1;
BA_ "SignalType" SG_ 3221225472 ClimCtrlHVDvcShtdwnCmdARC "UNM";
BA_ "SignalLongName" SG_ 3221225472 ClimCtrlHVDvcShtdwnCmdARC "Climate Control High Voltage Device Shutdown Commanded Alive Rolling Count";
BA_ "VNSigAllNodes" SG_ 3221225472 ThrmlRefCompSpdReq 1;
BA_ "SignalType" SG_ 3221225472 ThrmlRefCompSpdReq "UNM";
BA_ "SignalLongName" SG_ 3221225472 ThrmlRefCompSpdReq "Thermal Refrigerant Compressor Speed Request";
BA_ "VNSigAllNodes" SG_ 3221225472 a_12VSysVlt 1;
BA_ "SignalType" SG_ 3221225472 a_12VSysVlt "UNM";
BA_ "SignalLongName" SG_ 3221225472 a_12VSysVlt "12V System Voltage";
BA_ "VNSigAllNodes" SG_ 3221225472 HybVehHiVltSysDisbld_236 1;
BA_ "SignalType" SG_ 3221225472 HybVehHiVltSysDisbld_236 "BLN";
BA_ "SignalLongName" SG_ 3221225472 HybVehHiVltSysDisbld_236 "Hybrid Vehicle High Voltage System Disabled";
BA_ "VNSigAllNodes" SG_ 3221225472 DTCI_DTCFaultType_771 1;
BA_ "SignalType" SG_ 3221225472 DTCI_DTCFaultType_771 "ENM";
BA_ "PacketOrder" SG_ 3221225472 DTCI_DTCFaultType_771 20;
BA_ "SignalLongName" SG_ 3221225472 DTCI_DTCFaultType_771 "Diagnostic Trouble Code Information Extended : Diagnostic Trouble Code Fault Type";
BA_ "VNSigAllNodes" SG_ 3221225472 DTCI_CodeSupported_771 1;
BA_ "SignalType" SG_ 3221225472 DTCI_CodeSupported_771 "BLN";
BA_ "PacketOrder" SG_ 3221225472 DTCI_CodeSupported_771 19;
BA_ "SignalLongName" SG_ 3221225472 DTCI_CodeSupported_771 "Diagnostic Trouble Code Information Extended : Code Supported";
BA_ "VNSigAllNodes" SG_ 3221225472 DTCI_CurrentStatus_771 1;
BA_ "SignalType" SG_ 3221225472 DTCI_CurrentStatus_771 "BLN";
BA_ "PacketOrder" SG_ 3221225472 DTCI_CurrentStatus_771 18;
BA_ "SignalLongName" SG_ 3221225472 DTCI_CurrentStatus_771 "Diagnostic Trouble Code Information Extended : Current Status";
BA_ "VNSigAllNodes" SG_ 3221225472 DTCI_TstNPsdCdClrdSt_771 1;
BA_ "SignalType" SG_ 3221225472 DTCI_TstNPsdCdClrdSt_771 "BLN";
BA_ "PacketOrder" SG_ 3221225472 DTCI_TstNPsdCdClrdSt_771 17;
BA_ "SignalLongName" SG_ 3221225472 DTCI_TstNPsdCdClrdSt_771 "Diagnostic Trouble Code Information Extended : Test Not Passed Since Code Cleared Status";
BA_ "VNSigAllNodes" SG_ 3221225472 DTCI_TstFldCdClrdStat_771 1;
BA_ "SignalType" SG_ 3221225472 DTCI_TstFldCdClrdStat_771 "BLN";
BA_ "PacketOrder" SG_ 3221225472 DTCI_TstFldCdClrdStat_771 16;
BA_ "SignalLongName" SG_ 3221225472 DTCI_TstFldCdClrdStat_771 "Diagnostic Trouble Code Information Extended : Test Failed Since Code Cleared Status";
BA_ "VNSigAllNodes" SG_ 3221225472 DTCI_HistStat_771 1;
BA_ "SignalType" SG_ 3221225472 DTCI_HistStat_771 "BLN";
BA_ "PacketOrder" SG_ 3221225472 DTCI_HistStat_771 15;
BA_ "SignalLongName" SG_ 3221225472 DTCI_HistStat_771 "Diagnostic Trouble Code Information Extended : History Status";
BA_ "VNSigAllNodes" SG_ 3221225472 DTCI_TstNPsdPwrUpSt_771 1;
BA_ "SignalType" SG_ 3221225472 DTCI_TstNPsdPwrUpSt_771 "BLN";
BA_ "PacketOrder" SG_ 3221225472 DTCI_TstNPsdPwrUpSt_771 14;
BA_ "SignalLongName" SG_ 3221225472 DTCI_TstNPsdPwrUpSt_771 "Diagnostic Trouble Code Information Extended : Test Not Passed Since Power Up Status";
BA_ "VNSigAllNodes" SG_ 3221225472 DTCI_TstFldPwrUpSt_771 1;
BA_ "SignalType" SG_ 3221225472 DTCI_TstFldPwrUpSt_771 "BLN";
BA_ "PacketOrder" SG_ 3221225472 DTCI_TstFldPwrUpSt_771 13;
BA_ "SignalLongName" SG_ 3221225472 DTCI_TstFldPwrUpSt_771 "Diagnostic Trouble Code Information Extended : Test Failed Since Power Up Status";
BA_ "VNSigAllNodes" SG_ 3221225472 DTCI_WrnIndRqdSt_771 1;
BA_ "SignalType" SG_ 3221225472 DTCI_WrnIndRqdSt_771 "BLN";
BA_ "PacketOrder" SG_ 3221225472 DTCI_WrnIndRqdSt_771 12;
BA_ "SignalLongName" SG_ 3221225472 DTCI_WrnIndRqdSt_771 "Diagnostic Trouble Code Information Extended : Warning Indicator Requested Status";
BA_ "VNSigAllNodes" SG_ 3221225472 DTCI_DTCFailType_771 1;
BA_ "SignalType" SG_ 3221225472 DTCI_DTCFailType_771 "UNM";
BA_ "PacketOrder" SG_ 3221225472 DTCI_DTCFailType_771 11;
BA_ "SignalLongName" SG_ 3221225472 DTCI_DTCFailType_771 "Diagnostic Trouble Code Information Extended : Diagnostic Trouble Code Failure Type";
BA_ "VNSigAllNodes" SG_ 3221225472 DTCI_DTCNumber_771 1;
BA_ "SignalType" SG_ 3221225472 DTCI_DTCNumber_771 "UNM";
BA_ "PacketOrder" SG_ 3221225472 DTCI_DTCNumber_771 10;
BA_ "SignalLongName" SG_ 3221225472 DTCI_DTCNumber_771 "Diagnostic Trouble Code Information Extended : Diagnostic Trouble Code Number";
BA_ "VNSigAllNodes" SG_ 3221225472 DTCI_DTCSource_771 1;
BA_ "SignalType" SG_ 3221225472 DTCI_DTCSource_771 "UNM";
BA_ "PacketOrder" SG_ 3221225472 DTCI_DTCSource_771 9;
BA_ "SignalLongName" SG_ 3221225472 DTCI_DTCSource_771 "Diagnostic Trouble Code Information Extended : Diagnostic Trouble Code Source";
BA_ "VNSigAllNodes" SG_ 3221225472 DTCI_DTCTriggered_771 1;
BA_ "SignalType" SG_ 3221225472 DTCI_DTCTriggered_771 "BLN";
BA_ "PacketOrder" SG_ 3221225472 DTCI_DTCTriggered_771 8;
BA_ "SignalLongName" SG_ 3221225472 DTCI_DTCTriggered_771 "Diagnostic Trouble Code Information Extended : Diagnostic Trouble Code Triggered";
BA_ "VNSigAllNodes" SG_ 3221225472 DTCIUnused7_771 1;
BA_ "SignalType" SG_ 3221225472 DTCIUnused7_771 "BLN";
BA_ "PacketOrder" SG_ 3221225472 DTCIUnused7_771 7;
BA_ "SignalLongName" SG_ 3221225472 DTCIUnused7_771 "Diagnostic Trouble Code Information Extended : Unused 7";
BA_ "VNSigAllNodes" SG_ 3221225472 DTCIUnused6_771 1;
BA_ "SignalType" SG_ 3221225472 DTCIUnused6_771 "BLN";
BA_ "PacketOrder" SG_ 3221225472 DTCIUnused6_771 6;
BA_ "SignalLongName" SG_ 3221225472 DTCIUnused6_771 "Diagnostic Trouble Code Information Extended : Unused 6";
BA_ "VNSigAllNodes" SG_ 3221225472 DTCIUnused5_771 1;
BA_ "SignalType" SG_ 3221225472 DTCIUnused5_771 "BLN";
BA_ "PacketOrder" SG_ 3221225472 DTCIUnused5_771 5;
BA_ "SignalLongName" SG_ 3221225472 DTCIUnused5_771 "Diagnostic Trouble Code Information Extended : Unused 5";
BA_ "VNSigAllNodes" SG_ 3221225472 DTCIUnused4_771 1;
BA_ "SignalType" SG_ 3221225472 DTCIUnused4_771 "BLN";
BA_ "PacketOrder" SG_ 3221225472 DTCIUnused4_771 4;
BA_ "SignalLongName" SG_ 3221225472 DTCIUnused4_771 "Diagnostic Trouble Code Information Extended : Unused 4";
BA_ "VNSigAllNodes" SG_ 3221225472 DTCIUnused3_771 1;
BA_ "SignalType" SG_ 3221225472 DTCIUnused3_771 "BLN";
BA_ "PacketOrder" SG_ 3221225472 DTCIUnused3_771 3;
BA_ "SignalLongName" SG_ 3221225472 DTCIUnused3_771 "Diagnostic Trouble Code Information Extended : Unused 3";
BA_ "VNSigAllNodes" SG_ 3221225472 DTCIUnused2_771 1;
BA_ "SignalType" SG_ 3221225472 DTCIUnused2_771 "BLN";
BA_ "PacketOrder" SG_ 3221225472 DTCIUnused2_771 2;
BA_ "SignalLongName" SG_ 3221225472 DTCIUnused2_771 "Diagnostic Trouble Code Information Extended : Unused 2";
BA_ "VNSigAllNodes" SG_ 3221225472 DTCIUnused1_771 1;
BA_ "SignalType" SG_ 3221225472 DTCIUnused1_771 "BLN";
BA_ "PacketOrder" SG_ 3221225472 DTCIUnused1_771 1;
BA_ "SignalLongName" SG_ 3221225472 DTCIUnused1_771 "Diagnostic Trouble Code Information Extended : Unused 1";
BA_ "VNSigAllNodes" SG_ 3221225472 DTCI_DTCSource_78F 1;
BA_ "SignalType" SG_ 3221225472 DTCI_DTCSource_78F "UNM";
BA_ "PacketOrder" SG_ 3221225472 DTCI_DTCSource_78F 9;
BA_ "SignalLongName" SG_ 3221225472 DTCI_DTCSource_78F "Diagnostic Trouble Code Information Extended 78F : Diagnostic Trouble Code Source";
BA_ "VNSigAllNodes" SG_ 3221225472 DTCI_DTCTriggered_78F 1;
BA_ "SignalType" SG_ 3221225472 DTCI_DTCTriggered_78F "BLN";
BA_ "PacketOrder" SG_ 3221225472 DTCI_DTCTriggered_78F 8;
BA_ "SignalLongName" SG_ 3221225472 DTCI_DTCTriggered_78F "Diagnostic Trouble Code Information Extended 78F : Diagnostic Trouble Code Triggered";
BA_ "VNSigAllNodes" SG_ 3221225472 DTCIUnused1_78F 1;
BA_ "SignalType" SG_ 3221225472 DTCIUnused1_78F "BLN";
BA_ "PacketOrder" SG_ 3221225472 DTCIUnused1_78F 1;
BA_ "SignalLongName" SG_ 3221225472 DTCIUnused1_78F "Diagnostic Trouble Code Information Extended 78F : Unused 1";
BA_ "VNSigAllNodes" SG_ 3221225472 DTCIUnused2_78F 1;
BA_ "SignalType" SG_ 3221225472 DTCIUnused2_78F "BLN";
BA_ "PacketOrder" SG_ 3221225472 DTCIUnused2_78F 2;
BA_ "SignalLongName" SG_ 3221225472 DTCIUnused2_78F "Diagnostic Trouble Code Information Extended 78F : Unused 2";
BA_ "VNSigAllNodes" SG_ 3221225472 DTCIUnused3_78F 1;
BA_ "SignalType" SG_ 3221225472 DTCIUnused3_78F "BLN";
BA_ "PacketOrder" SG_ 3221225472 DTCIUnused3_78F 3;
BA_ "SignalLongName" SG_ 3221225472 DTCIUnused3_78F "Diagnostic Trouble Code Information Extended 78F : Unused 3";
BA_ "VNSigAllNodes" SG_ 3221225472 DTCIUnused4_78F 1;
BA_ "SignalType" SG_ 3221225472 DTCIUnused4_78F "BLN";
BA_ "PacketOrder" SG_ 3221225472 DTCIUnused4_78F 4;
BA_ "SignalLongName" SG_ 3221225472 DTCIUnused4_78F "Diagnostic Trouble Code Information Extended 78F : Unused 4";
BA_ "VNSigAllNodes" SG_ 3221225472 DTCIUnused5_78F 1;
BA_ "SignalType" SG_ 3221225472 DTCIUnused5_78F "BLN";
BA_ "PacketOrder" SG_ 3221225472 DTCIUnused5_78F 5;
BA_ "SignalLongName" SG_ 3221225472 DTCIUnused5_78F "Diagnostic Trouble Code Information Extended 78F : Unused 5";
BA_ "VNSigAllNodes" SG_ 3221225472 DTCIUnused6_78F 1;
BA_ "SignalType" SG_ 3221225472 DTCIUnused6_78F "BLN";
BA_ "PacketOrder" SG_ 3221225472 DTCIUnused6_78F 6;
BA_ "SignalLongName" SG_ 3221225472 DTCIUnused6_78F "Diagnostic Trouble Code Information Extended 78F : Unused 6";
BA_ "VNSigAllNodes" SG_ 3221225472 DTCIUnused7_78F 1;
BA_ "SignalType" SG_ 3221225472 DTCIUnused7_78F "BLN";
BA_ "PacketOrder" SG_ 3221225472 DTCIUnused7_78F 7;
BA_ "SignalLongName" SG_ 3221225472 DTCIUnused7_78F "Diagnostic Trouble Code Information Extended 78F : Unused 7";
BA_ "VNSigAllNodes" SG_ 3221225472 DTCI_CodeSupported_78F 1;
BA_ "SignalType" SG_ 3221225472 DTCI_CodeSupported_78F "BLN";
BA_ "PacketOrder" SG_ 3221225472 DTCI_CodeSupported_78F 19;
BA_ "SignalLongName" SG_ 3221225472 DTCI_CodeSupported_78F "Diagnostic Trouble Code Information Extended 78F : Code Supported";
BA_ "VNSigAllNodes" SG_ 3221225472 DTCI_CurrentStatus_78F 1;
BA_ "SignalType" SG_ 3221225472 DTCI_CurrentStatus_78F "BLN";
BA_ "PacketOrder" SG_ 3221225472 DTCI_CurrentStatus_78F 18;
BA_ "SignalLongName" SG_ 3221225472 DTCI_CurrentStatus_78F "Diagnostic Trouble Code Information Extended 78F : Current Status";
BA_ "VNSigAllNodes" SG_ 3221225472 DTCI_DTCFaultType_78F 1;
BA_ "SignalType" SG_ 3221225472 DTCI_DTCFaultType_78F "ENM";
BA_ "PacketOrder" SG_ 3221225472 DTCI_DTCFaultType_78F 20;
BA_ "SignalLongName" SG_ 3221225472 DTCI_DTCFaultType_78F "Diagnostic Trouble Code Information Extended 78F : Diagnostic Trouble Code Fault Type";
BA_ "VNSigAllNodes" SG_ 3221225472 DTCI_TstFldCdClrdStat_78F 1;
BA_ "SignalType" SG_ 3221225472 DTCI_TstFldCdClrdStat_78F "BLN";
BA_ "PacketOrder" SG_ 3221225472 DTCI_TstFldCdClrdStat_78F 16;
BA_ "SignalLongName" SG_ 3221225472 DTCI_TstFldCdClrdStat_78F "Diagnostic Trouble Code Information Extended 78F : Test Failed Since Code Cleared Status";
BA_ "VNSigAllNodes" SG_ 3221225472 DTCI_TstNPsdCdClrdSt_78F 1;
BA_ "SignalType" SG_ 3221225472 DTCI_TstNPsdCdClrdSt_78F "BLN";
BA_ "PacketOrder" SG_ 3221225472 DTCI_TstNPsdCdClrdSt_78F 17;
BA_ "SignalLongName" SG_ 3221225472 DTCI_TstNPsdCdClrdSt_78F "Diagnostic Trouble Code Information Extended 78F : Test Not Passed Since Code Cleared Status";
BA_ "VNSigAllNodes" SG_ 3221225472 DTCI_HistStat_78F 1;
BA_ "SignalType" SG_ 3221225472 DTCI_HistStat_78F "BLN";
BA_ "PacketOrder" SG_ 3221225472 DTCI_HistStat_78F 15;
BA_ "SignalLongName" SG_ 3221225472 DTCI_HistStat_78F "Diagnostic Trouble Code Information Extended 78F : History Status";
BA_ "VNSigAllNodes" SG_ 3221225472 DTCI_TstNPsdPwrUpSt_78F 1;
BA_ "SignalType" SG_ 3221225472 DTCI_TstNPsdPwrUpSt_78F "BLN";
BA_ "PacketOrder" SG_ 3221225472 DTCI_TstNPsdPwrUpSt_78F 14;
BA_ "SignalLongName" SG_ 3221225472 DTCI_TstNPsdPwrUpSt_78F "Diagnostic Trouble Code Information Extended 78F : Test Not Passed Since Power Up Status";
BA_ "VNSigAllNodes" SG_ 3221225472 DTCI_TstFldPwrUpSt_78F 1;
BA_ "SignalType" SG_ 3221225472 DTCI_TstFldPwrUpSt_78F "BLN";
BA_ "PacketOrder" SG_ 3221225472 DTCI_TstFldPwrUpSt_78F 13;
BA_ "SignalLongName" SG_ 3221225472 DTCI_TstFldPwrUpSt_78F "Diagnostic Trouble Code Information Extended 78F : Test Failed Since Power Up Status";
BA_ "VNSigAllNodes" SG_ 3221225472 DTCI_WrnIndRqdSt_78F 1;
BA_ "SignalType" SG_ 3221225472 DTCI_WrnIndRqdSt_78F "BLN";
BA_ "PacketOrder" SG_ 3221225472 DTCI_WrnIndRqdSt_78F 12;
BA_ "SignalLongName" SG_ 3221225472 DTCI_WrnIndRqdSt_78F "Diagnostic Trouble Code Information Extended 78F : Warning Indicator Requested Status";
BA_ "VNSigAllNodes" SG_ 3221225472 DTCI_DTCFailType_78F 1;
BA_ "SignalType" SG_ 3221225472 DTCI_DTCFailType_78F "UNM";
BA_ "PacketOrder" SG_ 3221225472 DTCI_DTCFailType_78F 11;
BA_ "SignalLongName" SG_ 3221225472 DTCI_DTCFailType_78F "Diagnostic Trouble Code Information Extended 78F : Diagnostic Trouble Code Failure Type";
BA_ "VNSigAllNodes" SG_ 3221225472 DTCI_DTCNumber_78F 1;
BA_ "SignalType" SG_ 3221225472 DTCI_DTCNumber_78F "UNM";
BA_ "PacketOrder" SG_ 3221225472 DTCI_DTCNumber_78F 10;
BA_ "SignalLongName" SG_ 3221225472 DTCI_DTCNumber_78F "Diagnostic Trouble Code Information Extended 78F : Diagnostic Trouble Code Number";
BA_ "VNSigAllNodes" SG_ 3221225472 DTCI_CodeSupported_78E 1;
BA_ "SignalType" SG_ 3221225472 DTCI_CodeSupported_78E "BLN";
BA_ "PacketOrder" SG_ 3221225472 DTCI_CodeSupported_78E 19;
BA_ "SignalLongName" SG_ 3221225472 DTCI_CodeSupported_78E "Diagnostic Trouble Code Information Extended 78E : Code Supported";
BA_ "VNSigAllNodes" SG_ 3221225472 DTCI_CurrentStatus_78E 1;
BA_ "SignalType" SG_ 3221225472 DTCI_CurrentStatus_78E "BLN";
BA_ "PacketOrder" SG_ 3221225472 DTCI_CurrentStatus_78E 18;
BA_ "SignalLongName" SG_ 3221225472 DTCI_CurrentStatus_78E "Diagnostic Trouble Code Information Extended 78E : Current Status";
BA_ "VNSigAllNodes" SG_ 3221225472 DTCI_DTCFailType_78E 1;
BA_ "SignalType" SG_ 3221225472 DTCI_DTCFailType_78E "UNM";
BA_ "PacketOrder" SG_ 3221225472 DTCI_DTCFailType_78E 11;
BA_ "SignalLongName" SG_ 3221225472 DTCI_DTCFailType_78E "Diagnostic Trouble Code Information Extended 78E : Diagnostic Trouble Code Failure Type";
BA_ "VNSigAllNodes" SG_ 3221225472 DTCI_DTCFaultType_78E 1;
BA_ "SignalType" SG_ 3221225472 DTCI_DTCFaultType_78E "ENM";
BA_ "PacketOrder" SG_ 3221225472 DTCI_DTCFaultType_78E 20;
BA_ "SignalLongName" SG_ 3221225472 DTCI_DTCFaultType_78E "Diagnostic Trouble Code Information Extended 78E : Diagnostic Trouble Code Fault Type";
BA_ "VNSigAllNodes" SG_ 3221225472 DTCI_DTCNumber_78E 1;
BA_ "SignalType" SG_ 3221225472 DTCI_DTCNumber_78E "UNM";
BA_ "PacketOrder" SG_ 3221225472 DTCI_DTCNumber_78E 10;
BA_ "SignalLongName" SG_ 3221225472 DTCI_DTCNumber_78E "Diagnostic Trouble Code Information Extended 78E : Diagnostic Trouble Code Number";
BA_ "VNSigAllNodes" SG_ 3221225472 DTCI_DTCSource_78E 1;
BA_ "SignalType" SG_ 3221225472 DTCI_DTCSource_78E "UNM";
BA_ "PacketOrder" SG_ 3221225472 DTCI_DTCSource_78E 9;
BA_ "SignalLongName" SG_ 3221225472 DTCI_DTCSource_78E "Diagnostic Trouble Code Information Extended 78E : Diagnostic Trouble Code Source";
BA_ "VNSigAllNodes" SG_ 3221225472 DTCI_DTCTriggered_78E 1;
BA_ "SignalType" SG_ 3221225472 DTCI_DTCTriggered_78E "BLN";
BA_ "PacketOrder" SG_ 3221225472 DTCI_DTCTriggered_78E 8;
BA_ "SignalLongName" SG_ 3221225472 DTCI_DTCTriggered_78E "Diagnostic Trouble Code Information Extended 78E : Diagnostic Trouble Code Triggered";
BA_ "VNSigAllNodes" SG_ 3221225472 DTCI_TstFldPwrUpSt_78C 1;
BA_ "SignalType" SG_ 3221225472 DTCI_TstFldPwrUpSt_78C "BLN";
BA_ "PacketOrder" SG_ 3221225472 DTCI_TstFldPwrUpSt_78C 14;
BA_ "SignalLongName" SG_ 3221225472 DTCI_TstFldPwrUpSt_78C "Diagnostic Trouble Code Information Extended 78C : Test Failed Since Power Up Status";
BA_ "VNSigAllNodes" SG_ 3221225472 DTCI_TstNPsdCdClrdSt_78C 1;
BA_ "SignalType" SG_ 3221225472 DTCI_TstNPsdCdClrdSt_78C "BLN";
BA_ "PacketOrder" SG_ 3221225472 DTCI_TstNPsdCdClrdSt_78C 17;
BA_ "SignalLongName" SG_ 3221225472 DTCI_TstNPsdCdClrdSt_78C "Diagnostic Trouble Code Information Extended 78C : Test Not Passed Since Code Cleared Status";
BA_ "VNSigAllNodes" SG_ 3221225472 DTCI_TstNPsdPwrUpSt_78C 1;
BA_ "SignalType" SG_ 3221225472 DTCI_TstNPsdPwrUpSt_78C "BLN";
BA_ "PacketOrder" SG_ 3221225472 DTCI_TstNPsdPwrUpSt_78C 13;
BA_ "SignalLongName" SG_ 3221225472 DTCI_TstNPsdPwrUpSt_78C "Diagnostic Trouble Code Information Extended 78C : Test Not Passed Since Power Up Status";
BA_ "VNSigAllNodes" SG_ 3221225472 DTCIUnused1_78C 1;
BA_ "SignalType" SG_ 3221225472 DTCIUnused1_78C "BLN";
BA_ "PacketOrder" SG_ 3221225472 DTCIUnused1_78C 1;
BA_ "SignalLongName" SG_ 3221225472 DTCIUnused1_78C "Diagnostic Trouble Code Information Extended 78C : Unused 1";
BA_ "VNSigAllNodes" SG_ 3221225472 DTCIUnused2_78C 1;
BA_ "SignalType" SG_ 3221225472 DTCIUnused2_78C "BLN";
BA_ "PacketOrder" SG_ 3221225472 DTCIUnused2_78C 2;
BA_ "SignalLongName" SG_ 3221225472 DTCIUnused2_78C "Diagnostic Trouble Code Information Extended 78C : Unused 2";
BA_ "VNSigAllNodes" SG_ 3221225472 DTCIUnused3_78C 1;
BA_ "SignalType" SG_ 3221225472 DTCIUnused3_78C "BLN";
BA_ "PacketOrder" SG_ 3221225472 DTCIUnused3_78C 3;
BA_ "SignalLongName" SG_ 3221225472 DTCIUnused3_78C "Diagnostic Trouble Code Information Extended 78C : Unused 3";
BA_ "VNSigAllNodes" SG_ 3221225472 DTCIUnused4_78C 1;
BA_ "SignalType" SG_ 3221225472 DTCIUnused4_78C "BLN";
BA_ "PacketOrder" SG_ 3221225472 DTCIUnused4_78C 4;
BA_ "SignalLongName" SG_ 3221225472 DTCIUnused4_78C "Diagnostic Trouble Code Information Extended 78C : Unused 4";
BA_ "VNSigAllNodes" SG_ 3221225472 DTCIUnused5_78C 1;
BA_ "SignalType" SG_ 3221225472 DTCIUnused5_78C "BLN";
BA_ "PacketOrder" SG_ 3221225472 DTCIUnused5_78C 5;
BA_ "SignalLongName" SG_ 3221225472 DTCIUnused5_78C "Diagnostic Trouble Code Information Extended 78C : Unused 5";
BA_ "VNSigAllNodes" SG_ 3221225472 DTCIUnused6_78C 1;
BA_ "SignalType" SG_ 3221225472 DTCIUnused6_78C "BLN";
BA_ "PacketOrder" SG_ 3221225472 DTCIUnused6_78C 6;
BA_ "SignalLongName" SG_ 3221225472 DTCIUnused6_78C "Diagnostic Trouble Code Information Extended 78C : Unused 6";
BA_ "VNSigAllNodes" SG_ 3221225472 DTCIUnused7_78C 1;
BA_ "SignalType" SG_ 3221225472 DTCIUnused7_78C "BLN";
BA_ "PacketOrder" SG_ 3221225472 DTCIUnused7_78C 7;
BA_ "SignalLongName" SG_ 3221225472 DTCIUnused7_78C "Diagnostic Trouble Code Information Extended 78C : Unused 7";
BA_ "VNSigAllNodes" SG_ 3221225472 DTCI_WrnIndRqdSt_78C 1;
BA_ "SignalType" SG_ 3221225472 DTCI_WrnIndRqdSt_78C "BLN";
BA_ "PacketOrder" SG_ 3221225472 DTCI_WrnIndRqdSt_78C 12;
BA_ "SignalLongName" SG_ 3221225472 DTCI_WrnIndRqdSt_78C "Diagnostic Trouble Code Information Extended 78C : Warning Indicator Requested Status";
BA_ "VNSigAllNodes" SG_ 3221225472 DTCI_CodeSupported_789 1;
BA_ "SignalType" SG_ 3221225472 DTCI_CodeSupported_789 "BLN";
BA_ "PacketOrder" SG_ 3221225472 DTCI_CodeSupported_789 19;
BA_ "SignalLongName" SG_ 3221225472 DTCI_CodeSupported_789 "Diagnostic Trouble Code Information Extended 789 : Code Supported";
BA_ "VNSigAllNodes" SG_ 3221225472 DTCI_CurrentStatus_789 1;
BA_ "SignalType" SG_ 3221225472 DTCI_CurrentStatus_789 "BLN";
BA_ "PacketOrder" SG_ 3221225472 DTCI_CurrentStatus_789 18;
BA_ "SignalLongName" SG_ 3221225472 DTCI_CurrentStatus_789 "Diagnostic Trouble Code Information Extended 789 : Current Status";
BA_ "VNSigAllNodes" SG_ 3221225472 DTCI_DTCFailType_789 1;
BA_ "SignalType" SG_ 3221225472 DTCI_DTCFailType_789 "UNM";
BA_ "PacketOrder" SG_ 3221225472 DTCI_DTCFailType_789 11;
BA_ "SignalLongName" SG_ 3221225472 DTCI_DTCFailType_789 "Diagnostic Trouble Code Information Extended 789 : Diagnostic Trouble Code Failure Type";
BA_ "VNSigAllNodes" SG_ 3221225472 DTCI_DTCFaultType_789 1;
BA_ "SignalType" SG_ 3221225472 DTCI_DTCFaultType_789 "ENM";
BA_ "PacketOrder" SG_ 3221225472 DTCI_DTCFaultType_789 20;
BA_ "SignalLongName" SG_ 3221225472 DTCI_DTCFaultType_789 "Diagnostic Trouble Code Information Extended 789 : Diagnostic Trouble Code Fault Type";
BA_ "VNSigAllNodes" SG_ 3221225472 DTCI_DTCNumber_789 1;
BA_ "SignalType" SG_ 3221225472 DTCI_DTCNumber_789 "UNM";
BA_ "PacketOrder" SG_ 3221225472 DTCI_DTCNumber_789 10;
BA_ "SignalLongName" SG_ 3221225472 DTCI_DTCNumber_789 "Diagnostic Trouble Code Information Extended 789 : Diagnostic Trouble Code Number";
BA_ "VNSigAllNodes" SG_ 3221225472 DTCI_DTCSource_789 1;
BA_ "SignalType" SG_ 3221225472 DTCI_DTCSource_789 "UNM";
BA_ "PacketOrder" SG_ 3221225472 DTCI_DTCSource_789 9;
BA_ "SignalLongName" SG_ 3221225472 DTCI_DTCSource_789 "Diagnostic Trouble Code Information Extended 789 : Diagnostic Trouble Code Source";
BA_ "VNSigAllNodes" SG_ 3221225472 DTCI_DTCTriggered_789 1;
BA_ "SignalType" SG_ 3221225472 DTCI_DTCTriggered_789 "BLN";
BA_ "PacketOrder" SG_ 3221225472 DTCI_DTCTriggered_789 8;
BA_ "SignalLongName" SG_ 3221225472 DTCI_DTCTriggered_789 "Diagnostic Trouble Code Information Extended 789 : Diagnostic Trouble Code Triggered";
BA_ "VNSigAllNodes" SG_ 3221225472 DTCI_HistStat_789 1;
BA_ "SignalType" SG_ 3221225472 DTCI_HistStat_789 "BLN";
BA_ "PacketOrder" SG_ 3221225472 DTCI_HistStat_789 15;
BA_ "SignalLongName" SG_ 3221225472 DTCI_HistStat_789 "Diagnostic Trouble Code Information Extended 789 : History Status";
BA_ "VNSigAllNodes" SG_ 3221225472 DTCI_TstFldCdClrdStat_789 1;
BA_ "SignalType" SG_ 3221225472 DTCI_TstFldCdClrdStat_789 "BLN";
BA_ "PacketOrder" SG_ 3221225472 DTCI_TstFldCdClrdStat_789 16;
BA_ "SignalLongName" SG_ 3221225472 DTCI_TstFldCdClrdStat_789 "Diagnostic Trouble Code Information Extended 789 : Test Failed Since Code Cleared Status";
BA_ "VNSigAllNodes" SG_ 3221225472 DTCI_TstFldPwrUpSt_789 1;
BA_ "SignalType" SG_ 3221225472 DTCI_TstFldPwrUpSt_789 "BLN";
BA_ "PacketOrder" SG_ 3221225472 DTCI_TstFldPwrUpSt_789 13;
BA_ "SignalLongName" SG_ 3221225472 DTCI_TstFldPwrUpSt_789 "Diagnostic Trouble Code Information Extended 789 : Test Failed Since Power Up Status";
BA_ "VNSigAllNodes" SG_ 3221225472 DTCI_TstNPsdCdClrdSt_789 1;
BA_ "SignalType" SG_ 3221225472 DTCI_TstNPsdCdClrdSt_789 "BLN";
BA_ "PacketOrder" SG_ 3221225472 DTCI_TstNPsdCdClrdSt_789 17;
BA_ "SignalLongName" SG_ 3221225472 DTCI_TstNPsdCdClrdSt_789 "Diagnostic Trouble Code Information Extended 789 : Test Not Passed Since Code Cleared Status";
BA_ "VNSigAllNodes" SG_ 3221225472 DTCI_TstNPsdPwrUpSt_789 1;
BA_ "SignalType" SG_ 3221225472 DTCI_TstNPsdPwrUpSt_789 "BLN";
BA_ "PacketOrder" SG_ 3221225472 DTCI_TstNPsdPwrUpSt_789 14;
BA_ "SignalLongName" SG_ 3221225472 DTCI_TstNPsdPwrUpSt_789 "Diagnostic Trouble Code Information Extended 789 : Test Not Passed Since Power Up Status";
BA_ "VNSigAllNodes" SG_ 3221225472 DTCIUnused1_789 1;
BA_ "SignalType" SG_ 3221225472 DTCIUnused1_789 "BLN";
BA_ "PacketOrder" SG_ 3221225472 DTCIUnused1_789 1;
BA_ "SignalLongName" SG_ 3221225472 DTCIUnused1_789 "Diagnostic Trouble Code Information Extended 789 : Unused 1";
BA_ "VNSigAllNodes" SG_ 3221225472 DTCIUnused2_789 1;
BA_ "SignalType" SG_ 3221225472 DTCIUnused2_789 "BLN";
BA_ "PacketOrder" SG_ 3221225472 DTCIUnused2_789 2;
BA_ "SignalLongName" SG_ 3221225472 DTCIUnused2_789 "Diagnostic Trouble Code Information Extended 789 : Unused 2";
BA_ "VNSigAllNodes" SG_ 3221225472 DTCIUnused3_789 1;
BA_ "SignalType" SG_ 3221225472 DTCIUnused3_789 "BLN";
BA_ "PacketOrder" SG_ 3221225472 DTCIUnused3_789 3;
BA_ "SignalLongName" SG_ 3221225472 DTCIUnused3_789 "Diagnostic Trouble Code Information Extended 789 : Unused 3";
BA_ "VNSigAllNodes" SG_ 3221225472 DTCIUnused4_789 1;
BA_ "SignalType" SG_ 3221225472 DTCIUnused4_789 "BLN";
BA_ "PacketOrder" SG_ 3221225472 DTCIUnused4_789 4;
BA_ "SignalLongName" SG_ 3221225472 DTCIUnused4_789 "Diagnostic Trouble Code Information Extended 789 : Unused 4";
BA_ "VNSigAllNodes" SG_ 3221225472 DTCIUnused5_789 1;
BA_ "SignalType" SG_ 3221225472 DTCIUnused5_789 "BLN";
BA_ "PacketOrder" SG_ 3221225472 DTCIUnused5_789 5;
BA_ "SignalLongName" SG_ 3221225472 DTCIUnused5_789 "Diagnostic Trouble Code Information Extended 789 : Unused 5";
BA_ "VNSigAllNodes" SG_ 3221225472 DTCIUnused6_789 1;
BA_ "SignalType" SG_ 3221225472 DTCIUnused6_789 "BLN";
BA_ "PacketOrder" SG_ 3221225472 DTCIUnused6_789 6;
BA_ "SignalLongName" SG_ 3221225472 DTCIUnused6_789 "Diagnostic Trouble Code Information Extended 789 : Unused 6";
BA_ "VNSigAllNodes" SG_ 3221225472 DTCIUnused7_789 1;
BA_ "SignalType" SG_ 3221225472 DTCIUnused7_789 "BLN";
BA_ "PacketOrder" SG_ 3221225472 DTCIUnused7_789 7;
BA_ "SignalLongName" SG_ 3221225472 DTCIUnused7_789 "Diagnostic Trouble Code Information Extended 789 : Unused 7";
BA_ "VNSigAllNodes" SG_ 3221225472 DTCI_WrnIndRqdSt_789 1;
BA_ "SignalType" SG_ 3221225472 DTCI_WrnIndRqdSt_789 "BLN";
BA_ "PacketOrder" SG_ 3221225472 DTCI_WrnIndRqdSt_789 12;
BA_ "SignalLongName" SG_ 3221225472 DTCI_WrnIndRqdSt_789 "Diagnostic Trouble Code Information Extended 789 : Warning Indicator Requested Status";
BA_ "VNSigAllNodes" SG_ 3221225472 DTCI_CodeSupported_787 1;
BA_ "SignalType" SG_ 3221225472 DTCI_CodeSupported_787 "BLN";
BA_ "PacketOrder" SG_ 3221225472 DTCI_CodeSupported_787 19;
BA_ "SignalLongName" SG_ 3221225472 DTCI_CodeSupported_787 "Diagnostic Trouble Code Information Extended 787 : Code Supported";
BA_ "VNSigAllNodes" SG_ 3221225472 DTCI_CurrentStatus_787 1;
BA_ "SignalType" SG_ 3221225472 DTCI_CurrentStatus_787 "BLN";
BA_ "PacketOrder" SG_ 3221225472 DTCI_CurrentStatus_787 18;
BA_ "SignalLongName" SG_ 3221225472 DTCI_CurrentStatus_787 "Diagnostic Trouble Code Information Extended 787 : Current Status";
BA_ "VNSigAllNodes" SG_ 3221225472 DTCI_DTCFailType_787 1;
BA_ "SignalType" SG_ 3221225472 DTCI_DTCFailType_787 "UNM";
BA_ "PacketOrder" SG_ 3221225472 DTCI_DTCFailType_787 11;
BA_ "SignalLongName" SG_ 3221225472 DTCI_DTCFailType_787 "Diagnostic Trouble Code Information Extended 787 : Diagnostic Trouble Code Failure Type";
BA_ "VNSigAllNodes" SG_ 3221225472 DTCI_DTCFaultType_787 1;
BA_ "SignalType" SG_ 3221225472 DTCI_DTCFaultType_787 "ENM";
BA_ "PacketOrder" SG_ 3221225472 DTCI_DTCFaultType_787 20;
BA_ "SignalLongName" SG_ 3221225472 DTCI_DTCFaultType_787 "Diagnostic Trouble Code Information Extended 787 : Diagnostic Trouble Code Fault Type";
BA_ "VNSigAllNodes" SG_ 3221225472 DTCI_DTCNumber_787 1;
BA_ "SignalType" SG_ 3221225472 DTCI_DTCNumber_787 "UNM";
BA_ "PacketOrder" SG_ 3221225472 DTCI_DTCNumber_787 10;
BA_ "SignalLongName" SG_ 3221225472 DTCI_DTCNumber_787 "Diagnostic Trouble Code Information Extended 787 : Diagnostic Trouble Code Number";
BA_ "VNSigAllNodes" SG_ 3221225472 DTCI_DTCSource_787 1;
BA_ "SignalType" SG_ 3221225472 DTCI_DTCSource_787 "UNM";
BA_ "PacketOrder" SG_ 3221225472 DTCI_DTCSource_787 9;
BA_ "SignalLongName" SG_ 3221225472 DTCI_DTCSource_787 "Diagnostic Trouble Code Information Extended 787 : Diagnostic Trouble Code Source";
BA_ "VNSigAllNodes" SG_ 3221225472 DTCI_DTCTriggered_787 1;
BA_ "SignalType" SG_ 3221225472 DTCI_DTCTriggered_787 "BLN";
BA_ "PacketOrder" SG_ 3221225472 DTCI_DTCTriggered_787 8;
BA_ "SignalLongName" SG_ 3221225472 DTCI_DTCTriggered_787 "Diagnostic Trouble Code Information Extended 787 : Diagnostic Trouble Code Triggered";
BA_ "VNSigAllNodes" SG_ 3221225472 DTCI_HistStat_787 1;
BA_ "SignalType" SG_ 3221225472 DTCI_HistStat_787 "BLN";
BA_ "PacketOrder" SG_ 3221225472 DTCI_HistStat_787 15;
BA_ "SignalLongName" SG_ 3221225472 DTCI_HistStat_787 "Diagnostic Trouble Code Information Extended 787 : History Status";
BA_ "VNSigAllNodes" SG_ 3221225472 DTCI_TstFldCdClrdStat_787 1;
BA_ "SignalType" SG_ 3221225472 DTCI_TstFldCdClrdStat_787 "BLN";
BA_ "PacketOrder" SG_ 3221225472 DTCI_TstFldCdClrdStat_787 16;
BA_ "SignalLongName" SG_ 3221225472 DTCI_TstFldCdClrdStat_787 "Diagnostic Trouble Code Information Extended 787 : Test Failed Since Code Cleared Status";
BA_ "VNSigAllNodes" SG_ 3221225472 DTCI_TstFldPwrUpSt_787 1;
BA_ "SignalType" SG_ 3221225472 DTCI_TstFldPwrUpSt_787 "BLN";
BA_ "PacketOrder" SG_ 3221225472 DTCI_TstFldPwrUpSt_787 13;
BA_ "SignalLongName" SG_ 3221225472 DTCI_TstFldPwrUpSt_787 "Diagnostic Trouble Code Information Extended 787 : Test Failed Since Power Up Status";
BA_ "VNSigAllNodes" SG_ 3221225472 DTCI_TstNPsdCdClrdSt_787 1;
BA_ "SignalType" SG_ 3221225472 DTCI_TstNPsdCdClrdSt_787 "BLN";
BA_ "PacketOrder" SG_ 3221225472 DTCI_TstNPsdCdClrdSt_787 17;
BA_ "SignalLongName" SG_ 3221225472 DTCI_TstNPsdCdClrdSt_787 "Diagnostic Trouble Code Information Extended 787 : Test Not Passed Since Code Cleared Status";
BA_ "VNSigAllNodes" SG_ 3221225472 DTCI_TstNPsdPwrUpSt_787 1;
BA_ "SignalType" SG_ 3221225472 DTCI_TstNPsdPwrUpSt_787 "BLN";
BA_ "PacketOrder" SG_ 3221225472 DTCI_TstNPsdPwrUpSt_787 14;
BA_ "SignalLongName" SG_ 3221225472 DTCI_TstNPsdPwrUpSt_787 "Diagnostic Trouble Code Information Extended 787 : Test Not Passed Since Power Up Status";
BA_ "VNSigAllNodes" SG_ 3221225472 DTCIUnused1_787 1;
BA_ "SignalType" SG_ 3221225472 DTCIUnused1_787 "BLN";
BA_ "PacketOrder" SG_ 3221225472 DTCIUnused1_787 1;
BA_ "SignalLongName" SG_ 3221225472 DTCIUnused1_787 "Diagnostic Trouble Code Information Extended 787 : Unused 1";
BA_ "VNSigAllNodes" SG_ 3221225472 DTCI_HistStat_78E 1;
BA_ "SignalType" SG_ 3221225472 DTCI_HistStat_78E "BLN";
BA_ "PacketOrder" SG_ 3221225472 DTCI_HistStat_78E 15;
BA_ "SignalLongName" SG_ 3221225472 DTCI_HistStat_78E "Diagnostic Trouble Code Information Extended 78E : History Status";
BA_ "VNSigAllNodes" SG_ 3221225472 DTCI_TstFldCdClrdStat_78E 1;
BA_ "SignalType" SG_ 3221225472 DTCI_TstFldCdClrdStat_78E "BLN";
BA_ "PacketOrder" SG_ 3221225472 DTCI_TstFldCdClrdStat_78E 16;
BA_ "SignalLongName" SG_ 3221225472 DTCI_TstFldCdClrdStat_78E "Diagnostic Trouble Code Information Extended 78E : Test Failed Since Code Cleared Status";
BA_ "VNSigAllNodes" SG_ 3221225472 DTCI_TstFldPwrUpSt_78E 1;
BA_ "SignalType" SG_ 3221225472 DTCI_TstFldPwrUpSt_78E "BLN";
BA_ "PacketOrder" SG_ 3221225472 DTCI_TstFldPwrUpSt_78E 13;
BA_ "SignalLongName" SG_ 3221225472 DTCI_TstFldPwrUpSt_78E "Diagnostic Trouble Code Information Extended 78E : Test Failed Since Power Up Status";
BA_ "VNSigAllNodes" SG_ 3221225472 DTCI_TstNPsdCdClrdSt_78E 1;
BA_ "SignalType" SG_ 3221225472 DTCI_TstNPsdCdClrdSt_78E "BLN";
BA_ "PacketOrder" SG_ 3221225472 DTCI_TstNPsdCdClrdSt_78E 17;
BA_ "SignalLongName" SG_ 3221225472 DTCI_TstNPsdCdClrdSt_78E "Diagnostic Trouble Code Information Extended 78E : Test Not Passed Since Code Cleared Status";
BA_ "VNSigAllNodes" SG_ 3221225472 DTCI_TstNPsdPwrUpSt_78E 1;
BA_ "SignalType" SG_ 3221225472 DTCI_TstNPsdPwrUpSt_78E "BLN";
BA_ "PacketOrder" SG_ 3221225472 DTCI_TstNPsdPwrUpSt_78E 14;
BA_ "SignalLongName" SG_ 3221225472 DTCI_TstNPsdPwrUpSt_78E "Diagnostic Trouble Code Information Extended 78E : Test Not Passed Since Power Up Status";
BA_ "VNSigAllNodes" SG_ 3221225472 DTCIUnused1_78E 1;
BA_ "SignalType" SG_ 3221225472 DTCIUnused1_78E "BLN";
BA_ "PacketOrder" SG_ 3221225472 DTCIUnused1_78E 1;
BA_ "SignalLongName" SG_ 3221225472 DTCIUnused1_78E "Diagnostic Trouble Code Information Extended 78E : Unused 1";
BA_ "VNSigAllNodes" SG_ 3221225472 DTCIUnused2_78E 1;
BA_ "SignalType" SG_ 3221225472 DTCIUnused2_78E "BLN";
BA_ "PacketOrder" SG_ 3221225472 DTCIUnused2_78E 2;
BA_ "SignalLongName" SG_ 3221225472 DTCIUnused2_78E "Diagnostic Trouble Code Information Extended 78E : Unused 2";
BA_ "VNSigAllNodes" SG_ 3221225472 DTCIUnused3_78E 1;
BA_ "SignalType" SG_ 3221225472 DTCIUnused3_78E "BLN";
BA_ "PacketOrder" SG_ 3221225472 DTCIUnused3_78E 3;
BA_ "SignalLongName" SG_ 3221225472 DTCIUnused3_78E "Diagnostic Trouble Code Information Extended 78E : Unused 3";
BA_ "VNSigAllNodes" SG_ 3221225472 DTCIUnused4_78E 1;
BA_ "SignalType" SG_ 3221225472 DTCIUnused4_78E "BLN";
BA_ "PacketOrder" SG_ 3221225472 DTCIUnused4_78E 4;
BA_ "SignalLongName" SG_ 3221225472 DTCIUnused4_78E "Diagnostic Trouble Code Information Extended 78E : Unused 4";
BA_ "VNSigAllNodes" SG_ 3221225472 DTCIUnused5_78E 1;
BA_ "SignalType" SG_ 3221225472 DTCIUnused5_78E "BLN";
BA_ "PacketOrder" SG_ 3221225472 DTCIUnused5_78E 5;
BA_ "SignalLongName" SG_ 3221225472 DTCIUnused5_78E "Diagnostic Trouble Code Information Extended 78E : Unused 5";
BA_ "VNSigAllNodes" SG_ 3221225472 DTCIUnused6_78E 1;
BA_ "SignalType" SG_ 3221225472 DTCIUnused6_78E "BLN";
BA_ "PacketOrder" SG_ 3221225472 DTCIUnused6_78E 6;
BA_ "SignalLongName" SG_ 3221225472 DTCIUnused6_78E "Diagnostic Trouble Code Information Extended 78E : Unused 6";
BA_ "VNSigAllNodes" SG_ 3221225472 DTCIUnused7_78E 1;
BA_ "SignalType" SG_ 3221225472 DTCIUnused7_78E "BLN";
BA_ "PacketOrder" SG_ 3221225472 DTCIUnused7_78E 7;
BA_ "SignalLongName" SG_ 3221225472 DTCIUnused7_78E "Diagnostic Trouble Code Information Extended 78E : Unused 7";
BA_ "VNSigAllNodes" SG_ 3221225472 DTCI_WrnIndRqdSt_78E 1;
BA_ "SignalType" SG_ 3221225472 DTCI_WrnIndRqdSt_78E "BLN";
BA_ "PacketOrder" SG_ 3221225472 DTCI_WrnIndRqdSt_78E 12;
BA_ "SignalLongName" SG_ 3221225472 DTCI_WrnIndRqdSt_78E "Diagnostic Trouble Code Information Extended 78E : Warning Indicator Requested Status";
BA_ "VNSigAllNodes" SG_ 3221225472 DTCI_CodeSupported_78D 1;
BA_ "SignalType" SG_ 3221225472 DTCI_CodeSupported_78D "BLN";
BA_ "PacketOrder" SG_ 3221225472 DTCI_CodeSupported_78D 19;
BA_ "SignalLongName" SG_ 3221225472 DTCI_CodeSupported_78D "Diagnostic Trouble Code Information Extended 78D : Code Supported";
BA_ "VNSigAllNodes" SG_ 3221225472 DTCI_CurrentStatus_78D 1;
BA_ "SignalType" SG_ 3221225472 DTCI_CurrentStatus_78D "BLN";
BA_ "PacketOrder" SG_ 3221225472 DTCI_CurrentStatus_78D 18;
BA_ "SignalLongName" SG_ 3221225472 DTCI_CurrentStatus_78D "Diagnostic Trouble Code Information Extended 78D : Current Status";
BA_ "VNSigAllNodes" SG_ 3221225472 DTCI_DTCFailType_78D 1;
BA_ "SignalType" SG_ 3221225472 DTCI_DTCFailType_78D "UNM";
BA_ "PacketOrder" SG_ 3221225472 DTCI_DTCFailType_78D 11;
BA_ "SignalLongName" SG_ 3221225472 DTCI_DTCFailType_78D "Diagnostic Trouble Code Information Extended 78D : Diagnostic Trouble Code Failure Type";
BA_ "VNSigAllNodes" SG_ 3221225472 DTCI_DTCFaultType_78D 1;
BA_ "SignalType" SG_ 3221225472 DTCI_DTCFaultType_78D "ENM";
BA_ "PacketOrder" SG_ 3221225472 DTCI_DTCFaultType_78D 20;
BA_ "SignalLongName" SG_ 3221225472 DTCI_DTCFaultType_78D "Diagnostic Trouble Code Information Extended 78D : Diagnostic Trouble Code Fault Type";
BA_ "VNSigAllNodes" SG_ 3221225472 DTCI_DTCNumber_78D 1;
BA_ "SignalType" SG_ 3221225472 DTCI_DTCNumber_78D "UNM";
BA_ "PacketOrder" SG_ 3221225472 DTCI_DTCNumber_78D 10;
BA_ "SignalLongName" SG_ 3221225472 DTCI_DTCNumber_78D "Diagnostic Trouble Code Information Extended 78D : Diagnostic Trouble Code Number";
BA_ "VNSigAllNodes" SG_ 3221225472 DTCI_DTCSource_78D 1;
BA_ "SignalType" SG_ 3221225472 DTCI_DTCSource_78D "UNM";
BA_ "PacketOrder" SG_ 3221225472 DTCI_DTCSource_78D 9;
BA_ "SignalLongName" SG_ 3221225472 DTCI_DTCSource_78D "Diagnostic Trouble Code Information Extended 78D : Diagnostic Trouble Code Source";
BA_ "VNSigAllNodes" SG_ 3221225472 DTCI_DTCTriggered_78D 1;
BA_ "SignalType" SG_ 3221225472 DTCI_DTCTriggered_78D "BLN";
BA_ "PacketOrder" SG_ 3221225472 DTCI_DTCTriggered_78D 8;
BA_ "SignalLongName" SG_ 3221225472 DTCI_DTCTriggered_78D "Diagnostic Trouble Code Information Extended 78D : Diagnostic Trouble Code Triggered";
BA_ "VNSigAllNodes" SG_ 3221225472 DTCI_HistStat_78D 1;
BA_ "SignalType" SG_ 3221225472 DTCI_HistStat_78D "BLN";
BA_ "PacketOrder" SG_ 3221225472 DTCI_HistStat_78D 15;
BA_ "SignalLongName" SG_ 3221225472 DTCI_HistStat_78D "Diagnostic Trouble Code Information Extended 78D : History Status";
BA_ "VNSigAllNodes" SG_ 3221225472 DTCIUnused2_787 1;
BA_ "SignalType" SG_ 3221225472 DTCIUnused2_787 "BLN";
BA_ "PacketOrder" SG_ 3221225472 DTCIUnused2_787 2;
BA_ "SignalLongName" SG_ 3221225472 DTCIUnused2_787 "Diagnostic Trouble Code Information Extended 787 : Unused 2";
BA_ "VNSigAllNodes" SG_ 3221225472 DTCIUnused3_787 1;
BA_ "SignalType" SG_ 3221225472 DTCIUnused3_787 "BLN";
BA_ "PacketOrder" SG_ 3221225472 DTCIUnused3_787 3;
BA_ "SignalLongName" SG_ 3221225472 DTCIUnused3_787 "Diagnostic Trouble Code Information Extended 787 : Unused 3";
BA_ "VNSigAllNodes" SG_ 3221225472 DTCIUnused4_787 1;
BA_ "SignalType" SG_ 3221225472 DTCIUnused4_787 "BLN";
BA_ "PacketOrder" SG_ 3221225472 DTCIUnused4_787 4;
BA_ "SignalLongName" SG_ 3221225472 DTCIUnused4_787 "Diagnostic Trouble Code Information Extended 787 : Unused 4";
BA_ "VNSigAllNodes" SG_ 3221225472 DTCIUnused5_787 1;
BA_ "SignalType" SG_ 3221225472 DTCIUnused5_787 "BLN";
BA_ "PacketOrder" SG_ 3221225472 DTCIUnused5_787 5;
BA_ "SignalLongName" SG_ 3221225472 DTCIUnused5_787 "Diagnostic Trouble Code Information Extended 787 : Unused 5";
BA_ "VNSigAllNodes" SG_ 3221225472 DTCIUnused6_787 1;
BA_ "SignalType" SG_ 3221225472 DTCIUnused6_787 "BLN";
BA_ "PacketOrder" SG_ 3221225472 DTCIUnused6_787 6;
BA_ "SignalLongName" SG_ 3221225472 DTCIUnused6_787 "Diagnostic Trouble Code Information Extended 787 : Unused 6";
BA_ "VNSigAllNodes" SG_ 3221225472 DTCIUnused7_787 1;
BA_ "SignalType" SG_ 3221225472 DTCIUnused7_787 "BLN";
BA_ "PacketOrder" SG_ 3221225472 DTCIUnused7_787 7;
BA_ "SignalLongName" SG_ 3221225472 DTCIUnused7_787 "Diagnostic Trouble Code Information Extended 787 : Unused 7";
BA_ "VNSigAllNodes" SG_ 3221225472 DTCI_WrnIndRqdSt_787 1;
BA_ "SignalType" SG_ 3221225472 DTCI_WrnIndRqdSt_787 "BLN";
BA_ "PacketOrder" SG_ 3221225472 DTCI_WrnIndRqdSt_787 12;
BA_ "SignalLongName" SG_ 3221225472 DTCI_WrnIndRqdSt_787 "Diagnostic Trouble Code Information Extended 787 : Warning Indicator Requested Status";
BA_ "VNSigAllNodes" SG_ 3221225472 DTCI_CodeSupported_786 1;
BA_ "SignalType" SG_ 3221225472 DTCI_CodeSupported_786 "BLN";
BA_ "PacketOrder" SG_ 3221225472 DTCI_CodeSupported_786 19;
BA_ "SignalLongName" SG_ 3221225472 DTCI_CodeSupported_786 "Diagnostic Trouble Code Information Extended 786 : Code Supported";
BA_ "VNSigAllNodes" SG_ 3221225472 DTCI_CurrentStatus_786 1;
BA_ "SignalType" SG_ 3221225472 DTCI_CurrentStatus_786 "BLN";
BA_ "PacketOrder" SG_ 3221225472 DTCI_CurrentStatus_786 18;
BA_ "SignalLongName" SG_ 3221225472 DTCI_CurrentStatus_786 "Diagnostic Trouble Code Information Extended 786 : Current Status";
BA_ "VNSigAllNodes" SG_ 3221225472 DTCI_DTCFailType_786 1;
BA_ "SignalType" SG_ 3221225472 DTCI_DTCFailType_786 "UNM";
BA_ "PacketOrder" SG_ 3221225472 DTCI_DTCFailType_786 11;
BA_ "SignalLongName" SG_ 3221225472 DTCI_DTCFailType_786 "Diagnostic Trouble Code Information Extended 786 : Diagnostic Trouble Code Failure Type";
BA_ "VNSigAllNodes" SG_ 3221225472 DTCI_DTCFaultType_786 1;
BA_ "SignalType" SG_ 3221225472 DTCI_DTCFaultType_786 "ENM";
BA_ "PacketOrder" SG_ 3221225472 DTCI_DTCFaultType_786 20;
BA_ "SignalLongName" SG_ 3221225472 DTCI_DTCFaultType_786 "Diagnostic Trouble Code Information Extended 786 : Diagnostic Trouble Code Fault Type";
BA_ "VNSigAllNodes" SG_ 3221225472 DTCI_DTCNumber_786 1;
BA_ "SignalType" SG_ 3221225472 DTCI_DTCNumber_786 "UNM";
BA_ "PacketOrder" SG_ 3221225472 DTCI_DTCNumber_786 10;
BA_ "SignalLongName" SG_ 3221225472 DTCI_DTCNumber_786 "Diagnostic Trouble Code Information Extended 786 : Diagnostic Trouble Code Number";
BA_ "VNSigAllNodes" SG_ 3221225472 DTCI_DTCSource_786 1;
BA_ "SignalType" SG_ 3221225472 DTCI_DTCSource_786 "UNM";
BA_ "PacketOrder" SG_ 3221225472 DTCI_DTCSource_786 9;
BA_ "SignalLongName" SG_ 3221225472 DTCI_DTCSource_786 "Diagnostic Trouble Code Information Extended 786 : Diagnostic Trouble Code Source";
BA_ "VNSigAllNodes" SG_ 3221225472 DTCI_DTCTriggered_786 1;
BA_ "SignalType" SG_ 3221225472 DTCI_DTCTriggered_786 "BLN";
BA_ "PacketOrder" SG_ 3221225472 DTCI_DTCTriggered_786 8;
BA_ "SignalLongName" SG_ 3221225472 DTCI_DTCTriggered_786 "Diagnostic Trouble Code Information Extended 786 : Diagnostic Trouble Code Triggered";
BA_ "VNSigAllNodes" SG_ 3221225472 DTCI_HistStat_786 1;
BA_ "SignalType" SG_ 3221225472 DTCI_HistStat_786 "BLN";
BA_ "PacketOrder" SG_ 3221225472 DTCI_HistStat_786 15;
BA_ "SignalLongName" SG_ 3221225472 DTCI_HistStat_786 "Diagnostic Trouble Code Information Extended 786 : History Status";
BA_ "VNSigAllNodes" SG_ 3221225472 DTCI_TstFldCdClrdStat_786 1;
BA_ "SignalType" SG_ 3221225472 DTCI_TstFldCdClrdStat_786 "BLN";
BA_ "PacketOrder" SG_ 3221225472 DTCI_TstFldCdClrdStat_786 16;
BA_ "SignalLongName" SG_ 3221225472 DTCI_TstFldCdClrdStat_786 "Diagnostic Trouble Code Information Extended 786 : Test Failed Since Code Cleared Status";
BA_ "VNSigAllNodes" SG_ 3221225472 DTCI_TstFldPwrUpSt_786 1;
BA_ "SignalType" SG_ 3221225472 DTCI_TstFldPwrUpSt_786 "BLN";
BA_ "PacketOrder" SG_ 3221225472 DTCI_TstFldPwrUpSt_786 13;
BA_ "SignalLongName" SG_ 3221225472 DTCI_TstFldPwrUpSt_786 "Diagnostic Trouble Code Information Extended 786 : Test Failed Since Power Up Status";
BA_ "VNSigAllNodes" SG_ 3221225472 DTCI_TstNPsdCdClrdSt_786 1;
BA_ "SignalType" SG_ 3221225472 DTCI_TstNPsdCdClrdSt_786 "BLN";
BA_ "PacketOrder" SG_ 3221225472 DTCI_TstNPsdCdClrdSt_786 17;
BA_ "SignalLongName" SG_ 3221225472 DTCI_TstNPsdCdClrdSt_786 "Diagnostic Trouble Code Information Extended 786 : Test Not Passed Since Code Cleared Status";
BA_ "VNSigAllNodes" SG_ 3221225472 DTCI_TstNPsdPwrUpSt_786 1;
BA_ "SignalType" SG_ 3221225472 DTCI_TstNPsdPwrUpSt_786 "BLN";
BA_ "PacketOrder" SG_ 3221225472 DTCI_TstNPsdPwrUpSt_786 14;
BA_ "SignalLongName" SG_ 3221225472 DTCI_TstNPsdPwrUpSt_786 "Diagnostic Trouble Code Information Extended 786 : Test Not Passed Since Power Up Status";
BA_ "VNSigAllNodes" SG_ 3221225472 DTCIUnused1_786 1;
BA_ "SignalType" SG_ 3221225472 DTCIUnused1_786 "BLN";
BA_ "PacketOrder" SG_ 3221225472 DTCIUnused1_786 1;
BA_ "SignalLongName" SG_ 3221225472 DTCIUnused1_786 "Diagnostic Trouble Code Information Extended 786 : Unused 1";
BA_ "VNSigAllNodes" SG_ 3221225472 DTCIUnused2_786 1;
BA_ "SignalType" SG_ 3221225472 DTCIUnused2_786 "BLN";
BA_ "PacketOrder" SG_ 3221225472 DTCIUnused2_786 2;
BA_ "SignalLongName" SG_ 3221225472 DTCIUnused2_786 "Diagnostic Trouble Code Information Extended 786 : Unused 2";
BA_ "VNSigAllNodes" SG_ 3221225472 DTCIUnused3_786 1;
BA_ "SignalType" SG_ 3221225472 DTCIUnused3_786 "BLN";
BA_ "PacketOrder" SG_ 3221225472 DTCIUnused3_786 3;
BA_ "SignalLongName" SG_ 3221225472 DTCIUnused3_786 "Diagnostic Trouble Code Information Extended 786 : Unused 3";
BA_ "VNSigAllNodes" SG_ 3221225472 DTCIUnused4_786 1;
BA_ "SignalType" SG_ 3221225472 DTCIUnused4_786 "BLN";
BA_ "PacketOrder" SG_ 3221225472 DTCIUnused4_786 4;
BA_ "SignalLongName" SG_ 3221225472 DTCIUnused4_786 "Diagnostic Trouble Code Information Extended 786 : Unused 4";
BA_ "VNSigAllNodes" SG_ 3221225472 DTCIUnused5_786 1;
BA_ "SignalType" SG_ 3221225472 DTCIUnused5_786 "BLN";
BA_ "PacketOrder" SG_ 3221225472 DTCIUnused5_786 5;
BA_ "SignalLongName" SG_ 3221225472 DTCIUnused5_786 "Diagnostic Trouble Code Information Extended 786 : Unused 5";
BA_ "VNSigAllNodes" SG_ 3221225472 DTCIUnused6_786 1;
BA_ "SignalType" SG_ 3221225472 DTCIUnused6_786 "BLN";
BA_ "PacketOrder" SG_ 3221225472 DTCIUnused6_786 6;
BA_ "SignalLongName" SG_ 3221225472 DTCIUnused6_786 "Diagnostic Trouble Code Information Extended 786 : Unused 6";
BA_ "VNSigAllNodes" SG_ 3221225472 DTCIUnused7_786 1;
BA_ "SignalType" SG_ 3221225472 DTCIUnused7_786 "BLN";
BA_ "PacketOrder" SG_ 3221225472 DTCIUnused7_786 7;
BA_ "SignalLongName" SG_ 3221225472 DTCIUnused7_786 "Diagnostic Trouble Code Information Extended 786 : Unused 7";
BA_ "VNSigAllNodes" SG_ 3221225472 DTCI_WrnIndRqdSt_786 1;
BA_ "SignalType" SG_ 3221225472 DTCI_WrnIndRqdSt_786 "BLN";
BA_ "PacketOrder" SG_ 3221225472 DTCI_WrnIndRqdSt_786 12;
BA_ "SignalLongName" SG_ 3221225472 DTCI_WrnIndRqdSt_786 "Diagnostic Trouble Code Information Extended 786 : Warning Indicator Requested Status";
BA_ "VNSigAllNodes" SG_ 3221225472 DTCI_HistStat_784 1;
BA_ "SignalType" SG_ 3221225472 DTCI_HistStat_784 "BLN";
BA_ "PacketOrder" SG_ 3221225472 DTCI_HistStat_784 15;
BA_ "SignalLongName" SG_ 3221225472 DTCI_HistStat_784 "Diagnostic Trouble Code Information Extended 784 : History Status";
BA_ "VNSigAllNodes" SG_ 3221225472 DTCI_TstFldCdClrdStat_784 1;
BA_ "SignalType" SG_ 3221225472 DTCI_TstFldCdClrdStat_784 "BLN";
BA_ "PacketOrder" SG_ 3221225472 DTCI_TstFldCdClrdStat_784 16;
BA_ "SignalLongName" SG_ 3221225472 DTCI_TstFldCdClrdStat_784 "Diagnostic Trouble Code Information Extended 784 : Test Failed Since Code Cleared Status";
BA_ "VNSigAllNodes" SG_ 3221225472 DTCI_TstFldPwrUpSt_784 1;
BA_ "SignalType" SG_ 3221225472 DTCI_TstFldPwrUpSt_784 "BLN";
BA_ "PacketOrder" SG_ 3221225472 DTCI_TstFldPwrUpSt_784 13;
BA_ "SignalLongName" SG_ 3221225472 DTCI_TstFldPwrUpSt_784 "Diagnostic Trouble Code Information Extended 784 : Test Failed Since Power Up Status";
BA_ "VNSigAllNodes" SG_ 3221225472 DTCI_TstNPsdCdClrdSt_784 1;
BA_ "SignalType" SG_ 3221225472 DTCI_TstNPsdCdClrdSt_784 "BLN";
BA_ "PacketOrder" SG_ 3221225472 DTCI_TstNPsdCdClrdSt_784 17;
BA_ "SignalLongName" SG_ 3221225472 DTCI_TstNPsdCdClrdSt_784 "Diagnostic Trouble Code Information Extended 784 : Test Not Passed Since Code Cleared Status";
BA_ "VNSigAllNodes" SG_ 3221225472 DTCI_TstNPsdPwrUpSt_784 1;
BA_ "SignalType" SG_ 3221225472 DTCI_TstNPsdPwrUpSt_784 "BLN";
BA_ "PacketOrder" SG_ 3221225472 DTCI_TstNPsdPwrUpSt_784 14;
BA_ "SignalLongName" SG_ 3221225472 DTCI_TstNPsdPwrUpSt_784 "Diagnostic Trouble Code Information Extended 784 : Test Not Passed Since Power Up Status";
BA_ "VNSigAllNodes" SG_ 3221225472 DTCIUnused1_784 1;
BA_ "SignalType" SG_ 3221225472 DTCIUnused1_784 "BLN";
BA_ "PacketOrder" SG_ 3221225472 DTCIUnused1_784 1;
BA_ "SignalLongName" SG_ 3221225472 DTCIUnused1_784 "Diagnostic Trouble Code Information Extended 784 : Unused 1";
BA_ "VNSigAllNodes" SG_ 3221225472 DTCIUnused2_784 1;
BA_ "SignalType" SG_ 3221225472 DTCIUnused2_784 "BLN";
BA_ "PacketOrder" SG_ 3221225472 DTCIUnused2_784 2;
BA_ "SignalLongName" SG_ 3221225472 DTCIUnused2_784 "Diagnostic Trouble Code Information Extended 784 : Unused 2";
BA_ "VNSigAllNodes" SG_ 3221225472 DTCIUnused3_784 1;
BA_ "SignalType" SG_ 3221225472 DTCIUnused3_784 "BLN";
BA_ "PacketOrder" SG_ 3221225472 DTCIUnused3_784 3;
BA_ "SignalLongName" SG_ 3221225472 DTCIUnused3_784 "Diagnostic Trouble Code Information Extended 784 : Unused 3";
BA_ "VNSigAllNodes" SG_ 3221225472 DTCIUnused4_784 1;
BA_ "SignalType" SG_ 3221225472 DTCIUnused4_784 "BLN";
BA_ "PacketOrder" SG_ 3221225472 DTCIUnused4_784 4;
BA_ "SignalLongName" SG_ 3221225472 DTCIUnused4_784 "Diagnostic Trouble Code Information Extended 784 : Unused 4";
BA_ "VNSigAllNodes" SG_ 3221225472 DTCIUnused5_784 1;
BA_ "SignalType" SG_ 3221225472 DTCIUnused5_784 "BLN";
BA_ "PacketOrder" SG_ 3221225472 DTCIUnused5_784 5;
BA_ "SignalLongName" SG_ 3221225472 DTCIUnused5_784 "Diagnostic Trouble Code Information Extended 784 : Unused 5";
BA_ "VNSigAllNodes" SG_ 3221225472 DTCIUnused6_784 1;
BA_ "SignalType" SG_ 3221225472 DTCIUnused6_784 "BLN";
BA_ "PacketOrder" SG_ 3221225472 DTCIUnused6_784 6;
BA_ "SignalLongName" SG_ 3221225472 DTCIUnused6_784 "Diagnostic Trouble Code Information Extended 784 : Unused 6";
BA_ "VNSigAllNodes" SG_ 3221225472 DTCIUnused7_784 1;
BA_ "SignalType" SG_ 3221225472 DTCIUnused7_784 "BLN";
BA_ "PacketOrder" SG_ 3221225472 DTCIUnused7_784 7;
BA_ "SignalLongName" SG_ 3221225472 DTCIUnused7_784 "Diagnostic Trouble Code Information Extended 784 : Unused 7";
BA_ "VNSigAllNodes" SG_ 3221225472 DTCI_WrnIndRqdSt_784 1;
BA_ "SignalType" SG_ 3221225472 DTCI_WrnIndRqdSt_784 "BLN";
BA_ "PacketOrder" SG_ 3221225472 DTCI_WrnIndRqdSt_784 12;
BA_ "SignalLongName" SG_ 3221225472 DTCI_WrnIndRqdSt_784 "Diagnostic Trouble Code Information Extended 784 : Warning Indicator Requested Status";
BA_ "VNSigAllNodes" SG_ 3221225472 DTCI_CodeSupported_784 1;
BA_ "SignalType" SG_ 3221225472 DTCI_CodeSupported_784 "BLN";
BA_ "PacketOrder" SG_ 3221225472 DTCI_CodeSupported_784 19;
BA_ "SignalLongName" SG_ 3221225472 DTCI_CodeSupported_784 "Diagnostic Trouble Code Information Extended 784 : Code Supported";
BA_ "VNSigAllNodes" SG_ 3221225472 DTCI_CurrentStatus_784 1;
BA_ "SignalType" SG_ 3221225472 DTCI_CurrentStatus_784 "BLN";
BA_ "PacketOrder" SG_ 3221225472 DTCI_CurrentStatus_784 18;
BA_ "SignalLongName" SG_ 3221225472 DTCI_CurrentStatus_784 "Diagnostic Trouble Code Information Extended 784 : Current Status";
BA_ "VNSigAllNodes" SG_ 3221225472 DTCI_DTCFailType_784 1;
BA_ "SignalType" SG_ 3221225472 DTCI_DTCFailType_784 "UNM";
BA_ "PacketOrder" SG_ 3221225472 DTCI_DTCFailType_784 11;
BA_ "SignalLongName" SG_ 3221225472 DTCI_DTCFailType_784 "Diagnostic Trouble Code Information Extended 784 : Diagnostic Trouble Code Failure Type";
BA_ "VNSigAllNodes" SG_ 3221225472 DTCI_DTCFaultType_784 1;
BA_ "SignalType" SG_ 3221225472 DTCI_DTCFaultType_784 "ENM";
BA_ "PacketOrder" SG_ 3221225472 DTCI_DTCFaultType_784 20;
BA_ "SignalLongName" SG_ 3221225472 DTCI_DTCFaultType_784 "Diagnostic Trouble Code Information Extended 784 : Diagnostic Trouble Code Fault Type";
BA_ "VNSigAllNodes" SG_ 3221225472 DTCI_DTCFaultType_774 1;
BA_ "SignalType" SG_ 3221225472 DTCI_DTCFaultType_774 "ENM";
BA_ "PacketOrder" SG_ 3221225472 DTCI_DTCFaultType_774 20;
BA_ "SignalLongName" SG_ 3221225472 DTCI_DTCFaultType_774 "Diagnostic Trouble Code Information Extended 774 : Diagnostic Trouble Code Fault Type";
BA_ "VNSigAllNodes" SG_ 3221225472 DTCI_CodeSupported_774 1;
BA_ "SignalType" SG_ 3221225472 DTCI_CodeSupported_774 "BLN";
BA_ "PacketOrder" SG_ 3221225472 DTCI_CodeSupported_774 19;
BA_ "SignalLongName" SG_ 3221225472 DTCI_CodeSupported_774 "Diagnostic Trouble Code Information Extended 774 : Code Supported";
BA_ "VNSigAllNodes" SG_ 3221225472 DTCI_CurrentStatus_774 1;
BA_ "SignalType" SG_ 3221225472 DTCI_CurrentStatus_774 "BLN";
BA_ "PacketOrder" SG_ 3221225472 DTCI_CurrentStatus_774 18;
BA_ "SignalLongName" SG_ 3221225472 DTCI_CurrentStatus_774 "Diagnostic Trouble Code Information Extended 774 : Current Status";
BA_ "VNSigAllNodes" SG_ 3221225472 DTCI_TstNPsdCdClrdSt_774 1;
BA_ "SignalType" SG_ 3221225472 DTCI_TstNPsdCdClrdSt_774 "BLN";
BA_ "PacketOrder" SG_ 3221225472 DTCI_TstNPsdCdClrdSt_774 17;
BA_ "SignalLongName" SG_ 3221225472 DTCI_TstNPsdCdClrdSt_774 "Diagnostic Trouble Code Information Extended 774 : Test Not Passed Since Code Cleared Status";
BA_ "VNSigAllNodes" SG_ 3221225472 DTCI_TstFldCdClrdStat_774 1;
BA_ "SignalType" SG_ 3221225472 DTCI_TstFldCdClrdStat_774 "BLN";
BA_ "PacketOrder" SG_ 3221225472 DTCI_TstFldCdClrdStat_774 16;
BA_ "SignalLongName" SG_ 3221225472 DTCI_TstFldCdClrdStat_774 "Diagnostic Trouble Code Information Extended 774 : Test Failed Since Code Cleared Status";
BA_ "VNSigAllNodes" SG_ 3221225472 DTCI_HistStat_774 1;
BA_ "SignalType" SG_ 3221225472 DTCI_HistStat_774 "BLN";
BA_ "PacketOrder" SG_ 3221225472 DTCI_HistStat_774 15;
BA_ "SignalLongName" SG_ 3221225472 DTCI_HistStat_774 "Diagnostic Trouble Code Information Extended 774 : History Status";
BA_ "VNSigAllNodes" SG_ 3221225472 DTCI_TstNPsdPwrUpSt_774 1;
BA_ "SignalType" SG_ 3221225472 DTCI_TstNPsdPwrUpSt_774 "BLN";
BA_ "PacketOrder" SG_ 3221225472 DTCI_TstNPsdPwrUpSt_774 14;
BA_ "SignalLongName" SG_ 3221225472 DTCI_TstNPsdPwrUpSt_774 "Diagnostic Trouble Code Information Extended 774 : Test Not Passed Since Power Up Status";
BA_ "VNSigAllNodes" SG_ 3221225472 DTCI_TstFldPwrUpSt_774 1;
BA_ "SignalType" SG_ 3221225472 DTCI_TstFldPwrUpSt_774 "BLN";
BA_ "PacketOrder" SG_ 3221225472 DTCI_TstFldPwrUpSt_774 13;
BA_ "SignalLongName" SG_ 3221225472 DTCI_TstFldPwrUpSt_774 "Diagnostic Trouble Code Information Extended 774 : Test Failed Since Power Up Status";
BA_ "VNSigAllNodes" SG_ 3221225472 DTCI_WrnIndRqdSt_774 1;
BA_ "SignalType" SG_ 3221225472 DTCI_WrnIndRqdSt_774 "BLN";
BA_ "PacketOrder" SG_ 3221225472 DTCI_WrnIndRqdSt_774 12;
BA_ "SignalLongName" SG_ 3221225472 DTCI_WrnIndRqdSt_774 "Diagnostic Trouble Code Information Extended 774 : Warning Indicator Requested Status";
BA_ "VNSigAllNodes" SG_ 3221225472 DTCI_DTCFailType_774 1;
BA_ "SignalType" SG_ 3221225472 DTCI_DTCFailType_774 "UNM";
BA_ "PacketOrder" SG_ 3221225472 DTCI_DTCFailType_774 11;
BA_ "SignalLongName" SG_ 3221225472 DTCI_DTCFailType_774 "Diagnostic Trouble Code Information Extended 774 : Diagnostic Trouble Code Failure Type";
BA_ "VNSigAllNodes" SG_ 3221225472 DTCI_DTCNumber_774 1;
BA_ "SignalType" SG_ 3221225472 DTCI_DTCNumber_774 "UNM";
BA_ "PacketOrder" SG_ 3221225472 DTCI_DTCNumber_774 10;
BA_ "SignalLongName" SG_ 3221225472 DTCI_DTCNumber_774 "Diagnostic Trouble Code Information Extended 774 : Diagnostic Trouble Code Number";
BA_ "VNSigAllNodes" SG_ 3221225472 DTCI_DTCSource_774 1;
BA_ "SignalType" SG_ 3221225472 DTCI_DTCSource_774 "UNM";
BA_ "PacketOrder" SG_ 3221225472 DTCI_DTCSource_774 9;
BA_ "SignalLongName" SG_ 3221225472 DTCI_DTCSource_774 "Diagnostic Trouble Code Information Extended 774 : Diagnostic Trouble Code Source";
BA_ "VNSigAllNodes" SG_ 3221225472 DTCI_DTCTriggered_774 1;
BA_ "SignalType" SG_ 3221225472 DTCI_DTCTriggered_774 "BLN";
BA_ "PacketOrder" SG_ 3221225472 DTCI_DTCTriggered_774 8;
BA_ "SignalLongName" SG_ 3221225472 DTCI_DTCTriggered_774 "Diagnostic Trouble Code Information Extended 774 : Diagnostic Trouble Code Triggered";
BA_ "VNSigAllNodes" SG_ 3221225472 DTCIUnused7_774 1;
BA_ "SignalType" SG_ 3221225472 DTCIUnused7_774 "BLN";
BA_ "PacketOrder" SG_ 3221225472 DTCIUnused7_774 7;
BA_ "SignalLongName" SG_ 3221225472 DTCIUnused7_774 "Diagnostic Trouble Code Information Extended 774 : Unused 7";
BA_ "VNSigAllNodes" SG_ 3221225472 DTCIUnused6_774 1;
BA_ "SignalType" SG_ 3221225472 DTCIUnused6_774 "BLN";
BA_ "PacketOrder" SG_ 3221225472 DTCIUnused6_774 6;
BA_ "SignalLongName" SG_ 3221225472 DTCIUnused6_774 "Diagnostic Trouble Code Information Extended 774 : Unused 6";
BA_ "VNSigAllNodes" SG_ 3221225472 DTCIUnused5_774 1;
BA_ "SignalType" SG_ 3221225472 DTCIUnused5_774 "BLN";
BA_ "PacketOrder" SG_ 3221225472 DTCIUnused5_774 5;
BA_ "SignalLongName" SG_ 3221225472 DTCIUnused5_774 "Diagnostic Trouble Code Information Extended 774 : Unused 5";
BA_ "VNSigAllNodes" SG_ 3221225472 DTCIUnused4_774 1;
BA_ "SignalType" SG_ 3221225472 DTCIUnused4_774 "BLN";
BA_ "PacketOrder" SG_ 3221225472 DTCIUnused4_774 4;
BA_ "SignalLongName" SG_ 3221225472 DTCIUnused4_774 "Diagnostic Trouble Code Information Extended 774 : Unused 4";
BA_ "VNSigAllNodes" SG_ 3221225472 DTCIUnused3_774 1;
BA_ "SignalType" SG_ 3221225472 DTCIUnused3_774 "BLN";
BA_ "PacketOrder" SG_ 3221225472 DTCIUnused3_774 3;
BA_ "SignalLongName" SG_ 3221225472 DTCIUnused3_774 "Diagnostic Trouble Code Information Extended 774 : Unused 3";
BA_ "VNSigAllNodes" SG_ 3221225472 DTCIUnused2_774 1;
BA_ "SignalType" SG_ 3221225472 DTCIUnused2_774 "BLN";
BA_ "PacketOrder" SG_ 3221225472 DTCIUnused2_774 2;
BA_ "SignalLongName" SG_ 3221225472 DTCIUnused2_774 "Diagnostic Trouble Code Information Extended 774 : Unused 2";
BA_ "VNSigAllNodes" SG_ 3221225472 DTCIUnused1_774 1;
BA_ "SignalType" SG_ 3221225472 DTCIUnused1_774 "BLN";
BA_ "PacketOrder" SG_ 3221225472 DTCIUnused1_774 1;
BA_ "SignalLongName" SG_ 3221225472 DTCIUnused1_774 "Diagnostic Trouble Code Information Extended 774 : Unused 1";
BA_ "VNSigAllNodes" SG_ 3221225472 DTCI_DTCFaultType_779 1;
BA_ "SignalType" SG_ 3221225472 DTCI_DTCFaultType_779 "ENM";
BA_ "PacketOrder" SG_ 3221225472 DTCI_DTCFaultType_779 20;
BA_ "SignalLongName" SG_ 3221225472 DTCI_DTCFaultType_779 "Diagnostic Trouble Code Information Extended 779 : Diagnostic Trouble Code Fault Type";
BA_ "VNSigAllNodes" SG_ 3221225472 DTCI_CodeSupported_779 1;
BA_ "SignalType" SG_ 3221225472 DTCI_CodeSupported_779 "BLN";
BA_ "PacketOrder" SG_ 3221225472 DTCI_CodeSupported_779 19;
BA_ "SignalLongName" SG_ 3221225472 DTCI_CodeSupported_779 "Diagnostic Trouble Code Information Extended 779 : Code Supported";
BA_ "VNSigAllNodes" SG_ 3221225472 DTCI_CurrentStatus_779 1;
BA_ "SignalType" SG_ 3221225472 DTCI_CurrentStatus_779 "BLN";
BA_ "PacketOrder" SG_ 3221225472 DTCI_CurrentStatus_779 18;
BA_ "SignalLongName" SG_ 3221225472 DTCI_CurrentStatus_779 "Diagnostic Trouble Code Information Extended 779 : Current Status";
BA_ "VNSigAllNodes" SG_ 3221225472 DTCI_TstNPsdCdClrdSt_779 1;
BA_ "SignalType" SG_ 3221225472 DTCI_TstNPsdCdClrdSt_779 "BLN";
BA_ "PacketOrder" SG_ 3221225472 DTCI_TstNPsdCdClrdSt_779 17;
BA_ "SignalLongName" SG_ 3221225472 DTCI_TstNPsdCdClrdSt_779 "Diagnostic Trouble Code Information Extended 779 : Test Not Passed Since Code Cleared Status";
BA_ "VNSigAllNodes" SG_ 3221225472 DTCI_TstFldCdClrdStat_779 1;
BA_ "SignalType" SG_ 3221225472 DTCI_TstFldCdClrdStat_779 "BLN";
BA_ "PacketOrder" SG_ 3221225472 DTCI_TstFldCdClrdStat_779 16;
BA_ "SignalLongName" SG_ 3221225472 DTCI_TstFldCdClrdStat_779 "Diagnostic Trouble Code Information Extended 779 : Test Failed Since Code Cleared Status";
BA_ "VNSigAllNodes" SG_ 3221225472 DTCI_HistStat_779 1;
BA_ "SignalType" SG_ 3221225472 DTCI_HistStat_779 "BLN";
BA_ "PacketOrder" SG_ 3221225472 DTCI_HistStat_779 15;
BA_ "SignalLongName" SG_ 3221225472 DTCI_HistStat_779 "Diagnostic Trouble Code Information Extended 779 : History Status";
BA_ "VNSigAllNodes" SG_ 3221225472 DTCI_TstNPsdPwrUpSt_779 1;
BA_ "SignalType" SG_ 3221225472 DTCI_TstNPsdPwrUpSt_779 "BLN";
BA_ "PacketOrder" SG_ 3221225472 DTCI_TstNPsdPwrUpSt_779 14;
BA_ "SignalLongName" SG_ 3221225472 DTCI_TstNPsdPwrUpSt_779 "Diagnostic Trouble Code Information Extended 779 : Test Not Passed Since Power Up Status";
BA_ "VNSigAllNodes" SG_ 3221225472 DTCI_TstFldPwrUpSt_779 1;
BA_ "SignalType" SG_ 3221225472 DTCI_TstFldPwrUpSt_779 "BLN";
BA_ "PacketOrder" SG_ 3221225472 DTCI_TstFldPwrUpSt_779 13;
BA_ "SignalLongName" SG_ 3221225472 DTCI_TstFldPwrUpSt_779 "Diagnostic Trouble Code Information Extended 779 : Test Failed Since Power Up Status";
BA_ "VNSigAllNodes" SG_ 3221225472 DTCI_WrnIndRqdSt_779 1;
BA_ "SignalType" SG_ 3221225472 DTCI_WrnIndRqdSt_779 "BLN";
BA_ "PacketOrder" SG_ 3221225472 DTCI_WrnIndRqdSt_779 12;
BA_ "SignalLongName" SG_ 3221225472 DTCI_WrnIndRqdSt_779 "Diagnostic Trouble Code Information Extended 779 : Warning Indicator Requested Status";
BA_ "VNSigAllNodes" SG_ 3221225472 DTCI_DTCFailType_779 1;
BA_ "SignalType" SG_ 3221225472 DTCI_DTCFailType_779 "UNM";
BA_ "PacketOrder" SG_ 3221225472 DTCI_DTCFailType_779 11;
BA_ "SignalLongName" SG_ 3221225472 DTCI_DTCFailType_779 "Diagnostic Trouble Code Information Extended 779 : Diagnostic Trouble Code Failure Type";
BA_ "VNSigAllNodes" SG_ 3221225472 DTCI_DTCNumber_779 1;
BA_ "SignalType" SG_ 3221225472 DTCI_DTCNumber_779 "UNM";
BA_ "PacketOrder" SG_ 3221225472 DTCI_DTCNumber_779 10;
BA_ "SignalLongName" SG_ 3221225472 DTCI_DTCNumber_779 "Diagnostic Trouble Code Information Extended 779 : Diagnostic Trouble Code Number";
BA_ "VNSigAllNodes" SG_ 3221225472 DTCI_DTCSource_779 1;
BA_ "SignalType" SG_ 3221225472 DTCI_DTCSource_779 "UNM";
BA_ "PacketOrder" SG_ 3221225472 DTCI_DTCSource_779 9;
BA_ "SignalLongName" SG_ 3221225472 DTCI_DTCSource_779 "Diagnostic Trouble Code Information Extended 779 : Diagnostic Trouble Code Source";
BA_ "VNSigAllNodes" SG_ 3221225472 DTCI_DTCTriggered_779 1;
BA_ "SignalType" SG_ 3221225472 DTCI_DTCTriggered_779 "BLN";
BA_ "PacketOrder" SG_ 3221225472 DTCI_DTCTriggered_779 8;
BA_ "SignalLongName" SG_ 3221225472 DTCI_DTCTriggered_779 "Diagnostic Trouble Code Information Extended 779 : Diagnostic Trouble Code Triggered";
BA_ "VNSigAllNodes" SG_ 3221225472 DTCIUnused7_779 1;
BA_ "SignalType" SG_ 3221225472 DTCIUnused7_779 "BLN";
BA_ "PacketOrder" SG_ 3221225472 DTCIUnused7_779 7;
BA_ "SignalLongName" SG_ 3221225472 DTCIUnused7_779 "Diagnostic Trouble Code Information Extended 779 : Unused 7";
BA_ "VNSigAllNodes" SG_ 3221225472 DTCIUnused6_779 1;
BA_ "SignalType" SG_ 3221225472 DTCIUnused6_779 "BLN";
BA_ "PacketOrder" SG_ 3221225472 DTCIUnused6_779 6;
BA_ "SignalLongName" SG_ 3221225472 DTCIUnused6_779 "Diagnostic Trouble Code Information Extended 779 : Unused 6";
BA_ "VNSigAllNodes" SG_ 3221225472 DTCIUnused5_779 1;
BA_ "SignalType" SG_ 3221225472 DTCIUnused5_779 "BLN";
BA_ "PacketOrder" SG_ 3221225472 DTCIUnused5_779 5;
BA_ "SignalLongName" SG_ 3221225472 DTCIUnused5_779 "Diagnostic Trouble Code Information Extended 779 : Unused 5";
BA_ "VNSigAllNodes" SG_ 3221225472 DTCIUnused4_779 1;
BA_ "SignalType" SG_ 3221225472 DTCIUnused4_779 "BLN";
BA_ "PacketOrder" SG_ 3221225472 DTCIUnused4_779 4;
BA_ "SignalLongName" SG_ 3221225472 DTCIUnused4_779 "Diagnostic Trouble Code Information Extended 779 : Unused 4";
BA_ "VNSigAllNodes" SG_ 3221225472 DTCIUnused3_779 1;
BA_ "SignalType" SG_ 3221225472 DTCIUnused3_779 "BLN";
BA_ "PacketOrder" SG_ 3221225472 DTCIUnused3_779 3;
BA_ "SignalLongName" SG_ 3221225472 DTCIUnused3_779 "Diagnostic Trouble Code Information Extended 779 : Unused 3";
BA_ "VNSigAllNodes" SG_ 3221225472 DTCIUnused2_779 1;
BA_ "SignalType" SG_ 3221225472 DTCIUnused2_779 "BLN";
BA_ "PacketOrder" SG_ 3221225472 DTCIUnused2_779 2;
BA_ "SignalLongName" SG_ 3221225472 DTCIUnused2_779 "Diagnostic Trouble Code Information Extended 779 : Unused 2";
BA_ "VNSigAllNodes" SG_ 3221225472 DTCIUnused1_779 1;
BA_ "SignalType" SG_ 3221225472 DTCIUnused1_779 "BLN";
BA_ "PacketOrder" SG_ 3221225472 DTCIUnused1_779 1;
BA_ "SignalLongName" SG_ 3221225472 DTCIUnused1_779 "Diagnostic Trouble Code Information Extended 779 : Unused 1";
BA_ "VNSigAllNodes" SG_ 3221225472 DTCI_TstFldCdClrdStat_78D 1;
BA_ "SignalType" SG_ 3221225472 DTCI_TstFldCdClrdStat_78D "BLN";
BA_ "PacketOrder" SG_ 3221225472 DTCI_TstFldCdClrdStat_78D 16;
BA_ "SignalLongName" SG_ 3221225472 DTCI_TstFldCdClrdStat_78D "Diagnostic Trouble Code Information Extended 78D : Test Failed Since Code Cleared Status";
BA_ "VNSigAllNodes" SG_ 3221225472 DTCI_TstFldPwrUpSt_78D 1;
BA_ "SignalType" SG_ 3221225472 DTCI_TstFldPwrUpSt_78D "BLN";
BA_ "PacketOrder" SG_ 3221225472 DTCI_TstFldPwrUpSt_78D 13;
BA_ "SignalLongName" SG_ 3221225472 DTCI_TstFldPwrUpSt_78D "Diagnostic Trouble Code Information Extended 78D : Test Failed Since Power Up Status";
BA_ "VNSigAllNodes" SG_ 3221225472 DTCI_TstNPsdCdClrdSt_78D 1;
BA_ "SignalType" SG_ 3221225472 DTCI_TstNPsdCdClrdSt_78D "BLN";
BA_ "PacketOrder" SG_ 3221225472 DTCI_TstNPsdCdClrdSt_78D 17;
BA_ "SignalLongName" SG_ 3221225472 DTCI_TstNPsdCdClrdSt_78D "Diagnostic Trouble Code Information Extended 78D : Test Not Passed Since Code Cleared Status";
BA_ "VNSigAllNodes" SG_ 3221225472 DTCI_TstNPsdPwrUpSt_78D 1;
BA_ "SignalType" SG_ 3221225472 DTCI_TstNPsdPwrUpSt_78D "BLN";
BA_ "PacketOrder" SG_ 3221225472 DTCI_TstNPsdPwrUpSt_78D 14;
BA_ "SignalLongName" SG_ 3221225472 DTCI_TstNPsdPwrUpSt_78D "Diagnostic Trouble Code Information Extended 78D : Test Not Passed Since Power Up Status";
BA_ "VNSigAllNodes" SG_ 3221225472 DTCIUnused1_78D 1;
BA_ "SignalType" SG_ 3221225472 DTCIUnused1_78D "BLN";
BA_ "PacketOrder" SG_ 3221225472 DTCIUnused1_78D 1;
BA_ "SignalLongName" SG_ 3221225472 DTCIUnused1_78D "Diagnostic Trouble Code Information Extended 78D : Unused 1";
BA_ "VNSigAllNodes" SG_ 3221225472 DTCIUnused2_78D 1;
BA_ "SignalType" SG_ 3221225472 DTCIUnused2_78D "BLN";
BA_ "PacketOrder" SG_ 3221225472 DTCIUnused2_78D 2;
BA_ "SignalLongName" SG_ 3221225472 DTCIUnused2_78D "Diagnostic Trouble Code Information Extended 78D : Unused 2";
BA_ "VNSigAllNodes" SG_ 3221225472 DTCIUnused3_78D 1;
BA_ "SignalType" SG_ 3221225472 DTCIUnused3_78D "BLN";
BA_ "PacketOrder" SG_ 3221225472 DTCIUnused3_78D 3;
BA_ "SignalLongName" SG_ 3221225472 DTCIUnused3_78D "Diagnostic Trouble Code Information Extended 78D : Unused 3";
BA_ "VNSigAllNodes" SG_ 3221225472 DTCIUnused4_78D 1;
BA_ "SignalType" SG_ 3221225472 DTCIUnused4_78D "BLN";
BA_ "PacketOrder" SG_ 3221225472 DTCIUnused4_78D 4;
BA_ "SignalLongName" SG_ 3221225472 DTCIUnused4_78D "Diagnostic Trouble Code Information Extended 78D : Unused 4";
BA_ "VNSigAllNodes" SG_ 3221225472 DTCIUnused5_78D 1;
BA_ "SignalType" SG_ 3221225472 DTCIUnused5_78D "BLN";
BA_ "PacketOrder" SG_ 3221225472 DTCIUnused5_78D 5;
BA_ "SignalLongName" SG_ 3221225472 DTCIUnused5_78D "Diagnostic Trouble Code Information Extended 78D : Unused 5";
BA_ "VNSigAllNodes" SG_ 3221225472 DTCIUnused6_78D 1;
BA_ "SignalType" SG_ 3221225472 DTCIUnused6_78D "BLN";
BA_ "PacketOrder" SG_ 3221225472 DTCIUnused6_78D 6;
BA_ "SignalLongName" SG_ 3221225472 DTCIUnused6_78D "Diagnostic Trouble Code Information Extended 78D : Unused 6";
BA_ "VNSigAllNodes" SG_ 3221225472 DTCIUnused7_78D 1;
BA_ "SignalType" SG_ 3221225472 DTCIUnused7_78D "BLN";
BA_ "PacketOrder" SG_ 3221225472 DTCIUnused7_78D 7;
BA_ "SignalLongName" SG_ 3221225472 DTCIUnused7_78D "Diagnostic Trouble Code Information Extended 78D : Unused 7";
BA_ "VNSigAllNodes" SG_ 3221225472 DTCI_WrnIndRqdSt_78D 1;
BA_ "SignalType" SG_ 3221225472 DTCI_WrnIndRqdSt_78D "BLN";
BA_ "PacketOrder" SG_ 3221225472 DTCI_WrnIndRqdSt_78D 12;
BA_ "SignalLongName" SG_ 3221225472 DTCI_WrnIndRqdSt_78D "Diagnostic Trouble Code Information Extended 78D : Warning Indicator Requested Status";
BA_ "VNSigAllNodes" SG_ 3221225472 DTCI_CodeSupported_78C 1;
BA_ "SignalType" SG_ 3221225472 DTCI_CodeSupported_78C "BLN";
BA_ "PacketOrder" SG_ 3221225472 DTCI_CodeSupported_78C 19;
BA_ "SignalLongName" SG_ 3221225472 DTCI_CodeSupported_78C "Diagnostic Trouble Code Information Extended 78C : Code Supported";
BA_ "VNSigAllNodes" SG_ 3221225472 DTCI_CurrentStatus_78C 1;
BA_ "SignalType" SG_ 3221225472 DTCI_CurrentStatus_78C "BLN";
BA_ "PacketOrder" SG_ 3221225472 DTCI_CurrentStatus_78C 18;
BA_ "SignalLongName" SG_ 3221225472 DTCI_CurrentStatus_78C "Diagnostic Trouble Code Information Extended 78C : Current Status";
BA_ "VNSigAllNodes" SG_ 3221225472 DTCI_DTCFailType_78C 1;
BA_ "SignalType" SG_ 3221225472 DTCI_DTCFailType_78C "UNM";
BA_ "PacketOrder" SG_ 3221225472 DTCI_DTCFailType_78C 11;
BA_ "SignalLongName" SG_ 3221225472 DTCI_DTCFailType_78C "Diagnostic Trouble Code Information Extended 78C : Diagnostic Trouble Code Failure Type";
BA_ "VNSigAllNodes" SG_ 3221225472 DTCI_DTCFaultType_78C 1;
BA_ "SignalType" SG_ 3221225472 DTCI_DTCFaultType_78C "ENM";
BA_ "PacketOrder" SG_ 3221225472 DTCI_DTCFaultType_78C 20;
BA_ "SignalLongName" SG_ 3221225472 DTCI_DTCFaultType_78C "Diagnostic Trouble Code Information Extended 78C : Diagnostic Trouble Code Fault Type";
BA_ "VNSigAllNodes" SG_ 3221225472 DTCI_DTCNumber_78C 1;
BA_ "SignalType" SG_ 3221225472 DTCI_DTCNumber_78C "UNM";
BA_ "PacketOrder" SG_ 3221225472 DTCI_DTCNumber_78C 10;
BA_ "SignalLongName" SG_ 3221225472 DTCI_DTCNumber_78C "Diagnostic Trouble Code Information Extended 78C : Diagnostic Trouble Code Number";
BA_ "VNSigAllNodes" SG_ 3221225472 DTCI_DTCSource_78C 1;
BA_ "SignalType" SG_ 3221225472 DTCI_DTCSource_78C "UNM";
BA_ "PacketOrder" SG_ 3221225472 DTCI_DTCSource_78C 9;
BA_ "SignalLongName" SG_ 3221225472 DTCI_DTCSource_78C "Diagnostic Trouble Code Information Extended 78C : Diagnostic Trouble Code Source";
BA_ "VNSigAllNodes" SG_ 3221225472 DTCI_DTCTriggered_78C 1;
BA_ "SignalType" SG_ 3221225472 DTCI_DTCTriggered_78C "BLN";
BA_ "PacketOrder" SG_ 3221225472 DTCI_DTCTriggered_78C 8;
BA_ "SignalLongName" SG_ 3221225472 DTCI_DTCTriggered_78C "Diagnostic Trouble Code Information Extended 78C : Diagnostic Trouble Code Triggered";
BA_ "VNSigAllNodes" SG_ 3221225472 DTCI_HistStat_78C 1;
BA_ "SignalType" SG_ 3221225472 DTCI_HistStat_78C "BLN";
BA_ "PacketOrder" SG_ 3221225472 DTCI_HistStat_78C 15;
BA_ "SignalLongName" SG_ 3221225472 DTCI_HistStat_78C "Diagnostic Trouble Code Information Extended 78C : History Status";
BA_ "VNSigAllNodes" SG_ 3221225472 DTCI_TstFldCdClrdStat_78C 1;
BA_ "SignalType" SG_ 3221225472 DTCI_TstFldCdClrdStat_78C "BLN";
BA_ "PacketOrder" SG_ 3221225472 DTCI_TstFldCdClrdStat_78C 16;
BA_ "SignalLongName" SG_ 3221225472 DTCI_TstFldCdClrdStat_78C "Diagnostic Trouble Code Information Extended 78C : Test Failed Since Code Cleared Status";
BA_ "VNSigAllNodes" SG_ 3221225472 DTCI_DTCNumber_784 1;
BA_ "SignalType" SG_ 3221225472 DTCI_DTCNumber_784 "UNM";
BA_ "PacketOrder" SG_ 3221225472 DTCI_DTCNumber_784 10;
BA_ "SignalLongName" SG_ 3221225472 DTCI_DTCNumber_784 "Diagnostic Trouble Code Information Extended 784 : Diagnostic Trouble Code Number";
BA_ "VNSigAllNodes" SG_ 3221225472 DTCI_DTCSource_784 1;
BA_ "SignalType" SG_ 3221225472 DTCI_DTCSource_784 "UNM";
BA_ "PacketOrder" SG_ 3221225472 DTCI_DTCSource_784 9;
BA_ "SignalLongName" SG_ 3221225472 DTCI_DTCSource_784 "Diagnostic Trouble Code Information Extended 784 : Diagnostic Trouble Code Source";
BA_ "VNSigAllNodes" SG_ 3221225472 DTCI_DTCTriggered_784 1;
BA_ "SignalType" SG_ 3221225472 DTCI_DTCTriggered_784 "BLN";
BA_ "PacketOrder" SG_ 3221225472 DTCI_DTCTriggered_784 8;
BA_ "SignalLongName" SG_ 3221225472 DTCI_DTCTriggered_784 "Diagnostic Trouble Code Information Extended 784 : Diagnostic Trouble Code Triggered";
BA_ "VNSigSLHSSharedDiagnostic" SG_ 3221225472 DgnInf_HS55D 1;
BA_ "VNSigAllNodes" SG_ 3221225472 DgnInf_HS55D 1;
BA_ "SignalType" SG_ 3221225472 DgnInf_HS55D "UNM";
BA_ "SignalLongName" SG_ 3221225472 DgnInf_HS55D "Diagnostic Information HS55D";
BA_ "VNSigSLHSSharedDiagnostic" SG_ 3221225472 DgnInf_HS55A 1;
BA_ "VNSigAllNodes" SG_ 3221225472 DgnInf_HS55A 1;
BA_ "SignalType" SG_ 3221225472 DgnInf_HS55A "UNM";
BA_ "SignalLongName" SG_ 3221225472 DgnInf_HS55A "Diagnostic Information HS55A";
BA_ "VNSigSLHSSharedDiagnostic" SG_ 3221225472 DgnInf_HS558 1;
BA_ "VNSigAllNodes" SG_ 3221225472 DgnInf_HS558 1;
BA_ "SignalType" SG_ 3221225472 DgnInf_HS558 "UNM";
BA_ "SignalLongName" SG_ 3221225472 DgnInf_HS558 "Diagnostic Information HS558";
BA_ "VNSigSLHSSharedDiagnostic" SG_ 3221225472 DgnInf_HS551 1;
BA_ "VNSigAllNodes" SG_ 3221225472 DgnInf_HS551 1;
BA_ "SignalType" SG_ 3221225472 DgnInf_HS551 "UNM";
BA_ "SignalLongName" SG_ 3221225472 DgnInf_HS551 "Diagnostic Information HS551";
BA_ "VNSigSLHSSharedDiagnostic" SG_ 3221225472 DgnInf_HS555 1;
BA_ "VNSigAllNodes" SG_ 3221225472 DgnInf_HS555 1;
BA_ "SignalType" SG_ 3221225472 DgnInf_HS555 "UNM";
BA_ "SignalLongName" SG_ 3221225472 DgnInf_HS555 "Diagnostic Information HS555";
BA_ "VNSigSLHSSharedDiagnostic" SG_ 3221225472 DgnInf_HS559 1;
BA_ "VNSigAllNodes" SG_ 3221225472 DgnInf_HS559 1;
BA_ "SignalType" SG_ 3221225472 DgnInf_HS559 "UNM";
BA_ "SignalLongName" SG_ 3221225472 DgnInf_HS559 "Diagnostic Information HS559";
BA_ "VNSigSLHSSharedDiagnostic" SG_ 3221225472 DgnInf_HS550 1;
BA_ "VNSigAllNodes" SG_ 3221225472 DgnInf_HS550 1;
BA_ "SignalType" SG_ 3221225472 DgnInf_HS550 "UNM";
BA_ "SignalLongName" SG_ 3221225472 DgnInf_HS550 "Diagnostic Information HS550";
BA_ "VNSigSLHSSharedDiagnostic" SG_ 3221225472 DgnInf_HS544 1;
BA_ "VNSigAllNodes" SG_ 3221225472 DgnInf_HS544 1;
BA_ "SignalType" SG_ 3221225472 DgnInf_HS544 "UNM";
BA_ "SignalLongName" SG_ 3221225472 DgnInf_HS544 "Diagnostic Information HS544";
BA_ "VNSigSLHSSharedDiagnostic" SG_ 3221225472 DgnInf_HS548 1;
BA_ "VNSigAllNodes" SG_ 3221225472 DgnInf_HS548 1;
BA_ "SignalType" SG_ 3221225472 DgnInf_HS548 "UNM";
BA_ "SignalLongName" SG_ 3221225472 DgnInf_HS548 "Diagnostic Information HS548";
BA_ "VNSigSLHSSharedDiagnostic" SG_ 3221225472 DgnInf_HS557 1;
BA_ "VNSigAllNodes" SG_ 3221225472 DgnInf_HS557 1;
BA_ "SignalType" SG_ 3221225472 DgnInf_HS557 "UNM";
BA_ "SignalLongName" SG_ 3221225472 DgnInf_HS557 "Diagnostic Information HS557";
BA_ "VNSigAllNodes" SG_ 3221225472 DTCI_DTCFaultType_775 1;
BA_ "SignalType" SG_ 3221225472 DTCI_DTCFaultType_775 "ENM";
BA_ "PacketOrder" SG_ 3221225472 DTCI_DTCFaultType_775 20;
BA_ "SignalLongName" SG_ 3221225472 DTCI_DTCFaultType_775 "Diagnostic Trouble Code Information Extended 775 : Diagnostic Trouble Code Fault Type";
BA_ "VNSigAllNodes" SG_ 3221225472 DTCI_CodeSupported_775 1;
BA_ "SignalType" SG_ 3221225472 DTCI_CodeSupported_775 "BLN";
BA_ "PacketOrder" SG_ 3221225472 DTCI_CodeSupported_775 19;
BA_ "SignalLongName" SG_ 3221225472 DTCI_CodeSupported_775 "Diagnostic Trouble Code Information Extended 775 : Code Supported";
BA_ "VNSigAllNodes" SG_ 3221225472 DTCI_CurrentStatus_775 1;
BA_ "SignalType" SG_ 3221225472 DTCI_CurrentStatus_775 "BLN";
BA_ "PacketOrder" SG_ 3221225472 DTCI_CurrentStatus_775 18;
BA_ "SignalLongName" SG_ 3221225472 DTCI_CurrentStatus_775 "Diagnostic Trouble Code Information Extended 775 : Current Status";
BA_ "VNSigAllNodes" SG_ 3221225472 DTCI_TstNPsdCdClrdSt_775 1;
BA_ "SignalType" SG_ 3221225472 DTCI_TstNPsdCdClrdSt_775 "BLN";
BA_ "PacketOrder" SG_ 3221225472 DTCI_TstNPsdCdClrdSt_775 17;
BA_ "SignalLongName" SG_ 3221225472 DTCI_TstNPsdCdClrdSt_775 "Diagnostic Trouble Code Information Extended 775 : Test Not Passed Since Code Cleared Status";
BA_ "VNSigAllNodes" SG_ 3221225472 DTCI_TstFldCdClrdStat_775 1;
BA_ "SignalType" SG_ 3221225472 DTCI_TstFldCdClrdStat_775 "BLN";
BA_ "PacketOrder" SG_ 3221225472 DTCI_TstFldCdClrdStat_775 16;
BA_ "SignalLongName" SG_ 3221225472 DTCI_TstFldCdClrdStat_775 "Diagnostic Trouble Code Information Extended 775 : Test Failed Since Code Cleared Status";
BA_ "VNSigAllNodes" SG_ 3221225472 DTCI_HistStat_775 1;
BA_ "SignalType" SG_ 3221225472 DTCI_HistStat_775 "BLN";
BA_ "PacketOrder" SG_ 3221225472 DTCI_HistStat_775 15;
BA_ "SignalLongName" SG_ 3221225472 DTCI_HistStat_775 "Diagnostic Trouble Code Information Extended 775 : History Status";
BA_ "VNSigAllNodes" SG_ 3221225472 DTCI_TstNPsdPwrUpSt_775 1;
BA_ "SignalType" SG_ 3221225472 DTCI_TstNPsdPwrUpSt_775 "BLN";
BA_ "PacketOrder" SG_ 3221225472 DTCI_TstNPsdPwrUpSt_775 14;
BA_ "SignalLongName" SG_ 3221225472 DTCI_TstNPsdPwrUpSt_775 "Diagnostic Trouble Code Information Extended 775 : Test Not Passed Since Power Up Status";
BA_ "VNSigAllNodes" SG_ 3221225472 DTCI_TstFldPwrUpSt_775 1;
BA_ "SignalType" SG_ 3221225472 DTCI_TstFldPwrUpSt_775 "BLN";
BA_ "PacketOrder" SG_ 3221225472 DTCI_TstFldPwrUpSt_775 13;
BA_ "SignalLongName" SG_ 3221225472 DTCI_TstFldPwrUpSt_775 "Diagnostic Trouble Code Information Extended 775 : Test Failed Since Power Up Status";
BA_ "VNSigAllNodes" SG_ 3221225472 DTCI_WrnIndRqdSt_775 1;
BA_ "SignalType" SG_ 3221225472 DTCI_WrnIndRqdSt_775 "BLN";
BA_ "PacketOrder" SG_ 3221225472 DTCI_WrnIndRqdSt_775 12;
BA_ "SignalLongName" SG_ 3221225472 DTCI_WrnIndRqdSt_775 "Diagnostic Trouble Code Information Extended 775 : Warning Indicator Requested Status";
BA_ "VNSigAllNodes" SG_ 3221225472 DTCI_DTCFailType_775 1;
BA_ "SignalType" SG_ 3221225472 DTCI_DTCFailType_775 "UNM";
BA_ "PacketOrder" SG_ 3221225472 DTCI_DTCFailType_775 11;
BA_ "SignalLongName" SG_ 3221225472 DTCI_DTCFailType_775 "Diagnostic Trouble Code Information Extended 775 : Diagnostic Trouble Code Failure Type";
BA_ "VNSigAllNodes" SG_ 3221225472 DTCI_DTCNumber_775 1;
BA_ "SignalType" SG_ 3221225472 DTCI_DTCNumber_775 "UNM";
BA_ "PacketOrder" SG_ 3221225472 DTCI_DTCNumber_775 10;
BA_ "SignalLongName" SG_ 3221225472 DTCI_DTCNumber_775 "Diagnostic Trouble Code Information Extended 775 : Diagnostic Trouble Code Number";
BA_ "VNSigAllNodes" SG_ 3221225472 DTCI_DTCSource_775 1;
BA_ "SignalType" SG_ 3221225472 DTCI_DTCSource_775 "UNM";
BA_ "PacketOrder" SG_ 3221225472 DTCI_DTCSource_775 9;
BA_ "SignalLongName" SG_ 3221225472 DTCI_DTCSource_775 "Diagnostic Trouble Code Information Extended 775 : Diagnostic Trouble Code Source";
BA_ "VNSigAllNodes" SG_ 3221225472 DTCI_DTCTriggered_775 1;
BA_ "SignalType" SG_ 3221225472 DTCI_DTCTriggered_775 "BLN";
BA_ "PacketOrder" SG_ 3221225472 DTCI_DTCTriggered_775 8;
BA_ "SignalLongName" SG_ 3221225472 DTCI_DTCTriggered_775 "Diagnostic Trouble Code Information Extended 775 : Diagnostic Trouble Code Triggered";
BA_ "VNSigAllNodes" SG_ 3221225472 DTCIUnused7_775 1;
BA_ "SignalType" SG_ 3221225472 DTCIUnused7_775 "BLN";
BA_ "PacketOrder" SG_ 3221225472 DTCIUnused7_775 7;
BA_ "SignalLongName" SG_ 3221225472 DTCIUnused7_775 "Diagnostic Trouble Code Information Extended 775 : Unused 7";
BA_ "VNSigAllNodes" SG_ 3221225472 DTCIUnused6_775 1;
BA_ "SignalType" SG_ 3221225472 DTCIUnused6_775 "BLN";
BA_ "PacketOrder" SG_ 3221225472 DTCIUnused6_775 6;
BA_ "SignalLongName" SG_ 3221225472 DTCIUnused6_775 "Diagnostic Trouble Code Information Extended 775 : Unused 6";
BA_ "VNSigAllNodes" SG_ 3221225472 DTCIUnused5_775 1;
BA_ "SignalType" SG_ 3221225472 DTCIUnused5_775 "BLN";
BA_ "PacketOrder" SG_ 3221225472 DTCIUnused5_775 5;
BA_ "SignalLongName" SG_ 3221225472 DTCIUnused5_775 "Diagnostic Trouble Code Information Extended 775 : Unused 5";
BA_ "VNSigAllNodes" SG_ 3221225472 DTCIUnused4_775 1;
BA_ "SignalType" SG_ 3221225472 DTCIUnused4_775 "BLN";
BA_ "PacketOrder" SG_ 3221225472 DTCIUnused4_775 4;
BA_ "SignalLongName" SG_ 3221225472 DTCIUnused4_775 "Diagnostic Trouble Code Information Extended 775 : Unused 4";
BA_ "VNSigAllNodes" SG_ 3221225472 DTCIUnused3_775 1;
BA_ "SignalType" SG_ 3221225472 DTCIUnused3_775 "BLN";
BA_ "PacketOrder" SG_ 3221225472 DTCIUnused3_775 3;
BA_ "SignalLongName" SG_ 3221225472 DTCIUnused3_775 "Diagnostic Trouble Code Information Extended 775 : Unused 3";
BA_ "VNSigAllNodes" SG_ 3221225472 DTCIUnused2_775 1;
BA_ "SignalType" SG_ 3221225472 DTCIUnused2_775 "BLN";
BA_ "PacketOrder" SG_ 3221225472 DTCIUnused2_775 2;
BA_ "SignalLongName" SG_ 3221225472 DTCIUnused2_775 "Diagnostic Trouble Code Information Extended 775 : Unused 2";
BA_ "VNSigAllNodes" SG_ 3221225472 DTCIUnused1_775 1;
BA_ "SignalType" SG_ 3221225472 DTCIUnused1_775 "BLN";
BA_ "PacketOrder" SG_ 3221225472 DTCIUnused1_775 1;
BA_ "SignalLongName" SG_ 3221225472 DTCIUnused1_775 "Diagnostic Trouble Code Information Extended 775 : Unused 1";
BA_ "VNSigAllNodes" SG_ 3221225472 DTCI_HistStat_783 1;
BA_ "SignalType" SG_ 3221225472 DTCI_HistStat_783 "BLN";
BA_ "PacketOrder" SG_ 3221225472 DTCI_HistStat_783 15;
BA_ "SignalLongName" SG_ 3221225472 DTCI_HistStat_783 "Diagnostic Trouble Code Information Extended 783 : History Status";
BA_ "VNSigAllNodes" SG_ 3221225472 DTCI_DTCTriggered_783 1;
BA_ "SignalType" SG_ 3221225472 DTCI_DTCTriggered_783 "BLN";
BA_ "PacketOrder" SG_ 3221225472 DTCI_DTCTriggered_783 8;
BA_ "SignalLongName" SG_ 3221225472 DTCI_DTCTriggered_783 "Diagnostic Trouble Code Information Extended 783 : Diagnostic Trouble Code Triggered";
BA_ "VNSigAllNodes" SG_ 3221225472 DTCI_DTCSource_783 1;
BA_ "SignalType" SG_ 3221225472 DTCI_DTCSource_783 "UNM";
BA_ "PacketOrder" SG_ 3221225472 DTCI_DTCSource_783 9;
BA_ "SignalLongName" SG_ 3221225472 DTCI_DTCSource_783 "Diagnostic Trouble Code Information Extended 783 : Diagnostic Trouble Code Source";
BA_ "VNSigAllNodes" SG_ 3221225472 DTCI_DTCNumber_783 1;
BA_ "SignalType" SG_ 3221225472 DTCI_DTCNumber_783 "UNM";
BA_ "PacketOrder" SG_ 3221225472 DTCI_DTCNumber_783 10;
BA_ "SignalLongName" SG_ 3221225472 DTCI_DTCNumber_783 "Diagnostic Trouble Code Information Extended 783 : Diagnostic Trouble Code Number";
BA_ "VNSigAllNodes" SG_ 3221225472 DTCI_DTCFaultType_783 1;
BA_ "SignalType" SG_ 3221225472 DTCI_DTCFaultType_783 "ENM";
BA_ "PacketOrder" SG_ 3221225472 DTCI_DTCFaultType_783 20;
BA_ "SignalLongName" SG_ 3221225472 DTCI_DTCFaultType_783 "Diagnostic Trouble Code Information Extended 783 : Diagnostic Trouble Code Fault Type";
BA_ "VNSigAllNodes" SG_ 3221225472 DTCI_DTCFailType_783 1;
BA_ "SignalType" SG_ 3221225472 DTCI_DTCFailType_783 "UNM";
BA_ "PacketOrder" SG_ 3221225472 DTCI_DTCFailType_783 11;
BA_ "SignalLongName" SG_ 3221225472 DTCI_DTCFailType_783 "Diagnostic Trouble Code Information Extended 783 : Diagnostic Trouble Code Failure Type";
BA_ "VNSigAllNodes" SG_ 3221225472 DTCI_CurrentStatus_783 1;
BA_ "SignalType" SG_ 3221225472 DTCI_CurrentStatus_783 "BLN";
BA_ "PacketOrder" SG_ 3221225472 DTCI_CurrentStatus_783 18;
BA_ "SignalLongName" SG_ 3221225472 DTCI_CurrentStatus_783 "Diagnostic Trouble Code Information Extended 783 : Current Status";
BA_ "VNSigAllNodes" SG_ 3221225472 DTCI_CodeSupported_783 1;
BA_ "SignalType" SG_ 3221225472 DTCI_CodeSupported_783 "BLN";
BA_ "PacketOrder" SG_ 3221225472 DTCI_CodeSupported_783 19;
BA_ "SignalLongName" SG_ 3221225472 DTCI_CodeSupported_783 "Diagnostic Trouble Code Information Extended 783 : Code Supported";
BA_ "VNSigAllNodes" SG_ 3221225472 DTCIUnused7_783 1;
BA_ "SignalType" SG_ 3221225472 DTCIUnused7_783 "BLN";
BA_ "PacketOrder" SG_ 3221225472 DTCIUnused7_783 7;
BA_ "SignalLongName" SG_ 3221225472 DTCIUnused7_783 "Diagnostic Trouble Code Information Extended 783 : Unused 7";
BA_ "VNSigAllNodes" SG_ 3221225472 DTCIUnused6_783 1;
BA_ "SignalType" SG_ 3221225472 DTCIUnused6_783 "BLN";
BA_ "PacketOrder" SG_ 3221225472 DTCIUnused6_783 6;
BA_ "SignalLongName" SG_ 3221225472 DTCIUnused6_783 "Diagnostic Trouble Code Information Extended 783 : Unused 6";
BA_ "VNSigAllNodes" SG_ 3221225472 DTCIUnused5_783 1;
BA_ "SignalType" SG_ 3221225472 DTCIUnused5_783 "BLN";
BA_ "PacketOrder" SG_ 3221225472 DTCIUnused5_783 5;
BA_ "SignalLongName" SG_ 3221225472 DTCIUnused5_783 "Diagnostic Trouble Code Information Extended 783 : Unused 5";
BA_ "VNSigAllNodes" SG_ 3221225472 DTCIUnused4_783 1;
BA_ "SignalType" SG_ 3221225472 DTCIUnused4_783 "BLN";
BA_ "PacketOrder" SG_ 3221225472 DTCIUnused4_783 4;
BA_ "SignalLongName" SG_ 3221225472 DTCIUnused4_783 "Diagnostic Trouble Code Information Extended 783 : Unused 4";
BA_ "VNSigAllNodes" SG_ 3221225472 DTCIUnused3_783 1;
BA_ "SignalType" SG_ 3221225472 DTCIUnused3_783 "BLN";
BA_ "PacketOrder" SG_ 3221225472 DTCIUnused3_783 3;
BA_ "SignalLongName" SG_ 3221225472 DTCIUnused3_783 "Diagnostic Trouble Code Information Extended 783 : Unused 3";
BA_ "VNSigAllNodes" SG_ 3221225472 DTCIUnused2_783 1;
BA_ "SignalType" SG_ 3221225472 DTCIUnused2_783 "BLN";
BA_ "PacketOrder" SG_ 3221225472 DTCIUnused2_783 2;
BA_ "SignalLongName" SG_ 3221225472 DTCIUnused2_783 "Diagnostic Trouble Code Information Extended 783 : Unused 2";
BA_ "VNSigAllNodes" SG_ 3221225472 DTCIUnused1_783 1;
BA_ "SignalType" SG_ 3221225472 DTCIUnused1_783 "BLN";
BA_ "PacketOrder" SG_ 3221225472 DTCIUnused1_783 1;
BA_ "SignalLongName" SG_ 3221225472 DTCIUnused1_783 "Diagnostic Trouble Code Information Extended 783 : Unused 1";
BA_ "VNSigSLHSSharedDiagnostic" SG_ 3221225472 DgnInf_HS545 1;
BA_ "VNSigAllNodes" SG_ 3221225472 DgnInf_HS545 1;
BA_ "SignalType" SG_ 3221225472 DgnInf_HS545 "UNM";
BA_ "SignalLongName" SG_ 3221225472 DgnInf_HS545 "Diagnostic Information HS545";
BA_ "VNSigAllNodes" SG_ 3221225472 DTCI_WrnIndRqdSt_783 1;
BA_ "SignalType" SG_ 3221225472 DTCI_WrnIndRqdSt_783 "BLN";
BA_ "PacketOrder" SG_ 3221225472 DTCI_WrnIndRqdSt_783 12;
BA_ "SignalLongName" SG_ 3221225472 DTCI_WrnIndRqdSt_783 "Diagnostic Trouble Code Information Extended 783 : Warning Indicator Requested Status";
BA_ "VNSigAllNodes" SG_ 3221225472 DTCI_TstNPsdPwrUpSt_783 1;
BA_ "SignalType" SG_ 3221225472 DTCI_TstNPsdPwrUpSt_783 "BLN";
BA_ "PacketOrder" SG_ 3221225472 DTCI_TstNPsdPwrUpSt_783 14;
BA_ "SignalLongName" SG_ 3221225472 DTCI_TstNPsdPwrUpSt_783 "Diagnostic Trouble Code Information Extended 783 : Test Not Passed Since Power Up Status";
BA_ "VNSigAllNodes" SG_ 3221225472 DTCI_TstNPsdCdClrdSt_783 1;
BA_ "SignalType" SG_ 3221225472 DTCI_TstNPsdCdClrdSt_783 "BLN";
BA_ "PacketOrder" SG_ 3221225472 DTCI_TstNPsdCdClrdSt_783 17;
BA_ "SignalLongName" SG_ 3221225472 DTCI_TstNPsdCdClrdSt_783 "Diagnostic Trouble Code Information Extended 783 : Test Not Passed Since Code Cleared Status";
BA_ "VNSigAllNodes" SG_ 3221225472 DTCI_TstFldPwrUpSt_783 1;
BA_ "SignalType" SG_ 3221225472 DTCI_TstFldPwrUpSt_783 "BLN";
BA_ "PacketOrder" SG_ 3221225472 DTCI_TstFldPwrUpSt_783 13;
BA_ "SignalLongName" SG_ 3221225472 DTCI_TstFldPwrUpSt_783 "Diagnostic Trouble Code Information Extended 783 : Test Failed Since Power Up Status";
BA_ "VNSigAllNodes" SG_ 3221225472 DTCI_TstFldCdClrdStat_783 1;
BA_ "SignalType" SG_ 3221225472 DTCI_TstFldCdClrdStat_783 "BLN";
BA_ "PacketOrder" SG_ 3221225472 DTCI_TstFldCdClrdStat_783 16;
BA_ "SignalLongName" SG_ 3221225472 DTCI_TstFldCdClrdStat_783 "Diagnostic Trouble Code Information Extended 783 : Test Failed Since Code Cleared Status";
BA_ "VNSigAllNodes" SG_ 3221225472 DTCI_DTCFaultType_77E 1;
BA_ "SignalType" SG_ 3221225472 DTCI_DTCFaultType_77E "ENM";
BA_ "PacketOrder" SG_ 3221225472 DTCI_DTCFaultType_77E 20;
BA_ "SignalLongName" SG_ 3221225472 DTCI_DTCFaultType_77E "Diagnostic Trouble Code Information Extended 77E : Diagnostic Trouble Code Fault Type";
BA_ "VNSigAllNodes" SG_ 3221225472 DTCI_CodeSupported_77E 1;
BA_ "SignalType" SG_ 3221225472 DTCI_CodeSupported_77E "BLN";
BA_ "PacketOrder" SG_ 3221225472 DTCI_CodeSupported_77E 19;
BA_ "SignalLongName" SG_ 3221225472 DTCI_CodeSupported_77E "Diagnostic Trouble Code Information Extended 77E : Code Supported";
BA_ "VNSigAllNodes" SG_ 3221225472 DTCI_CurrentStatus_77E 1;
BA_ "SignalType" SG_ 3221225472 DTCI_CurrentStatus_77E "BLN";
BA_ "PacketOrder" SG_ 3221225472 DTCI_CurrentStatus_77E 18;
BA_ "SignalLongName" SG_ 3221225472 DTCI_CurrentStatus_77E "Diagnostic Trouble Code Information Extended 77E : Current Status";
BA_ "VNSigAllNodes" SG_ 3221225472 DTCI_TstNPsdCdClrdSt_77E 1;
BA_ "SignalType" SG_ 3221225472 DTCI_TstNPsdCdClrdSt_77E "BLN";
BA_ "PacketOrder" SG_ 3221225472 DTCI_TstNPsdCdClrdSt_77E 17;
BA_ "SignalLongName" SG_ 3221225472 DTCI_TstNPsdCdClrdSt_77E "Diagnostic Trouble Code Information Extended 77E : Test Not Passed Since Code Cleared Status";
BA_ "VNSigAllNodes" SG_ 3221225472 DTCI_TstFldCdClrdStat_77E 1;
BA_ "SignalType" SG_ 3221225472 DTCI_TstFldCdClrdStat_77E "BLN";
BA_ "PacketOrder" SG_ 3221225472 DTCI_TstFldCdClrdStat_77E 16;
BA_ "SignalLongName" SG_ 3221225472 DTCI_TstFldCdClrdStat_77E "Diagnostic Trouble Code Information Extended 77E : Test Failed Since Code Cleared Status";
BA_ "VNSigAllNodes" SG_ 3221225472 DTCI_HistStat_77E 1;
BA_ "SignalType" SG_ 3221225472 DTCI_HistStat_77E "BLN";
BA_ "PacketOrder" SG_ 3221225472 DTCI_HistStat_77E 15;
BA_ "SignalLongName" SG_ 3221225472 DTCI_HistStat_77E "Diagnostic Trouble Code Information Extended 77E : History Status";
BA_ "VNSigAllNodes" SG_ 3221225472 DTCI_TstNPsdPwrUpSt_77E 1;
BA_ "SignalType" SG_ 3221225472 DTCI_TstNPsdPwrUpSt_77E "BLN";
BA_ "PacketOrder" SG_ 3221225472 DTCI_TstNPsdPwrUpSt_77E 14;
BA_ "SignalLongName" SG_ 3221225472 DTCI_TstNPsdPwrUpSt_77E "Diagnostic Trouble Code Information Extended 77E : Test Not Passed Since Power Up Status";
BA_ "VNSigAllNodes" SG_ 3221225472 DTCI_TstFldPwrUpSt_77E 1;
BA_ "SignalType" SG_ 3221225472 DTCI_TstFldPwrUpSt_77E "BLN";
BA_ "PacketOrder" SG_ 3221225472 DTCI_TstFldPwrUpSt_77E 13;
BA_ "SignalLongName" SG_ 3221225472 DTCI_TstFldPwrUpSt_77E "Diagnostic Trouble Code Information Extended 77E : Test Failed Since Power Up Status";
BA_ "VNSigAllNodes" SG_ 3221225472 DTCI_WrnIndRqdSt_77E 1;
BA_ "SignalType" SG_ 3221225472 DTCI_WrnIndRqdSt_77E "BLN";
BA_ "PacketOrder" SG_ 3221225472 DTCI_WrnIndRqdSt_77E 12;
BA_ "SignalLongName" SG_ 3221225472 DTCI_WrnIndRqdSt_77E "Diagnostic Trouble Code Information Extended 77E : Warning Indicator Requested Status";
BA_ "VNSigAllNodes" SG_ 3221225472 DTCI_DTCFailType_77E 1;
BA_ "SignalType" SG_ 3221225472 DTCI_DTCFailType_77E "UNM";
BA_ "PacketOrder" SG_ 3221225472 DTCI_DTCFailType_77E 11;
BA_ "SignalLongName" SG_ 3221225472 DTCI_DTCFailType_77E "Diagnostic Trouble Code Information Extended 77E : Diagnostic Trouble Code Failure Type";
BA_ "VNSigAllNodes" SG_ 3221225472 DTCI_DTCNumber_77E 1;
BA_ "SignalType" SG_ 3221225472 DTCI_DTCNumber_77E "UNM";
BA_ "PacketOrder" SG_ 3221225472 DTCI_DTCNumber_77E 10;
BA_ "SignalLongName" SG_ 3221225472 DTCI_DTCNumber_77E "Diagnostic Trouble Code Information Extended 77E : Diagnostic Trouble Code Number";
BA_ "VNSigAllNodes" SG_ 3221225472 DTCI_DTCSource_77E 1;
BA_ "SignalType" SG_ 3221225472 DTCI_DTCSource_77E "UNM";
BA_ "PacketOrder" SG_ 3221225472 DTCI_DTCSource_77E 9;
BA_ "SignalLongName" SG_ 3221225472 DTCI_DTCSource_77E "Diagnostic Trouble Code Information Extended 77E : Diagnostic Trouble Code Source";
BA_ "VNSigAllNodes" SG_ 3221225472 DTCI_DTCTriggered_77E 1;
BA_ "SignalType" SG_ 3221225472 DTCI_DTCTriggered_77E "BLN";
BA_ "PacketOrder" SG_ 3221225472 DTCI_DTCTriggered_77E 8;
BA_ "SignalLongName" SG_ 3221225472 DTCI_DTCTriggered_77E "Diagnostic Trouble Code Information Extended 77E : Diagnostic Trouble Code Triggered";
BA_ "VNSigAllNodes" SG_ 3221225472 DTCIUnused7_77E 1;
BA_ "SignalType" SG_ 3221225472 DTCIUnused7_77E "BLN";
BA_ "PacketOrder" SG_ 3221225472 DTCIUnused7_77E 7;
BA_ "SignalLongName" SG_ 3221225472 DTCIUnused7_77E "Diagnostic Trouble Code Information Extended 77E : Unused 7";
BA_ "VNSigAllNodes" SG_ 3221225472 DTCIUnused6_77E 1;
BA_ "SignalType" SG_ 3221225472 DTCIUnused6_77E "BLN";
BA_ "PacketOrder" SG_ 3221225472 DTCIUnused6_77E 6;
BA_ "SignalLongName" SG_ 3221225472 DTCIUnused6_77E "Diagnostic Trouble Code Information Extended 77E : Unused 6";
BA_ "VNSigAllNodes" SG_ 3221225472 DTCIUnused5_77E 1;
BA_ "SignalType" SG_ 3221225472 DTCIUnused5_77E "BLN";
BA_ "PacketOrder" SG_ 3221225472 DTCIUnused5_77E 5;
BA_ "SignalLongName" SG_ 3221225472 DTCIUnused5_77E "Diagnostic Trouble Code Information Extended 77E : Unused 5";
BA_ "VNSigAllNodes" SG_ 3221225472 DTCIUnused4_77E 1;
BA_ "SignalType" SG_ 3221225472 DTCIUnused4_77E "BLN";
BA_ "PacketOrder" SG_ 3221225472 DTCIUnused4_77E 4;
BA_ "SignalLongName" SG_ 3221225472 DTCIUnused4_77E "Diagnostic Trouble Code Information Extended 77E : Unused 4";
BA_ "VNSigAllNodes" SG_ 3221225472 DTCIUnused3_77E 1;
BA_ "SignalType" SG_ 3221225472 DTCIUnused3_77E "BLN";
BA_ "PacketOrder" SG_ 3221225472 DTCIUnused3_77E 3;
BA_ "SignalLongName" SG_ 3221225472 DTCIUnused3_77E "Diagnostic Trouble Code Information Extended 77E : Unused 3";
BA_ "VNSigAllNodes" SG_ 3221225472 DTCIUnused2_77E 1;
BA_ "SignalType" SG_ 3221225472 DTCIUnused2_77E "BLN";
BA_ "PacketOrder" SG_ 3221225472 DTCIUnused2_77E 2;
BA_ "SignalLongName" SG_ 3221225472 DTCIUnused2_77E "Diagnostic Trouble Code Information Extended 77E : Unused 2";
BA_ "VNSigAllNodes" SG_ 3221225472 DTCIUnused1_77E 1;
BA_ "SignalType" SG_ 3221225472 DTCIUnused1_77E "BLN";
BA_ "PacketOrder" SG_ 3221225472 DTCIUnused1_77E 1;
BA_ "SignalLongName" SG_ 3221225472 DTCIUnused1_77E "Diagnostic Trouble Code Information Extended 77E : Unused 1";
BA_ "VNSigSLHSSharedDiagnostic" SG_ 3221225472 DgnInf_HS54E 1;
BA_ "VNSigAllNodes" SG_ 3221225472 DgnInf_HS54E 1;
BA_ "SignalType" SG_ 3221225472 DgnInf_HS54E "UNM";
BA_ "SignalLongName" SG_ 3221225472 DgnInf_HS54E "Diagnostic Information HS54E";
BA_ "VNSigAllNodes" SG_ 3221225472 DTCI_DTCFaultType_777 1;
BA_ "SignalType" SG_ 3221225472 DTCI_DTCFaultType_777 "ENM";
BA_ "PacketOrder" SG_ 3221225472 DTCI_DTCFaultType_777 20;
BA_ "SignalLongName" SG_ 3221225472 DTCI_DTCFaultType_777 "Diagnostic Trouble Code Information Extended 777 : Diagnostic Trouble Code Fault Type";
BA_ "VNSigAllNodes" SG_ 3221225472 DTCI_CodeSupported_777 1;
BA_ "SignalType" SG_ 3221225472 DTCI_CodeSupported_777 "BLN";
BA_ "PacketOrder" SG_ 3221225472 DTCI_CodeSupported_777 19;
BA_ "SignalLongName" SG_ 3221225472 DTCI_CodeSupported_777 "Diagnostic Trouble Code Information Extended 777 : Code Supported";
BA_ "VNSigAllNodes" SG_ 3221225472 DTCI_CurrentStatus_777 1;
BA_ "SignalType" SG_ 3221225472 DTCI_CurrentStatus_777 "BLN";
BA_ "PacketOrder" SG_ 3221225472 DTCI_CurrentStatus_777 18;
BA_ "SignalLongName" SG_ 3221225472 DTCI_CurrentStatus_777 "Diagnostic Trouble Code Information Extended 777 : Current Status";
BA_ "VNSigAllNodes" SG_ 3221225472 DTCI_TstNPsdCdClrdSt_777 1;
BA_ "SignalType" SG_ 3221225472 DTCI_TstNPsdCdClrdSt_777 "BLN";
BA_ "PacketOrder" SG_ 3221225472 DTCI_TstNPsdCdClrdSt_777 17;
BA_ "SignalLongName" SG_ 3221225472 DTCI_TstNPsdCdClrdSt_777 "Diagnostic Trouble Code Information Extended 777 : Test Not Passed Since Code Cleared Status";
BA_ "VNSigAllNodes" SG_ 3221225472 DTCI_TstFldCdClrdStat_777 1;
BA_ "SignalType" SG_ 3221225472 DTCI_TstFldCdClrdStat_777 "BLN";
BA_ "PacketOrder" SG_ 3221225472 DTCI_TstFldCdClrdStat_777 16;
BA_ "SignalLongName" SG_ 3221225472 DTCI_TstFldCdClrdStat_777 "Diagnostic Trouble Code Information Extended 777 : Test Failed Since Code Cleared Status";
BA_ "VNSigAllNodes" SG_ 3221225472 DTCI_HistStat_777 1;
BA_ "SignalType" SG_ 3221225472 DTCI_HistStat_777 "BLN";
BA_ "PacketOrder" SG_ 3221225472 DTCI_HistStat_777 15;
BA_ "SignalLongName" SG_ 3221225472 DTCI_HistStat_777 "Diagnostic Trouble Code Information Extended 777 : History Status";
BA_ "VNSigAllNodes" SG_ 3221225472 DTCI_TstNPsdPwrUpSt_777 1;
BA_ "SignalType" SG_ 3221225472 DTCI_TstNPsdPwrUpSt_777 "BLN";
BA_ "PacketOrder" SG_ 3221225472 DTCI_TstNPsdPwrUpSt_777 14;
BA_ "SignalLongName" SG_ 3221225472 DTCI_TstNPsdPwrUpSt_777 "Diagnostic Trouble Code Information Extended 777 : Test Not Passed Since Power Up Status";
BA_ "VNSigAllNodes" SG_ 3221225472 DTCI_TstFldPwrUpSt_777 1;
BA_ "SignalType" SG_ 3221225472 DTCI_TstFldPwrUpSt_777 "BLN";
BA_ "PacketOrder" SG_ 3221225472 DTCI_TstFldPwrUpSt_777 13;
BA_ "SignalLongName" SG_ 3221225472 DTCI_TstFldPwrUpSt_777 "Diagnostic Trouble Code Information Extended 777 : Test Failed Since Power Up Status";
BA_ "VNSigAllNodes" SG_ 3221225472 DTCI_WrnIndRqdSt_777 1;
BA_ "SignalType" SG_ 3221225472 DTCI_WrnIndRqdSt_777 "BLN";
BA_ "PacketOrder" SG_ 3221225472 DTCI_WrnIndRqdSt_777 12;
BA_ "SignalLongName" SG_ 3221225472 DTCI_WrnIndRqdSt_777 "Diagnostic Trouble Code Information Extended 777 : Warning Indicator Requested Status";
BA_ "VNSigAllNodes" SG_ 3221225472 DTCI_DTCFailType_777 1;
BA_ "SignalType" SG_ 3221225472 DTCI_DTCFailType_777 "UNM";
BA_ "PacketOrder" SG_ 3221225472 DTCI_DTCFailType_777 11;
BA_ "SignalLongName" SG_ 3221225472 DTCI_DTCFailType_777 "Diagnostic Trouble Code Information Extended 777 : Diagnostic Trouble Code Failure Type";
BA_ "VNSigAllNodes" SG_ 3221225472 DTCI_DTCNumber_777 1;
BA_ "SignalType" SG_ 3221225472 DTCI_DTCNumber_777 "UNM";
BA_ "PacketOrder" SG_ 3221225472 DTCI_DTCNumber_777 10;
BA_ "SignalLongName" SG_ 3221225472 DTCI_DTCNumber_777 "Diagnostic Trouble Code Information Extended 777 : Diagnostic Trouble Code Number";
BA_ "VNSigAllNodes" SG_ 3221225472 DTCI_DTCSource_777 1;
BA_ "SignalType" SG_ 3221225472 DTCI_DTCSource_777 "UNM";
BA_ "PacketOrder" SG_ 3221225472 DTCI_DTCSource_777 9;
BA_ "SignalLongName" SG_ 3221225472 DTCI_DTCSource_777 "Diagnostic Trouble Code Information Extended 777 : Diagnostic Trouble Code Source";
BA_ "VNSigAllNodes" SG_ 3221225472 DTCI_DTCTriggered_777 1;
BA_ "SignalType" SG_ 3221225472 DTCI_DTCTriggered_777 "BLN";
BA_ "PacketOrder" SG_ 3221225472 DTCI_DTCTriggered_777 8;
BA_ "SignalLongName" SG_ 3221225472 DTCI_DTCTriggered_777 "Diagnostic Trouble Code Information Extended 777 : Diagnostic Trouble Code Triggered";
BA_ "VNSigAllNodes" SG_ 3221225472 DTCIUnused7_777 1;
BA_ "SignalType" SG_ 3221225472 DTCIUnused7_777 "BLN";
BA_ "PacketOrder" SG_ 3221225472 DTCIUnused7_777 7;
BA_ "SignalLongName" SG_ 3221225472 DTCIUnused7_777 "Diagnostic Trouble Code Information Extended 777 : Unused 7";
BA_ "VNSigAllNodes" SG_ 3221225472 DTCIUnused6_777 1;
BA_ "SignalType" SG_ 3221225472 DTCIUnused6_777 "BLN";
BA_ "PacketOrder" SG_ 3221225472 DTCIUnused6_777 6;
BA_ "SignalLongName" SG_ 3221225472 DTCIUnused6_777 "Diagnostic Trouble Code Information Extended 777 : Unused 6";
BA_ "VNSigAllNodes" SG_ 3221225472 DTCIUnused5_777 1;
BA_ "SignalType" SG_ 3221225472 DTCIUnused5_777 "BLN";
BA_ "PacketOrder" SG_ 3221225472 DTCIUnused5_777 5;
BA_ "SignalLongName" SG_ 3221225472 DTCIUnused5_777 "Diagnostic Trouble Code Information Extended 777 : Unused 5";
BA_ "VNSigAllNodes" SG_ 3221225472 PTOAudExtAlertReq 1;
BA_ "SignalType" SG_ 3221225472 PTOAudExtAlertReq "BLN";
BA_ "SignalLongName" SG_ 3221225472 PTOAudExtAlertReq "Power Take Off Audible External Alert Request";
BA_ "VNSigAllNodes" SG_ 3221225472 DmpSysVehTopSpdLim 1;
BA_ "SignalType" SG_ 3221225472 DmpSysVehTopSpdLim "UNM";
BA_ "SignalLongName" SG_ 3221225472 DmpSysVehTopSpdLim "Damping System Vehicle Top Speed Limit Value";
BA_ "GenSigStartValue" SG_ 3221225472 DmpSysVehTopSpdLim 255;
BA_ "VNSigAllNodes" SG_ 3221225472 HybEstTransOilTmpM 1;
BA_ "SignalType" SG_ 3221225472 HybEstTransOilTmpM "ENM";
BA_ "SignalLongName" SG_ 3221225472 HybEstTransOilTmpM "Hybrid Estimated Transmission Oil Temperature Mask";
BA_ "VNSigAllNodes" SG_ 3221225472 HybEstTransOilTmp 1;
BA_ "SignalType" SG_ 3221225472 HybEstTransOilTmp "UNM";
BA_ "SignalLongName" SG_ 3221225472 HybEstTransOilTmp "Hybrid Estimated Transmission Oil Temperature";
BA_ "VNSigAllNodes" SG_ 3221225472 TransClch5_TorqCmnd 1;
BA_ "SignalType" SG_ 3221225472 TransClch5_TorqCmnd "UNM";
BA_ "SignalLongName" SG_ 3221225472 TransClch5_TorqCmnd "Transmission Clutch 5 Torque Command";
BA_ "VNSigAllNodes" SG_ 3221225472 TransCltch5MinPrsRq 1;
BA_ "SignalType" SG_ 3221225472 TransCltch5MinPrsRq "UNM";
BA_ "SignalLongName" SG_ 3221225472 TransCltch5MinPrsRq "Transmission Clutch 5 Minimum Pressure Required";
BA_ "VNSigAllNodes" SG_ 3221225472 TransCltch5FillCmd 1;
BA_ "SignalType" SG_ 3221225472 TransCltch5FillCmd "ENM";
BA_ "SignalLongName" SG_ 3221225472 TransCltch5FillCmd "Transmission Clutch 5 Fill Commanded";
BA_ "VNSigAllNodes" SG_ 3221225472 TransClch4_TorqCmnd 1;
BA_ "SignalType" SG_ 3221225472 TransClch4_TorqCmnd "UNM";
BA_ "SignalLongName" SG_ 3221225472 TransClch4_TorqCmnd "Transmission Clutch 4 Torque Command";
BA_ "VNSigAllNodes" SG_ 3221225472 TransCltch4MinPrsRq 1;
BA_ "SignalType" SG_ 3221225472 TransCltch4MinPrsRq "UNM";
BA_ "SignalLongName" SG_ 3221225472 TransCltch4MinPrsRq "Transmission Clutch 4 Minimum Pressure Required";
BA_ "VNSigAllNodes" SG_ 3221225472 TransCltch4FillCmd 1;
BA_ "SignalType" SG_ 3221225472 TransCltch4FillCmd "ENM";
BA_ "SignalLongName" SG_ 3221225472 TransCltch4FillCmd "Transmission Clutch 4 Fill Commanded";
BA_ "VNSigAllNodes" SG_ 3221225472 TransCltch1FillCmd 1;
BA_ "SignalType" SG_ 3221225472 TransCltch1FillCmd "ENM";
BA_ "SignalLongName" SG_ 3221225472 TransCltch1FillCmd "Transmission Clutch 1 Fill Commanded";
BA_ "VNSigAllNodes" SG_ 3221225472 TransCltch1CntlRqPVal 1;
BA_ "SignalType" SG_ 3221225472 TransCltch1CntlRqPVal "UNM";
BA_ "SignalLongName" SG_ 3221225472 TransCltch1CntlRqPVal "Transmission Clutch 1 Control Requested Protection Value";
BA_ "VNSigAllNodes" SG_ 3221225472 MtrBCoolFlwCmd 1;
BA_ "SignalType" SG_ 3221225472 MtrBCoolFlwCmd "UNM";
BA_ "SignalLongName" SG_ 3221225472 MtrBCoolFlwCmd "Motor B Cooling Flow Command";
BA_ "VNSigAllNodes" SG_ 3221225472 MtrACoolFlwCmd 1;
BA_ "SignalType" SG_ 3221225472 MtrACoolFlwCmd "UNM";
BA_ "SignalLongName" SG_ 3221225472 MtrACoolFlwCmd "Motor A Cooling Flow Command";
BA_ "VNSigAllNodes" SG_ 3221225472 TransCltchCntlARC 1;
BA_ "SignalType" SG_ 3221225472 TransCltchCntlARC "UNM";
BA_ "SignalLongName" SG_ 3221225472 TransCltchCntlARC "Transmission Clutch Control Alive Rolling Count";
BA_ "VNSigAllNodes" SG_ 3221225472 TransCltch5CntlRqPVal 1;
BA_ "SignalType" SG_ 3221225472 TransCltch5CntlRqPVal "UNM";
BA_ "SignalLongName" SG_ 3221225472 TransCltch5CntlRqPVal "Transmission Clutch 5 Control Requested Protection Value";
BA_ "VNSigAllNodes" SG_ 3221225472 TransCltch4CntlRqPVal 1;
BA_ "SignalType" SG_ 3221225472 TransCltch4CntlRqPVal "UNM";
BA_ "SignalLongName" SG_ 3221225472 TransCltch4CntlRqPVal "Transmission Clutch 4 Control Requested Protection Value";
BA_ "VNSigAllNodes" SG_ 3221225472 TransCltch3CntlRqPVal 1;
BA_ "SignalType" SG_ 3221225472 TransCltch3CntlRqPVal "UNM";
BA_ "SignalLongName" SG_ 3221225472 TransCltch3CntlRqPVal "Transmission Clutch 3 Control Requested Protection Value";
BA_ "VNSigAllNodes" SG_ 3221225472 TransCltch2CntlRqPVal 1;
BA_ "SignalType" SG_ 3221225472 TransCltch2CntlRqPVal "UNM";
BA_ "SignalLongName" SG_ 3221225472 TransCltch2CntlRqPVal "Transmission Clutch 2 Control Requested Protection Value";
BA_ "VNSigAllNodes" SG_ 3221225472 TransClch1_TorqCmnd 1;
BA_ "SignalType" SG_ 3221225472 TransClch1_TorqCmnd "UNM";
BA_ "SignalLongName" SG_ 3221225472 TransClch1_TorqCmnd "Transmission Clutch 1 Torque Command";
BA_ "VNSigAllNodes" SG_ 3221225472 TransCltch1MinPrsRq 1;
BA_ "SignalType" SG_ 3221225472 TransCltch1MinPrsRq "UNM";
BA_ "SignalLongName" SG_ 3221225472 TransCltch1MinPrsRq "Transmission Clutch 1 Minimum Pressure Required";
BA_ "VNSigAllNodes" SG_ 3221225472 TransCltch5CntlRq 1;
BA_ "SignalType" SG_ 3221225472 TransCltch5CntlRq "ENM";
BA_ "SignalLongName" SG_ 3221225472 TransCltch5CntlRq "Transmission Clutch 5 Control Requested";
BA_ "VNSigAllNodes" SG_ 3221225472 TransCltch4CntlRq 1;
BA_ "SignalType" SG_ 3221225472 TransCltch4CntlRq "ENM";
BA_ "SignalLongName" SG_ 3221225472 TransCltch4CntlRq "Transmission Clutch 4 Control Requested";
BA_ "VNSigAllNodes" SG_ 3221225472 TransCltch3CntlRq 1;
BA_ "SignalType" SG_ 3221225472 TransCltch3CntlRq "ENM";
BA_ "SignalLongName" SG_ 3221225472 TransCltch3CntlRq "Transmission Clutch 3 Control Requested";
BA_ "VNSigAllNodes" SG_ 3221225472 TransCltch2CntlRq 1;
BA_ "SignalType" SG_ 3221225472 TransCltch2CntlRq "ENM";
BA_ "SignalLongName" SG_ 3221225472 TransCltch2CntlRq "Transmission Clutch 2 Control Requested";
BA_ "VNSigAllNodes" SG_ 3221225472 TransCltch1CntlRq 1;
BA_ "SignalType" SG_ 3221225472 TransCltch1CntlRq "ENM";
BA_ "SignalLongName" SG_ 3221225472 TransCltch1CntlRq "Transmission Clutch 1 Control Requested";
BA_ "VNSigAllNodes" SG_ 3221225472 TransAuxPmpPresDetcd 1;
BA_ "SignalType" SG_ 3221225472 TransAuxPmpPresDetcd "BLN";
BA_ "SignalLongName" SG_ 3221225472 TransAuxPmpPresDetcd "Transmission Auxiliary Pump Pressure Detected";
BA_ "VNSigAllNodes" SG_ 3221225472 TransClch3_TorqCmnd 1;
BA_ "SignalType" SG_ 3221225472 TransClch3_TorqCmnd "UNM";
BA_ "SignalLongName" SG_ 3221225472 TransClch3_TorqCmnd "Transmission Clutch 3 Torque Command";
BA_ "VNSigAllNodes" SG_ 3221225472 TransCltch3MinPrsRq 1;
BA_ "SignalType" SG_ 3221225472 TransCltch3MinPrsRq "UNM";
BA_ "SignalLongName" SG_ 3221225472 TransCltch3MinPrsRq "Transmission Clutch 3 Minimum Pressure Required";
BA_ "VNSigAllNodes" SG_ 3221225472 TransCltch3FillCmd 1;
BA_ "SignalType" SG_ 3221225472 TransCltch3FillCmd "ENM";
BA_ "SignalLongName" SG_ 3221225472 TransCltch3FillCmd "Transmission Clutch 3 Fill Commanded";
BA_ "VNSigSLHSSharedDiagnostic" SG_ 3221225472 DgnInf_HS55E 1;
BA_ "VNSigAllNodes" SG_ 3221225472 DgnInf_HS55E 1;
BA_ "SignalType" SG_ 3221225472 DgnInf_HS55E "UNM";
BA_ "SignalLongName" SG_ 3221225472 DgnInf_HS55E "Diagnostic Information HS55E";
BA_ "VNSigSLHSSharedDiagnostic" SG_ 3221225472 DgnInf_HS54F 1;
BA_ "VNSigAllNodes" SG_ 3221225472 DgnInf_HS54F 1;
BA_ "SignalType" SG_ 3221225472 DgnInf_HS54F "UNM";
BA_ "SignalLongName" SG_ 3221225472 DgnInf_HS54F "Diagnostic Information HS54F";
BA_ "VNSigAllNodes" SG_ 3221225472 DTCIUnused4_777 1;
BA_ "SignalType" SG_ 3221225472 DTCIUnused4_777 "BLN";
BA_ "PacketOrder" SG_ 3221225472 DTCIUnused4_777 4;
BA_ "SignalLongName" SG_ 3221225472 DTCIUnused4_777 "Diagnostic Trouble Code Information Extended 777 : Unused 4";
BA_ "VNSigAllNodes" SG_ 3221225472 DTCIUnused3_777 1;
BA_ "SignalType" SG_ 3221225472 DTCIUnused3_777 "BLN";
BA_ "PacketOrder" SG_ 3221225472 DTCIUnused3_777 3;
BA_ "SignalLongName" SG_ 3221225472 DTCIUnused3_777 "Diagnostic Trouble Code Information Extended 777 : Unused 3";
BA_ "VNSigAllNodes" SG_ 3221225472 DTCIUnused2_777 1;
BA_ "SignalType" SG_ 3221225472 DTCIUnused2_777 "BLN";
BA_ "PacketOrder" SG_ 3221225472 DTCIUnused2_777 2;
BA_ "SignalLongName" SG_ 3221225472 DTCIUnused2_777 "Diagnostic Trouble Code Information Extended 777 : Unused 2";
BA_ "VNSigAllNodes" SG_ 3221225472 DTCIUnused1_777 1;
BA_ "SignalType" SG_ 3221225472 DTCIUnused1_777 "BLN";
BA_ "PacketOrder" SG_ 3221225472 DTCIUnused1_777 1;
BA_ "SignalLongName" SG_ 3221225472 DTCIUnused1_777 "Diagnostic Trouble Code Information Extended 777 : Unused 1";
BA_ "VNSigSLHSSharedDiagnostic" SG_ 3221225472 DgnInf_HS547 1;
BA_ "VNSigAllNodes" SG_ 3221225472 DgnInf_HS547 1;
BA_ "SignalType" SG_ 3221225472 DgnInf_HS547 "UNM";
BA_ "SignalLongName" SG_ 3221225472 DgnInf_HS547 "Diagnostic Information HS547";
BA_ "VNSigAllNodes" SG_ 3221225472 EBrkAstStat 1;
BA_ "SignalType" SG_ 3221225472 EBrkAstStat "ENM";
BA_ "SignalLongName" SG_ 3221225472 EBrkAstStat "EBrakeAssist Status";
BA_ "VNSigAllNodes" SG_ 3221225472 Sig1877PVal 1;
BA_ "SignalType" SG_ 3221225472 Sig1877PVal "UNM";
BA_ "SignalLongName" SG_ 3221225472 Sig1877PVal "Signal1877 Protection Value";
BA_ "VNSigAllNodes" SG_ 3221225472 Sig1877ARC 1;
BA_ "SignalType" SG_ 3221225472 Sig1877ARC "UNM";
BA_ "SignalLongName" SG_ 3221225472 Sig1877ARC "Signal1877 Alive Rolling Count";
BA_ "VNSigAllNodes" SG_ 3221225472 Sig1877 1;
BA_ "SignalType" SG_ 3221225472 Sig1877 "BLN";
BA_ "SignalLongName" SG_ 3221225472 Sig1877 "Signal1877";
BA_ "VNSigAllNodes" SG_ 3221225472 TransClch2_TorqCmnd 1;
BA_ "SignalType" SG_ 3221225472 TransClch2_TorqCmnd "UNM";
BA_ "SignalLongName" SG_ 3221225472 TransClch2_TorqCmnd "Transmission Clutch 2 Torque Command";
BA_ "VNSigAllNodes" SG_ 3221225472 TransCltch2MinPrsRq 1;
BA_ "SignalType" SG_ 3221225472 TransCltch2MinPrsRq "UNM";
BA_ "SignalLongName" SG_ 3221225472 TransCltch2MinPrsRq "Transmission Clutch 2 Minimum Pressure Required";
BA_ "VNSigAllNodes" SG_ 3221225472 TransCltch2FillCmd 1;
BA_ "SignalType" SG_ 3221225472 TransCltch2FillCmd "ENM";
BA_ "SignalLongName" SG_ 3221225472 TransCltch2FillCmd "Transmission Clutch 2 Fill Commanded";
BA_ "VNSigAllNodes" SG_ 3221225472 HybTrnsLubeFlwRqd 1;
BA_ "SignalType" SG_ 3221225472 HybTrnsLubeFlwRqd "UNM";
BA_ "SignalLongName" SG_ 3221225472 HybTrnsLubeFlwRqd "Hybrid Transmission Lube Flow Requested";
BA_ "VNSigAllNodes" SG_ 3221225472 MtrBSpd 1;
BA_ "SignalType" SG_ 3221225472 MtrBSpd "SNM";
BA_ "SignalLongName" SG_ 3221225472 MtrBSpd "Motor B Speed";
BA_ "VNSigAllNodes" SG_ 3221225472 MtrASpd 1;
BA_ "SignalType" SG_ 3221225472 MtrASpd "SNM";
BA_ "SignalLongName" SG_ 3221225472 MtrASpd "Motor A Speed";
BA_ "VNSigAllNodes" SG_ 3221225472 HybTransStCmmnd 1;
BA_ "SignalType" SG_ 3221225472 HybTransStCmmnd "ENM";
BA_ "SignalLongName" SG_ 3221225472 HybTransStCmmnd "Hybrid Transmission State Commanded";
BA_ "VNSigAllNodes" SG_ 3221225472 HybTransStAchvd 1;
BA_ "SignalType" SG_ 3221225472 HybTransStAchvd "ENM";
BA_ "SignalLongName" SG_ 3221225472 HybTransStAchvd "Hybrid Transmission State Achieved";
BA_ "VNSigAllNodes" SG_ 3221225472 TransFldPmpCmd 1;
BA_ "SignalType" SG_ 3221225472 TransFldPmpCmd "ENM";
BA_ "SignalLongName" SG_ 3221225472 TransFldPmpCmd "Transmission Fluid Pump Command";
BA_ "VNSigAllNodes" SG_ 3221225472 TnsClchFlLnePrsBstRq 1;
BA_ "SignalType" SG_ 3221225472 TnsClchFlLnePrsBstRq "BLN";
BA_ "SignalLongName" SG_ 3221225472 TnsClchFlLnePrsBstRq "Transmission Clutch Fill Line Pressure Boost Requested";
BA_ "VNSigAllNodes" SG_ 3221225472 TransAuxPumpSpd 1;
BA_ "SignalType" SG_ 3221225472 TransAuxPumpSpd "UNM";
BA_ "SignalLongName" SG_ 3221225472 TransAuxPumpSpd "Transmission Auxiliary Pump Speed";
BA_ "VNSigAllNodes" SG_ 3221225472 TransAuxPumpAvail 1;
BA_ "SignalType" SG_ 3221225472 TransAuxPumpAvail "BLN";
BA_ "SignalLongName" SG_ 3221225472 TransAuxPumpAvail "Transmission Auxiliary Pump Available";
BA_ "VNSigAllNodes" SG_ 3221225472 MtrBSpdV 1;
BA_ "SignalType" SG_ 3221225472 MtrBSpdV "ENM";
BA_ "SignalLongName" SG_ 3221225472 MtrBSpdV "Motor B Speed Validity";
BA_ "VNSigAllNodes" SG_ 3221225472 MtrASpdV 1;
BA_ "SignalType" SG_ 3221225472 MtrASpdV "ENM";
BA_ "SignalLongName" SG_ 3221225472 MtrASpdV "Motor A Speed Validity";
BA_ "VNSigAllNodes" SG_ 3221225472 HybColdSoakTempM 1;
BA_ "SignalType" SG_ 3221225472 HybColdSoakTempM "ENM";
BA_ "SignalLongName" SG_ 3221225472 HybColdSoakTempM "Hybrid Cold Soak Temperature Mask";
BA_ "VNSigAllNodes" SG_ 3221225472 HybColdSoakTemp 1;
BA_ "SignalType" SG_ 3221225472 HybColdSoakTemp "UNM";
BA_ "SignalLongName" SG_ 3221225472 HybColdSoakTemp "Hybrid Cold Soak Temperature";
BA_ "VNSigAllNodes" SG_ 3221225472 BrkSyCtl2EmsRldMlfAct 1;
BA_ "SignalType" SG_ 3221225472 BrkSyCtl2EmsRldMlfAct "BLN";
BA_ "SignalLongName" SG_ 3221225472 BrkSyCtl2EmsRldMlfAct "Brake System Control 2 Emissions Related Malfunction Active";
BA_ "VNSigAllNodes" SG_ 3221225472 BSC2ERDTC_CdNum 1;
BA_ "SignalType" SG_ 3221225472 BSC2ERDTC_CdNum "UNM";
BA_ "PacketOrder" SG_ 3221225472 BSC2ERDTC_CdNum 2;
BA_ "SignalLongName" SG_ 3221225472 BSC2ERDTC_CdNum "Brake System Control 2 Emissions Related DTC : Code Number";
BA_ "VNSigAllNodes" SG_ 3221225472 BSC2ERDTC_SysDes 1;
BA_ "SignalType" SG_ 3221225472 BSC2ERDTC_SysDes "ENM";
BA_ "PacketOrder" SG_ 3221225472 BSC2ERDTC_SysDes 1;
BA_ "SignalLongName" SG_ 3221225472 BSC2ERDTC_SysDes "Brake System Control 2 Related DTC : System Designator";
BA_ "VNSigAllNodes" SG_ 3221225472 RdGasFuelDevDisStat 1;
BA_ "SignalType" SG_ 3221225472 RdGasFuelDevDisStat "ENM";
BA_ "SignalLongName" SG_ 3221225472 RdGasFuelDevDisStat "Redundant Gaseous Fuel Devices Disable State";
BA_ "VNSigAllNodes" SG_ 3221225472 RdFInjCtrlMdIFltAct 1;
BA_ "SignalType" SG_ 3221225472 RdFInjCtrlMdIFltAct "BLN";
BA_ "SignalLongName" SG_ 3221225472 RdFInjCtrlMdIFltAct "Redundant Fuel Injector Control Module Injection Fault Active";
BA_ "VNSigAllNodes" SG_ 3221225472 RdDistFuelMdReq 1;
BA_ "SignalType" SG_ 3221225472 RdDistFuelMdReq "ENM";
BA_ "SignalLongName" SG_ 3221225472 RdDistFuelMdReq "Redundant Distributed Fuel Mode Request";
BA_ "VNSigAllNodes" SG_ 3221225472 RdDistFuelMdCmdResRC 1;
BA_ "SignalType" SG_ 3221225472 RdDistFuelMdCmdResRC "UNM";
BA_ "SignalLongName" SG_ 3221225472 RdDistFuelMdCmdResRC "Redundant Distributed Fuel Mode Command Response Rolling Count";
BA_ "VNSigAllNodes" SG_ 3221225472 RdDistFuelMdCmdRes 1;
BA_ "SignalType" SG_ 3221225472 RdDistFuelMdCmdRes "ENM";
BA_ "SignalLongName" SG_ 3221225472 RdDistFuelMdCmdRes "Redundant Distributed Fuel Mode Command Response";
BA_ "VNSigAllNodes" SG_ 3221225472 RdAltFuelSysStat 1;
BA_ "SignalType" SG_ 3221225472 RdAltFuelSysStat "ENM";
BA_ "SignalLongName" SG_ 3221225472 RdAltFuelSysStat "Redundant Alternative Fuel System Status";
BA_ "VNSigAllNodes" SG_ 3221225472 RdAltFuelInjCmdRsp 1;
BA_ "SignalType" SG_ 3221225472 RdAltFuelInjCmdRsp "UNM";
BA_ "SignalLongName" SG_ 3221225472 RdAltFuelInjCmdRsp "Redundant Alternative Fuel Injector Commands Response";
BA_ "VNSigAllNodes" SG_ 3221225472 AltFuelInjRCRstOcc 1;
BA_ "SignalType" SG_ 3221225472 AltFuelInjRCRstOcc "BLN";
BA_ "SignalLongName" SG_ 3221225472 AltFuelInjRCRstOcc "Alternative Fuel Injected Rolling Count Reset Occurred";
BA_ "VNSigAllNodes" SG_ 3221225472 AltFuelInjRC 1;
BA_ "SignalType" SG_ 3221225472 AltFuelInjRC "UNM";
BA_ "SignalLongName" SG_ 3221225472 AltFuelInjRC "Alternative Fuel Injected Rolling Count";
BA_ "VNSigAllNodes" SG_ 3221225472 CltTmpCntlMdEmRMAct 1;
BA_ "SignalType" SG_ 3221225472 CltTmpCntlMdEmRMAct "BLN";
BA_ "SignalLongName" SG_ 3221225472 CltTmpCntlMdEmRMAct "Coolant Temperature Control Module Emissions Related Malfunction Active";
BA_ "VNSigAllNodes" SG_ 3221225472 CTCMERDTC_SysDes 1;
BA_ "SignalType" SG_ 3221225472 CTCMERDTC_SysDes "ENM";
BA_ "PacketOrder" SG_ 3221225472 CTCMERDTC_SysDes 1;
BA_ "SignalLongName" SG_ 3221225472 CTCMERDTC_SysDes "Coolant Temperature Control Module Emissions Related DTC : System Designator";
BA_ "VNSigAllNodes" SG_ 3221225472 CTCMERDTC_CdNum 1;
BA_ "SignalType" SG_ 3221225472 CTCMERDTC_CdNum "UNM";
BA_ "PacketOrder" SG_ 3221225472 CTCMERDTC_CdNum 2;
BA_ "SignalLongName" SG_ 3221225472 CTCMERDTC_CdNum "Coolant Temperature Control Module Emissions Related DTC : Code Number";
BA_ "VNSigAllNodes" SG_ 3221225472 RHCS_RdctHtrCCurrV 1;
BA_ "SignalType" SG_ 3221225472 RHCS_RdctHtrCCurrV "ENM";
BA_ "PacketOrder" SG_ 3221225472 RHCS_RdctHtrCCurrV 3;
BA_ "SignalLongName" SG_ 3221225472 RHCS_RdctHtrCCurrV "Reductant Heater Circuits Status : Reductant Heater C Current Validity";
BA_ "VNSigAllNodes" SG_ 3221225472 RHCS_RdctHtrBCurrV 1;
BA_ "SignalType" SG_ 3221225472 RHCS_RdctHtrBCurrV "ENM";
BA_ "PacketOrder" SG_ 3221225472 RHCS_RdctHtrBCurrV 2;
BA_ "SignalLongName" SG_ 3221225472 RHCS_RdctHtrBCurrV "Reductant Heater Circuits Status : Reductant Heater B Current Validity";
BA_ "VNSigAllNodes" SG_ 3221225472 RHCS_RdctHtrACurrV 1;
BA_ "SignalType" SG_ 3221225472 RHCS_RdctHtrACurrV "ENM";
BA_ "PacketOrder" SG_ 3221225472 RHCS_RdctHtrACurrV 1;
BA_ "SignalLongName" SG_ 3221225472 RHCS_RdctHtrACurrV "Reductant Heater Circuits Status : Reductant Heater A Current Validity";
BA_ "VNSigAllNodes" SG_ 3221225472 RdctHtrCrntFdbckRC 1;
BA_ "SignalType" SG_ 3221225472 RdctHtrCrntFdbckRC "UNM";
BA_ "SignalLongName" SG_ 3221225472 RdctHtrCrntFdbckRC "Reductant Heaters Current Feedback Alive Rolling Count";
BA_ "VNSigAllNodes" SG_ 3221225472 RdctHtrCctStatPV 1;
BA_ "SignalType" SG_ 3221225472 RdctHtrCctStatPV "UNM";
BA_ "SignalLongName" SG_ 3221225472 RdctHtrCctStatPV "Reductant Heater Circuits Status Protection Value";
BA_ "VNSigAllNodes" SG_ 3221225472 RdctHtrCCrntFdbckPVa 1;
BA_ "SignalType" SG_ 3221225472 RdctHtrCCrntFdbckPVa "UNM";
BA_ "SignalLongName" SG_ 3221225472 RdctHtrCCrntFdbckPVa "Reductant Heater C Current Feedback Protection Value";
BA_ "VNSigAllNodes" SG_ 3221225472 RdctHtrBCrntFdbckPVa 1;
BA_ "SignalType" SG_ 3221225472 RdctHtrBCrntFdbckPVa "UNM";
BA_ "SignalLongName" SG_ 3221225472 RdctHtrBCrntFdbckPVa "Reductant Heater B Current Feedback Protection Value";
BA_ "VNSigAllNodes" SG_ 3221225472 RdctHtrACrntFdbckPVa 1;
BA_ "SignalType" SG_ 3221225472 RdctHtrACrntFdbckPVa "UNM";
BA_ "SignalLongName" SG_ 3221225472 RdctHtrACrntFdbckPVa "Reductant Heater A Current Feedback Protection Value";
BA_ "VNSigAllNodes" SG_ 3221225472 RdctHtrCCrntFdbck 1;
BA_ "SignalType" SG_ 3221225472 RdctHtrCCrntFdbck "UNM";
BA_ "SignalLongName" SG_ 3221225472 RdctHtrCCrntFdbck "Reductant Heater C Current Feedback";
BA_ "VNSigAllNodes" SG_ 3221225472 RdctHtrBCrntFdbck 1;
BA_ "SignalType" SG_ 3221225472 RdctHtrBCrntFdbck "UNM";
BA_ "SignalLongName" SG_ 3221225472 RdctHtrBCrntFdbck "Reductant Heater B Current Feedback";
BA_ "VNSigAllNodes" SG_ 3221225472 RdctHtrACrntFdbck 1;
BA_ "SignalType" SG_ 3221225472 RdctHtrACrntFdbck "UNM";
BA_ "SignalLongName" SG_ 3221225472 RdctHtrACrntFdbck "Reductant Heater A Current Feedback";
BA_ "VNSigAllNodes" SG_ 3221225472 AltFuelLvlPrcnt 1;
BA_ "SignalType" SG_ 3221225472 AltFuelLvlPrcnt "UNM";
BA_ "SignalLongName" SG_ 3221225472 AltFuelLvlPrcnt "Alternative Fuel Level Percent";
BA_ "VNSigAllNodes" SG_ 3221225472 FuelInjCntrlModInjFltAct 1;
BA_ "SignalType" SG_ 3221225472 FuelInjCntrlModInjFltAct "BLN";
BA_ "SignalLongName" SG_ 3221225472 FuelInjCntrlModInjFltAct "Fuel Injector Control Module Injection Fault Active";
BA_ "VNSigAllNodes" SG_ 3221225472 AFRP_RailPrs 1;
BA_ "SignalType" SG_ 3221225472 AFRP_RailPrs "UNM";
BA_ "PacketOrder" SG_ 3221225472 AFRP_RailPrs 2;
BA_ "SignalLongName" SG_ 3221225472 AFRP_RailPrs "Alternative Fuel Rail Pressure : Rail Pressure";
BA_ "VNSigAllNodes" SG_ 3221225472 AFRP_SnsTyp 1;
BA_ "SignalType" SG_ 3221225472 AFRP_SnsTyp "ENM";
BA_ "PacketOrder" SG_ 3221225472 AFRP_SnsTyp 1;
BA_ "SignalLongName" SG_ 3221225472 AFRP_SnsTyp "Alternative Fuel Rail Pressure : Sensor Type";
BA_ "VNSigAllNodes" SG_ 3221225472 FICMDS3_DTCStatus 1;
BA_ "SignalType" SG_ 3221225472 FICMDS3_DTCStatus "ENM";
BA_ "PacketOrder" SG_ 3221225472 FICMDS3_DTCStatus 2;
BA_ "SignalLongName" SG_ 3221225472 FICMDS3_DTCStatus "Fuel Injector Control Module Diagnostic Status 3 : Diagnostic Trouble Code Status";
BA_ "VNSigAllNodes" SG_ 3221225472 FICMDS3_DTCIndx 1;
BA_ "SignalType" SG_ 3221225472 FICMDS3_DTCIndx "UNM";
BA_ "PacketOrder" SG_ 3221225472 FICMDS3_DTCIndx 1;
BA_ "SignalLongName" SG_ 3221225472 FICMDS3_DTCIndx "Fuel Injector Control Module Diagnostic Status 3 : Diagnostic Trouble Code Index";
BA_ "VNSigAllNodes" SG_ 3221225472 FICMDS2_DTCStatus 1;
BA_ "SignalType" SG_ 3221225472 FICMDS2_DTCStatus "ENM";
BA_ "PacketOrder" SG_ 3221225472 FICMDS2_DTCStatus 2;
BA_ "SignalLongName" SG_ 3221225472 FICMDS2_DTCStatus "Fuel Injector Control Module Diagnostic Status 2 : Diagnostic Trouble Code Status";
BA_ "VNSigAllNodes" SG_ 3221225472 FICMDS2_DTCIndx 1;
BA_ "SignalType" SG_ 3221225472 FICMDS2_DTCIndx "UNM";
BA_ "PacketOrder" SG_ 3221225472 FICMDS2_DTCIndx 1;
BA_ "SignalLongName" SG_ 3221225472 FICMDS2_DTCIndx "Fuel Injector Control Module Diagnostic Status 2 : Diagnostic Trouble Code Index";
BA_ "VNSigAllNodes" SG_ 3221225472 FICMDS1_DTCStatus 1;
BA_ "SignalType" SG_ 3221225472 FICMDS1_DTCStatus "ENM";
BA_ "PacketOrder" SG_ 3221225472 FICMDS1_DTCStatus 2;
BA_ "SignalLongName" SG_ 3221225472 FICMDS1_DTCStatus "Fuel Injector Control Module Diagnostic Status 1 : Diagnostic Trouble Code Status";
BA_ "VNSigAllNodes" SG_ 3221225472 FICMDS1_DTCIndx 1;
BA_ "SignalType" SG_ 3221225472 FICMDS1_DTCIndx "UNM";
BA_ "PacketOrder" SG_ 3221225472 FICMDS1_DTCIndx 1;
BA_ "SignalLongName" SG_ 3221225472 FICMDS1_DTCIndx "Fuel Injector Control Module Diagnostic Status 1 : Diagnostic Trouble Code Index";
BA_ "VNSigAllNodes" SG_ 3221225472 AltFuelRFuelTrmLmtOff 1;
BA_ "SignalType" SG_ 3221225472 AltFuelRFuelTrmLmtOff "SNM";
BA_ "SignalLongName" SG_ 3221225472 AltFuelRFuelTrmLmtOff "Alternative Fuel Rich Fuel Trim Limit Offset";
BA_ "VNSigAllNodes" SG_ 3221225472 AltFuelLnFuelTrmLmtOff 1;
BA_ "SignalType" SG_ 3221225472 AltFuelLnFuelTrmLmtOff "SNM";
BA_ "SignalLongName" SG_ 3221225472 AltFuelLnFuelTrmLmtOff "Alternative Fuel Lean Fuel Trim Limit Offset";
BA_ "VNSigAllNodes" SG_ 3221225472 AltFuelInjMinPlsOffst 1;
BA_ "SignalType" SG_ 3221225472 AltFuelInjMinPlsOffst "SNM";
BA_ "SignalLongName" SG_ 3221225472 AltFuelInjMinPlsOffst "Alternative Fuel Injector Min Pulse Offset";
BA_ "VNSigAllNodes" SG_ 3221225472 AltFuelInjOpnOffst 1;
BA_ "SignalType" SG_ 3221225472 AltFuelInjOpnOffst "SNM";
BA_ "SignalLongName" SG_ 3221225472 AltFuelInjOpnOffst "Alternative Fuel Injector Opening Offset";
BA_ "VNSigAllNodes" SG_ 3221225472 AltFuelInjFlwOffst 1;
BA_ "SignalType" SG_ 3221225472 AltFuelInjFlwOffst "SNM";
BA_ "SignalLongName" SG_ 3221225472 AltFuelInjFlwOffst "Alternative Fuel Injector Flow Offset";
BA_ "VNSigAllNodes" SG_ 3221225472 AltFuelEqvlntRatBsOffst 1;
BA_ "SignalType" SG_ 3221225472 AltFuelEqvlntRatBsOffst "SNM";
BA_ "SignalLongName" SG_ 3221225472 AltFuelEqvlntRatBsOffst "Alternative Fuel Equivalence Ratio Bias Offset";
BA_ "VNSigAllNodes" SG_ 3221225472 AltFuelPst02BsOffst 1;
BA_ "SignalType" SG_ 3221225472 AltFuelPst02BsOffst "SNM";
BA_ "SignalLongName" SG_ 3221225472 AltFuelPst02BsOffst "Alternative Fuel Post O2 Bias Offset";
BA_ "VNSigAllNodes" SG_ 3221225472 BattThrmlCondOffTmeV 1;
BA_ "SignalType" SG_ 3221225472 BattThrmlCondOffTmeV "ENM";
BA_ "SignalLongName" SG_ 3221225472 BattThrmlCondOffTmeV "Battery Thermal Conditioning Off Time Validity";
BA_ "VNSigAllNodes" SG_ 3221225472 BattThrmlCondOffTmeM 1;
BA_ "SignalType" SG_ 3221225472 BattThrmlCondOffTmeM "ENM";
BA_ "SignalLongName" SG_ 3221225472 BattThrmlCondOffTmeM "Battery Thermal Conditioning Off Time Mask";
BA_ "VNSigAllNodes" SG_ 3221225472 BattThrmlCondOffTme 1;
BA_ "SignalType" SG_ 3221225472 BattThrmlCondOffTme "UNM";
BA_ "SignalLongName" SG_ 3221225472 BattThrmlCondOffTme "Battery Thermal Conditioning Off Time";
BA_ "VNSigAllNodes" SG_ 3221225472 OffBrdChrgOffTmeV 1;
BA_ "SignalType" SG_ 3221225472 OffBrdChrgOffTmeV "ENM";
BA_ "SignalLongName" SG_ 3221225472 OffBrdChrgOffTmeV "Off Board Charging Off Time Validity";
BA_ "VNSigAllNodes" SG_ 3221225472 OffBrdChrgOffTmeM 1;
BA_ "SignalType" SG_ 3221225472 OffBrdChrgOffTmeM "ENM";
BA_ "SignalLongName" SG_ 3221225472 OffBrdChrgOffTmeM "Off Board Charging Off Time Mask";
BA_ "VNSigAllNodes" SG_ 3221225472 OffBrdChrgOffTme 1;
BA_ "SignalType" SG_ 3221225472 OffBrdChrgOffTme "UNM";
BA_ "SignalLongName" SG_ 3221225472 OffBrdChrgOffTme "Off Board Charging Off Time";
BA_ "VNSigAllNodes" SG_ 3221225472 RdctHtrCStat 1;
BA_ "SignalType" SG_ 3221225472 RdctHtrCStat "ENM";
BA_ "SignalLongName" SG_ 3221225472 RdctHtrCStat "Reductant Heater C Status";
BA_ "VNSigAllNodes" SG_ 3221225472 RdctHtrBStat 1;
BA_ "SignalType" SG_ 3221225472 RdctHtrBStat "ENM";
BA_ "SignalLongName" SG_ 3221225472 RdctHtrBStat "Reductant Heater B Status";
BA_ "VNSigAllNodes" SG_ 3221225472 RdctHtrAStat 1;
BA_ "SignalType" SG_ 3221225472 RdctHtrAStat "ENM";
BA_ "SignalLongName" SG_ 3221225472 RdctHtrAStat "Reductant Heater A Status";
BA_ "VNSigAllNodes" SG_ 3221225472 GPCMDS2_DTCStatus 1;
BA_ "SignalType" SG_ 3221225472 GPCMDS2_DTCStatus "ENM";
BA_ "PacketOrder" SG_ 3221225472 GPCMDS2_DTCStatus 2;
BA_ "SignalLongName" SG_ 3221225472 GPCMDS2_DTCStatus "Glow Plug Control Module Diagnostic Status 2 : Diagnostic Trouble Code Status";
BA_ "VNSigAllNodes" SG_ 3221225472 GPCMDS2_DTCIndex 1;
BA_ "SignalType" SG_ 3221225472 GPCMDS2_DTCIndex "UNM";
BA_ "PacketOrder" SG_ 3221225472 GPCMDS2_DTCIndex 1;
BA_ "SignalLongName" SG_ 3221225472 GPCMDS2_DTCIndex "Glow Plug Control Module Diagnostic Status 2 : Diagnostic Trouble Code Index";
BA_ "VNSigAllNodes" SG_ 3221225472 IntAirHtrPwrConsmp 1;
BA_ "SignalType" SG_ 3221225472 IntAirHtrPwrConsmp "UNM";
BA_ "SignalLongName" SG_ 3221225472 IntAirHtrPwrConsmp "Intake Air Heater Power Consumption";
BA_ "VNSigAllNodes" SG_ 3221225472 IntAirHtrPwrConsmpV 1;
BA_ "SignalType" SG_ 3221225472 IntAirHtrPwrConsmpV "ENM";
BA_ "SignalLongName" SG_ 3221225472 IntAirHtrPwrConsmpV "Intake Air Heater Power Consumption Validity";
BA_ "VNSigAllNodes" SG_ 3221225472 DslGlwPlgMdOvTmOD 1;
BA_ "SignalType" SG_ 3221225472 DslGlwPlgMdOvTmOD "BLN";
BA_ "SignalLongName" SG_ 3221225472 DslGlwPlgMdOvTmOD "Glow Plug Control Module Over Temperature Outputs Disabled";
BA_ "VNSigAllNodes" SG_ 3221225472 IQAI_DataByte 1;
BA_ "SignalType" SG_ 3221225472 IQAI_DataByte "UNM";
BA_ "PacketOrder" SG_ 3221225472 IQAI_DataByte 4;
BA_ "SignalLongName" SG_ 3221225472 IQAI_DataByte "Injector Quantity Adjustment Information : Data Byte";
BA_ "VNSigAllNodes" SG_ 3221225472 IQAI_DataSeqNmbr 1;
BA_ "SignalType" SG_ 3221225472 IQAI_DataSeqNmbr "UNM";
BA_ "PacketOrder" SG_ 3221225472 IQAI_DataSeqNmbr 3;
BA_ "SignalLongName" SG_ 3221225472 IQAI_DataSeqNmbr "Injector Quantity Adjustment Information : Data Sequence Number";
BA_ "VNSigAllNodes" SG_ 3221225472 IQAI_InjIdInd 1;
BA_ "SignalType" SG_ 3221225472 IQAI_InjIdInd "ENM";
BA_ "PacketOrder" SG_ 3221225472 IQAI_InjIdInd 2;
BA_ "SignalLongName" SG_ 3221225472 IQAI_InjIdInd "Injector Quantity Adjustment Information : Injector Identification Index";
BA_ "GenSigStartValue" SG_ 3221225472 IQAI_InjIdInd 1;
BA_ "VNSigAllNodes" SG_ 3221225472 IQAI_DataStat 1;
BA_ "SignalType" SG_ 3221225472 IQAI_DataStat "ENM";
BA_ "PacketOrder" SG_ 3221225472 IQAI_DataStat 1;
BA_ "SignalLongName" SG_ 3221225472 IQAI_DataStat "Injector Quantity Adjustment Information : Data Status";
BA_ "VNSigAllNodes" SG_ 3221225472 IntAirHtrTempSensVoltV 1;
BA_ "SignalType" SG_ 3221225472 IntAirHtrTempSensVoltV "ENM";
BA_ "SignalLongName" SG_ 3221225472 IntAirHtrTempSensVoltV "Intake Air Heater Temperature Sensor Voltage Validity";
BA_ "VNSigAllNodes" SG_ 3221225472 IntAirHtrTempSensVolt 1;
BA_ "SignalType" SG_ 3221225472 IntAirHtrTempSensVolt "UNM";
BA_ "SignalLongName" SG_ 3221225472 IntAirHtrTempSensVolt "Intake Air Heater Temperature Sensor Voltage";
BA_ "VNSigAllNodes" SG_ 3221225472 IntAirHtrSupVoltV 1;
BA_ "SignalType" SG_ 3221225472 IntAirHtrSupVoltV "ENM";
BA_ "SignalLongName" SG_ 3221225472 IntAirHtrSupVoltV "Intake Air Heater Supply Voltage Validity";
BA_ "VNSigAllNodes" SG_ 3221225472 IntAirHtrSupVolt 1;
BA_ "SignalType" SG_ 3221225472 IntAirHtrSupVolt "UNM";
BA_ "SignalLongName" SG_ 3221225472 IntAirHtrSupVolt "Intake Air Heater Supply Voltage";
BA_ "VNSigAllNodes" SG_ 3221225472 GPCMDS_DTCStatus 1;
BA_ "SignalType" SG_ 3221225472 GPCMDS_DTCStatus "ENM";
BA_ "PacketOrder" SG_ 3221225472 GPCMDS_DTCStatus 2;
BA_ "SignalLongName" SG_ 3221225472 GPCMDS_DTCStatus "Glow Plug Control Module Diagnostic Status : Diagnostic Trouble Code Status";
BA_ "VNSigAllNodes" SG_ 3221225472 GPCMDS_DTCIndex 1;
BA_ "SignalType" SG_ 3221225472 GPCMDS_DTCIndex "UNM";
BA_ "PacketOrder" SG_ 3221225472 GPCMDS_DTCIndex 1;
BA_ "SignalLongName" SG_ 3221225472 GPCMDS_DTCIndex "Glow Plug Control Module Diagnostic Status : Diagnostic Trouble Code Index";
BA_ "VNSigAllNodes" SG_ 3221225472 EngCoolFanOpEnbl 1;
BA_ "SignalType" SG_ 3221225472 EngCoolFanOpEnbl "BLN";
BA_ "SignalLongName" SG_ 3221225472 EngCoolFanOpEnbl "Engine Cooling Fan Operation Enable";
BA_ "VNSigAllNodes" SG_ 3221225472 DiagFreeRunCntrV 1;
BA_ "SignalType" SG_ 3221225472 DiagFreeRunCntrV "ENM";
BA_ "SignalLongName" SG_ 3221225472 DiagFreeRunCntrV "Diagnostic Free Running Counter Validity";
BA_ "VNSigAllNodes" SG_ 3221225472 DiagFreeRunCntr 1;
BA_ "SignalType" SG_ 3221225472 DiagFreeRunCntr "UNM";
BA_ "SignalLongName" SG_ 3221225472 DiagFreeRunCntr "Diagnostic Free Running Counter";
BA_ "VNSigAllNodes" SG_ 3221225472 HybFanSpdRq 1;
BA_ "SignalType" SG_ 3221225472 HybFanSpdRq "UNM";
BA_ "SignalLongName" SG_ 3221225472 HybFanSpdRq "Hybrid Fan Speed Percent Request";
BA_ "VNSigAllNodes" SG_ 3221225472 TransDirctnStV 1;
BA_ "SignalType" SG_ 3221225472 TransDirctnStV "ENM";
BA_ "SignalLongName" SG_ 3221225472 TransDirctnStV "Transmission Direction State Validity";
BA_ "VNSigAllNodes" SG_ 3221225472 TransDirctnSt 1;
BA_ "SignalType" SG_ 3221225472 TransDirctnSt "ENM";
BA_ "SignalLongName" SG_ 3221225472 TransDirctnSt "Transmission Direction State";
BA_ "GenSigSendOnInit" SG_ 3221225472 AuxClntHtrVlvStat 1;
BA_ "GenSigSendType" SG_ 3221225472 AuxClntHtrVlvStat 10;
BA_ "VNSigAllNodes" SG_ 3221225472 AuxClntHtrVlvStat 1;
BA_ "SignalType" SG_ 3221225472 AuxClntHtrVlvStat "ENM";
BA_ "SignalLongName" SG_ 3221225472 AuxClntHtrVlvStat "Auxiliary Coolant Heater Valve Status";
BA_ "GenSigSendType" SG_ 3221225472 FCAHptcStVbnRqSeqN 12;
BA_ "GenSigDeltaValue" SG_ 3221225472 FCAHptcStVbnRqSeqN 1;
BA_ "VNSigAllNodes" SG_ 3221225472 FCAHptcStVbnRqSeqN 1;
BA_ "SignalType" SG_ 3221225472 FCAHptcStVbnRqSeqN "UNM";
BA_ "SignalLongName" SG_ 3221225472 FCAHptcStVbnRqSeqN "Forward Collision Alert Haptic Seat Vibration Request Sequence Number";
BA_ "GenSigSendType" SG_ 3221225472 FCAHptcStVbnReq 12;
BA_ "GenSigDeltaValue" SG_ 3221225472 FCAHptcStVbnReq 1;
BA_ "VNSigAllNodes" SG_ 3221225472 FCAHptcStVbnReq 1;
BA_ "SignalType" SG_ 3221225472 FCAHptcStVbnReq "UNM";
BA_ "SignalLongName" SG_ 3221225472 FCAHptcStVbnReq "Forward Collision Alert Haptic Seat Vibration Request";
BA_ "GenSigSendOnInit" SG_ 3221225472 ClimCtrlHVDvcShtdwnCmd 1;
BA_ "GenSigSendType" SG_ 3221225472 ClimCtrlHVDvcShtdwnCmd 10;
BA_ "GenSigDeltaValue" SG_ 3221225472 ClimCtrlHVDvcShtdwnCmd 1;
BA_ "VNSigAllNodes" SG_ 3221225472 ClimCtrlHVDvcShtdwnCmd 1;
BA_ "SignalType" SG_ 3221225472 ClimCtrlHVDvcShtdwnCmd "BLN";
BA_ "SignalLongName" SG_ 3221225472 ClimCtrlHVDvcShtdwnCmd "Climate Control High Voltage Device Shutdown Commanded";
BA_ "GenSigSendOnInit" SG_ 3221225472 ThrmlRefCompSpdV 1;
BA_ "GenSigSendType" SG_ 3221225472 ThrmlRefCompSpdV 10;
BA_ "VNSigAllNodes" SG_ 3221225472 ThrmlRefCompSpdV 1;
BA_ "SignalType" SG_ 3221225472 ThrmlRefCompSpdV "ENM";
BA_ "SignalLongName" SG_ 3221225472 ThrmlRefCompSpdV "Thermal Refrigerant Compressor Speed Validity";
BA_ "GenSigSendOnInit" SG_ 3221225472 ThrmlRefCompSpd 1;
BA_ "GenSigSendType" SG_ 3221225472 ThrmlRefCompSpd 12;
BA_ "GenSigDeltaValue" SG_ 3221225472 ThrmlRefCompSpd 1;
BA_ "VNSigAllNodes" SG_ 3221225472 ThrmlRefCompSpd 1;
BA_ "SignalType" SG_ 3221225472 ThrmlRefCompSpd "UNM";
BA_ "SignalLongName" SG_ 3221225472 ThrmlRefCompSpd "Thermal Refrigerant Compressor Speed";
BA_ "VNSigAllNodes" SG_ 3221225472 PTOTpStpSpdCsStAvl 1;
BA_ "SignalType" SG_ 3221225472 PTOTpStpSpdCsStAvl "BLN";
BA_ "SignalLongName" SG_ 3221225472 PTOTpStpSpdCsStAvl "Power Take Off Tap Step Speed Customization Setting Available";
BA_ "VNSigAllNodes" SG_ 3221225472 PTOTpStSpdCsCrStVal 1;
BA_ "SignalType" SG_ 3221225472 PTOTpStSpdCsCrStVal "ENM";
BA_ "SignalLongName" SG_ 3221225472 PTOTpStSpdCsCrStVal "Power Take Off Tap Step Speed Customization Current Setting Value";
BA_ "VNSigAllNodes" SG_ 3221225472 PTOStdbySpdCsStAvl 1;
BA_ "SignalType" SG_ 3221225472 PTOStdbySpdCsStAvl "BLN";
BA_ "SignalLongName" SG_ 3221225472 PTOStdbySpdCsStAvl "Power Take Off Standby Speed Customization Setting Available";
VAL_ 3221225472 ChrgSysAudblIndRq 7 "Unused and Reserved3" 6 "Unused and Reserved2" 5 "Unused and Reserved1" 4 "Sequence 4" 3 "Sequence 3" 2 "Sequence 2" 1 "Sequence 1" 0 "Inactive" ;
VAL_ 3221225472 RdHVBatLwParMdReq 1 "true" 0 "false" ;
VAL_ 3221225472 RdHVBtClOVFFTstRq 1 "true" 0 "false" ;
VAL_ 3221225472 VICMHVEnMgCmEnTrS 0 "Inactive" 1 "Active" ;
VAL_ 3221225472 HybVehHiVltSysDisbld_236 1 "true" 0 "false" ;
VAL_ 3221225472 DTCI_DTCFaultType_771 3 "Type C" 2 "Type B" 1 "Type A" 0 "Not Supported" ;
VAL_ 3221225472 DTCI_CodeSupported_771 1 "true" 0 "false" ;
VAL_ 3221225472 DTCI_CurrentStatus_771 1 "true" 0 "false" ;
VAL_ 3221225472 DTCI_TstNPsdCdClrdSt_771 1 "true" 0 "false" ;
VAL_ 3221225472 DTCI_TstFldCdClrdStat_771 1 "true" 0 "false" ;
VAL_ 3221225472 DTCI_HistStat_771 1 "true" 0 "false" ;
VAL_ 3221225472 DTCI_TstNPsdPwrUpSt_771 1 "true" 0 "false" ;
VAL_ 3221225472 DTCI_TstFldPwrUpSt_771 1 "true" 0 "false" ;
VAL_ 3221225472 DTCI_WrnIndRqdSt_771 1 "true" 0 "false" ;
VAL_ 3221225472 DTCI_DTCTriggered_771 1 "true" 0 "false" ;
VAL_ 3221225472 DTCIUnused7_771 1 "true" 0 "false" ;
VAL_ 3221225472 DTCIUnused6_771 1 "true" 0 "false" ;
VAL_ 3221225472 DTCIUnused5_771 1 "true" 0 "false" ;
VAL_ 3221225472 DTCIUnused4_771 1 "true" 0 "false" ;
VAL_ 3221225472 DTCIUnused3_771 1 "true" 0 "false" ;
VAL_ 3221225472 DTCIUnused2_771 1 "true" 0 "false" ;
VAL_ 3221225472 DTCIUnused1_771 1 "true" 0 "false" ;
VAL_ 3221225472 DTCI_DTCTriggered_78F 1 "true" 0 "false" ;
VAL_ 3221225472 DTCIUnused1_78F 1 "true" 0 "false" ;
VAL_ 3221225472 DTCIUnused2_78F 1 "true" 0 "false" ;
VAL_ 3221225472 DTCIUnused3_78F 1 "true" 0 "false" ;
VAL_ 3221225472 DTCIUnused4_78F 1 "true" 0 "false" ;
VAL_ 3221225472 DTCIUnused5_78F 1 "true" 0 "false" ;
VAL_ 3221225472 DTCIUnused6_78F 1 "true" 0 "false" ;
VAL_ 3221225472 DTCIUnused7_78F 1 "true" 0 "false" ;
VAL_ 3221225472 DTCI_CodeSupported_78F 1 "true" 0 "false" ;
VAL_ 3221225472 DTCI_CurrentStatus_78F 1 "true" 0 "false" ;
VAL_ 3221225472 DTCI_DTCFaultType_78F 3 "Type C" 2 "Type B" 1 "Type A" 0 "Not Supported" ;
VAL_ 3221225472 DTCI_TstFldCdClrdStat_78F 1 "true" 0 "false" ;
VAL_ 3221225472 DTCI_TstNPsdCdClrdSt_78F 1 "true" 0 "false" ;
VAL_ 3221225472 DTCI_HistStat_78F 1 "true" 0 "false" ;
VAL_ 3221225472 DTCI_TstNPsdPwrUpSt_78F 1 "true" 0 "false" ;
VAL_ 3221225472 DTCI_TstFldPwrUpSt_78F 1 "true" 0 "false" ;
VAL_ 3221225472 DTCI_WrnIndRqdSt_78F 1 "true" 0 "false" ;
VAL_ 3221225472 DTCI_CodeSupported_78E 1 "true" 0 "false" ;
VAL_ 3221225472 DTCI_CurrentStatus_78E 1 "true" 0 "false" ;
VAL_ 3221225472 DTCI_DTCFaultType_78E 3 "Type C" 2 "Type B" 1 "Type A" 0 "Not Supported" ;
VAL_ 3221225472 DTCI_DTCTriggered_78E 1 "true" 0 "false" ;
VAL_ 3221225472 DTCI_TstFldPwrUpSt_78C 1 "true" 0 "false" ;
VAL_ 3221225472 DTCI_TstNPsdCdClrdSt_78C 1 "true" 0 "false" ;
VAL_ 3221225472 DTCI_TstNPsdPwrUpSt_78C 1 "true" 0 "false" ;
VAL_ 3221225472 DTCIUnused1_78C 1 "true" 0 "false" ;
VAL_ 3221225472 DTCIUnused2_78C 1 "true" 0 "false" ;
VAL_ 3221225472 DTCIUnused3_78C 1 "true" 0 "false" ;
VAL_ 3221225472 DTCIUnused4_78C 1 "true" 0 "false" ;
VAL_ 3221225472 DTCIUnused5_78C 1 "true" 0 "false" ;
VAL_ 3221225472 DTCIUnused6_78C 1 "true" 0 "false" ;
VAL_ 3221225472 DTCIUnused7_78C 1 "true" 0 "false" ;
VAL_ 3221225472 DTCI_WrnIndRqdSt_78C 1 "true" 0 "false" ;
VAL_ 3221225472 DTCI_CodeSupported_789 1 "true" 0 "false" ;
VAL_ 3221225472 DTCI_CurrentStatus_789 1 "true" 0 "false" ;
VAL_ 3221225472 DTCI_DTCFaultType_789 3 "Type C" 2 "Type B" 1 "Type A" 0 "Not Supported" ;
VAL_ 3221225472 DTCI_DTCTriggered_789 1 "true" 0 "false" ;
VAL_ 3221225472 DTCI_HistStat_789 1 "true" 0 "false" ;
VAL_ 3221225472 DTCI_TstFldCdClrdStat_789 1 "true" 0 "false" ;
VAL_ 3221225472 DTCI_TstFldPwrUpSt_789 1 "true" 0 "false" ;
VAL_ 3221225472 DTCI_TstNPsdCdClrdSt_789 1 "true" 0 "false" ;
VAL_ 3221225472 DTCI_TstNPsdPwrUpSt_789 1 "true" 0 "false" ;
VAL_ 3221225472 DTCIUnused1_789 1 "true" 0 "false" ;
VAL_ 3221225472 DTCIUnused2_789 1 "true" 0 "false" ;
VAL_ 3221225472 DTCIUnused3_789 1 "true" 0 "false" ;
VAL_ 3221225472 DTCIUnused4_789 1 "true" 0 "false" ;
VAL_ 3221225472 DTCIUnused5_789 1 "true" 0 "false" ;
VAL_ 3221225472 DTCIUnused6_789 1 "true" 0 "false" ;
VAL_ 3221225472 DTCIUnused7_789 1 "true" 0 "false" ;
VAL_ 3221225472 DTCI_WrnIndRqdSt_789 1 "true" 0 "false" ;
VAL_ 3221225472 DTCI_CodeSupported_787 1 "true" 0 "false" ;
VAL_ 3221225472 DTCI_CurrentStatus_787 1 "true" 0 "false" ;
VAL_ 3221225472 DTCI_DTCFaultType_787 3 "Type C" 2 "Type B" 1 "Type A" 0 "Not Supported" ;
VAL_ 3221225472 DTCI_DTCTriggered_787 1 "true" 0 "false" ;
VAL_ 3221225472 DTCI_HistStat_787 1 "true" 0 "false" ;
VAL_ 3221225472 DTCI_TstFldCdClrdStat_787 1 "true" 0 "false" ;
VAL_ 3221225472 DTCI_TstFldPwrUpSt_787 1 "true" 0 "false" ;
VAL_ 3221225472 DTCI_TstNPsdCdClrdSt_787 1 "true" 0 "false" ;
VAL_ 3221225472 DTCI_TstNPsdPwrUpSt_787 1 "true" 0 "false" ;
VAL_ 3221225472 DTCIUnused1_787 1 "true" 0 "false" ;
VAL_ 3221225472 DTCI_HistStat_78E 1 "true" 0 "false" ;
VAL_ 3221225472 DTCI_TstFldCdClrdStat_78E 1 "true" 0 "false" ;
VAL_ 3221225472 DTCI_TstFldPwrUpSt_78E 1 "true" 0 "false" ;
VAL_ 3221225472 DTCI_TstNPsdCdClrdSt_78E 1 "true" 0 "false" ;
VAL_ 3221225472 DTCI_TstNPsdPwrUpSt_78E 1 "true" 0 "false" ;
VAL_ 3221225472 DTCIUnused1_78E 1 "true" 0 "false" ;
VAL_ 3221225472 DTCIUnused2_78E 1 "true" 0 "false" ;
VAL_ 3221225472 DTCIUnused3_78E 1 "true" 0 "false" ;
VAL_ 3221225472 DTCIUnused4_78E 1 "true" 0 "false" ;
VAL_ 3221225472 DTCIUnused5_78E 1 "true" 0 "false" ;
VAL_ 3221225472 DTCIUnused6_78E 1 "true" 0 "false" ;
VAL_ 3221225472 DTCIUnused7_78E 1 "true" 0 "false" ;
VAL_ 3221225472 DTCI_WrnIndRqdSt_78E 1 "true" 0 "false" ;
VAL_ 3221225472 DTCI_CodeSupported_78D 1 "true" 0 "false" ;
VAL_ 3221225472 DTCI_CurrentStatus_78D 1 "true" 0 "false" ;
VAL_ 3221225472 DTCI_DTCFaultType_78D 3 "Type C" 2 "Type B" 1 "Type A" 0 "Not Supported" ;
VAL_ 3221225472 DTCI_DTCTriggered_78D 1 "true" 0 "false" ;
VAL_ 3221225472 DTCI_HistStat_78D 1 "true" 0 "false" ;
VAL_ 3221225472 DTCIUnused2_787 1 "true" 0 "false" ;
VAL_ 3221225472 DTCIUnused3_787 1 "true" 0 "false" ;
VAL_ 3221225472 DTCIUnused4_787 1 "true" 0 "false" ;
VAL_ 3221225472 DTCIUnused5_787 1 "true" 0 "false" ;
VAL_ 3221225472 DTCIUnused6_787 1 "true" 0 "false" ;
VAL_ 3221225472 DTCIUnused7_787 1 "true" 0 "false" ;
VAL_ 3221225472 DTCI_WrnIndRqdSt_787 1 "true" 0 "false" ;
VAL_ 3221225472 DTCI_CodeSupported_786 1 "true" 0 "false" ;
VAL_ 3221225472 DTCI_CurrentStatus_786 1 "true" 0 "false" ;
VAL_ 3221225472 DTCI_DTCFaultType_786 3 "Type C" 2 "Type B" 1 "Type A" 0 "Not Supported" ;
VAL_ 3221225472 DTCI_DTCTriggered_786 1 "true" 0 "false" ;
VAL_ 3221225472 DTCI_HistStat_786 1 "true" 0 "false" ;
VAL_ 3221225472 DTCI_TstFldCdClrdStat_786 1 "true" 0 "false" ;
VAL_ 3221225472 DTCI_TstFldPwrUpSt_786 1 "true" 0 "false" ;
VAL_ 3221225472 DTCI_TstNPsdCdClrdSt_786 1 "true" 0 "false" ;
VAL_ 3221225472 DTCI_TstNPsdPwrUpSt_786 1 "true" 0 "false" ;
VAL_ 3221225472 DTCIUnused1_786 1 "true" 0 "false" ;
VAL_ 3221225472 DTCIUnused2_786 1 "true" 0 "false" ;
VAL_ 3221225472 DTCIUnused3_786 1 "true" 0 "false" ;
VAL_ 3221225472 DTCIUnused4_786 1 "true" 0 "false" ;
VAL_ 3221225472 DTCIUnused5_786 1 "true" 0 "false" ;
VAL_ 3221225472 DTCIUnused6_786 1 "true" 0 "false" ;
VAL_ 3221225472 DTCIUnused7_786 1 "true" 0 "false" ;
VAL_ 3221225472 DTCI_WrnIndRqdSt_786 1 "true" 0 "false" ;
VAL_ 3221225472 DTCI_HistStat_784 1 "true" 0 "false" ;
VAL_ 3221225472 DTCI_TstFldCdClrdStat_784 1 "true" 0 "false" ;
VAL_ 3221225472 DTCI_TstFldPwrUpSt_784 1 "true" 0 "false" ;
VAL_ 3221225472 DTCI_TstNPsdCdClrdSt_784 1 "true" 0 "false" ;
VAL_ 3221225472 DTCI_TstNPsdPwrUpSt_784 1 "true" 0 "false" ;
VAL_ 3221225472 DTCIUnused1_784 1 "true" 0 "false" ;
VAL_ 3221225472 DTCIUnused2_784 1 "true" 0 "false" ;
VAL_ 3221225472 DTCIUnused3_784 1 "true" 0 "false" ;
VAL_ 3221225472 DTCIUnused4_784 1 "true" 0 "false" ;
VAL_ 3221225472 DTCIUnused5_784 1 "true" 0 "false" ;
VAL_ 3221225472 DTCIUnused6_784 1 "true" 0 "false" ;
VAL_ 3221225472 DTCIUnused7_784 1 "true" 0 "false" ;
VAL_ 3221225472 DTCI_WrnIndRqdSt_784 1 "true" 0 "false" ;
VAL_ 3221225472 DTCI_CodeSupported_784 1 "true" 0 "false" ;
VAL_ 3221225472 DTCI_CurrentStatus_784 1 "true" 0 "false" ;
VAL_ 3221225472 DTCI_DTCFaultType_784 3 "Type C" 2 "Type B" 1 "Type A" 0 "Not Supported" ;
VAL_ 3221225472 DTCI_DTCFaultType_774 3 "Type C" 2 "Type B" 1 "Type A" 0 "Not Supported" ;
VAL_ 3221225472 DTCI_CodeSupported_774 1 "true" 0 "false" ;
VAL_ 3221225472 DTCI_CurrentStatus_774 1 "true" 0 "false" ;
VAL_ 3221225472 DTCI_TstNPsdCdClrdSt_774 1 "true" 0 "false" ;
VAL_ 3221225472 DTCI_TstFldCdClrdStat_774 1 "true" 0 "false" ;
VAL_ 3221225472 DTCI_HistStat_774 1 "true" 0 "false" ;
VAL_ 3221225472 DTCI_TstNPsdPwrUpSt_774 1 "true" 0 "false" ;
VAL_ 3221225472 DTCI_TstFldPwrUpSt_774 1 "true" 0 "false" ;
VAL_ 3221225472 DTCI_WrnIndRqdSt_774 1 "true" 0 "false" ;
VAL_ 3221225472 DTCI_DTCTriggered_774 1 "true" 0 "false" ;
VAL_ 3221225472 DTCIUnused7_774 1 "true" 0 "false" ;
VAL_ 3221225472 DTCIUnused6_774 1 "true" 0 "false" ;
VAL_ 3221225472 DTCIUnused5_774 1 "true" 0 "false" ;
VAL_ 3221225472 DTCIUnused4_774 1 "true" 0 "false" ;
VAL_ 3221225472 DTCIUnused3_774 1 "true" 0 "false" ;
VAL_ 3221225472 DTCIUnused2_774 1 "true" 0 "false" ;
VAL_ 3221225472 DTCIUnused1_774 1 "true" 0 "false" ;
VAL_ 3221225472 DTCI_DTCFaultType_779 3 "Type C" 2 "Type B" 1 "Type A" 0 "Not Supported" ;
VAL_ 3221225472 DTCI_CodeSupported_779 1 "true" 0 "false" ;
VAL_ 3221225472 DTCI_CurrentStatus_779 1 "true" 0 "false" ;
VAL_ 3221225472 DTCI_TstNPsdCdClrdSt_779 1 "true" 0 "false" ;
VAL_ 3221225472 DTCI_TstFldCdClrdStat_779 1 "true" 0 "false" ;
VAL_ 3221225472 DTCI_HistStat_779 1 "true" 0 "false" ;
VAL_ 3221225472 DTCI_TstNPsdPwrUpSt_779 1 "true" 0 "false" ;
VAL_ 3221225472 DTCI_TstFldPwrUpSt_779 1 "true" 0 "false" ;
VAL_ 3221225472 DTCI_WrnIndRqdSt_779 1 "true" 0 "false" ;
VAL_ 3221225472 DTCI_DTCTriggered_779 1 "true" 0 "false" ;
VAL_ 3221225472 DTCIUnused7_779 1 "true" 0 "false" ;
VAL_ 3221225472 DTCIUnused6_779 1 "true" 0 "false" ;
VAL_ 3221225472 DTCIUnused5_779 1 "true" 0 "false" ;
VAL_ 3221225472 DTCIUnused4_779 1 "true" 0 "false" ;
VAL_ 3221225472 DTCIUnused3_779 1 "true" 0 "false" ;
VAL_ 3221225472 DTCIUnused2_779 1 "true" 0 "false" ;
VAL_ 3221225472 DTCIUnused1_779 1 "true" 0 "false" ;
VAL_ 3221225472 DTCI_TstFldCdClrdStat_78D 1 "true" 0 "false" ;
VAL_ 3221225472 DTCI_TstFldPwrUpSt_78D 1 "true" 0 "false" ;
VAL_ 3221225472 DTCI_TstNPsdCdClrdSt_78D 1 "true" 0 "false" ;
VAL_ 3221225472 DTCI_TstNPsdPwrUpSt_78D 1 "true" 0 "false" ;
VAL_ 3221225472 DTCIUnused1_78D 1 "true" 0 "false" ;
VAL_ 3221225472 DTCIUnused2_78D 1 "true" 0 "false" ;
VAL_ 3221225472 DTCIUnused3_78D 1 "true" 0 "false" ;
VAL_ 3221225472 DTCIUnused4_78D 1 "true" 0 "false" ;
VAL_ 3221225472 DTCIUnused5_78D 1 "true" 0 "false" ;
VAL_ 3221225472 DTCIUnused6_78D 1 "true" 0 "false" ;
VAL_ 3221225472 DTCIUnused7_78D 1 "true" 0 "false" ;
VAL_ 3221225472 DTCI_WrnIndRqdSt_78D 1 "true" 0 "false" ;
VAL_ 3221225472 DTCI_CodeSupported_78C 1 "true" 0 "false" ;
VAL_ 3221225472 DTCI_CurrentStatus_78C 1 "true" 0 "false" ;
VAL_ 3221225472 DTCI_DTCFaultType_78C 3 "Type C" 2 "Type B" 1 "Type A" 0 "Not Supported" ;
VAL_ 3221225472 DTCI_DTCTriggered_78C 1 "true" 0 "false" ;
VAL_ 3221225472 DTCI_HistStat_78C 1 "true" 0 "false" ;
VAL_ 3221225472 DTCI_TstFldCdClrdStat_78C 1 "true" 0 "false" ;
VAL_ 3221225472 DTCI_DTCTriggered_784 1 "true" 0 "false" ;
VAL_ 3221225472 DTCI_DTCFaultType_775 3 "Type C" 2 "Type B" 1 "Type A" 0 "Not Supported" ;
VAL_ 3221225472 DTCI_CodeSupported_775 1 "true" 0 "false" ;
VAL_ 3221225472 DTCI_CurrentStatus_775 1 "true" 0 "false" ;
VAL_ 3221225472 DTCI_TstNPsdCdClrdSt_775 1 "true" 0 "false" ;
VAL_ 3221225472 DTCI_TstFldCdClrdStat_775 1 "true" 0 "false" ;
VAL_ 3221225472 DTCI_HistStat_775 1 "true" 0 "false" ;
VAL_ 3221225472 DTCI_TstNPsdPwrUpSt_775 1 "true" 0 "false" ;
VAL_ 3221225472 DTCI_TstFldPwrUpSt_775 1 "true" 0 "false" ;
VAL_ 3221225472 DTCI_WrnIndRqdSt_775 1 "true" 0 "false" ;
VAL_ 3221225472 DTCI_DTCTriggered_775 1 "true" 0 "false" ;
VAL_ 3221225472 DTCIUnused7_775 1 "true" 0 "false" ;
VAL_ 3221225472 DTCIUnused6_775 1 "true" 0 "false" ;
VAL_ 3221225472 DTCIUnused5_775 1 "true" 0 "false" ;
VAL_ 3221225472 DTCIUnused4_775 1 "true" 0 "false" ;
VAL_ 3221225472 DTCIUnused3_775 1 "true" 0 "false" ;
VAL_ 3221225472 DTCIUnused2_775 1 "true" 0 "false" ;
VAL_ 3221225472 DTCIUnused1_775 1 "true" 0 "false" ;
VAL_ 3221225472 DTCI_HistStat_783 1 "true" 0 "false" ;
VAL_ 3221225472 DTCI_DTCTriggered_783 1 "true" 0 "false" ;
VAL_ 3221225472 DTCI_DTCFaultType_783 3 "Type C" 2 "Type B" 1 "Type A" 0 "Not Supported" ;
VAL_ 3221225472 DTCI_CurrentStatus_783 1 "true" 0 "false" ;
VAL_ 3221225472 DTCI_CodeSupported_783 1 "true" 0 "false" ;
VAL_ 3221225472 DTCIUnused7_783 1 "true" 0 "false" ;
VAL_ 3221225472 DTCIUnused6_783 1 "true" 0 "false" ;
VAL_ 3221225472 DTCIUnused5_783 1 "true" 0 "false" ;
VAL_ 3221225472 DTCIUnused4_783 1 "true" 0 "false" ;
VAL_ 3221225472 DTCIUnused3_783 1 "true" 0 "false" ;
VAL_ 3221225472 DTCIUnused2_783 1 "true" 0 "false" ;
VAL_ 3221225472 DTCIUnused1_783 1 "true" 0 "false" ;
VAL_ 3221225472 DTCI_WrnIndRqdSt_783 1 "true" 0 "false" ;
VAL_ 3221225472 DTCI_TstNPsdPwrUpSt_783 1 "true" 0 "false" ;
VAL_ 3221225472 DTCI_TstNPsdCdClrdSt_783 1 "true" 0 "false" ;
VAL_ 3221225472 DTCI_TstFldPwrUpSt_783 1 "true" 0 "false" ;
VAL_ 3221225472 DTCI_TstFldCdClrdStat_783 1 "true" 0 "false" ;
VAL_ 3221225472 DTCI_DTCFaultType_77E 3 "Type C" 2 "Type B" 1 "Type A" 0 "Not Supported" ;
VAL_ 3221225472 DTCI_CodeSupported_77E 1 "true" 0 "false" ;
VAL_ 3221225472 DTCI_CurrentStatus_77E 1 "true" 0 "false" ;
VAL_ 3221225472 DTCI_TstNPsdCdClrdSt_77E 1 "true" 0 "false" ;
VAL_ 3221225472 DTCI_TstFldCdClrdStat_77E 1 "true" 0 "false" ;
VAL_ 3221225472 DTCI_HistStat_77E 1 "true" 0 "false" ;
VAL_ 3221225472 DTCI_TstNPsdPwrUpSt_77E 1 "true" 0 "false" ;
VAL_ 3221225472 DTCI_TstFldPwrUpSt_77E 1 "true" 0 "false" ;
VAL_ 3221225472 DTCI_WrnIndRqdSt_77E 1 "true" 0 "false" ;
VAL_ 3221225472 DTCI_DTCTriggered_77E 1 "true" 0 "false" ;
VAL_ 3221225472 DTCIUnused7_77E 1 "true" 0 "false" ;
VAL_ 3221225472 DTCIUnused6_77E 1 "true" 0 "false" ;
VAL_ 3221225472 DTCIUnused5_77E 1 "true" 0 "false" ;
VAL_ 3221225472 DTCIUnused4_77E 1 "true" 0 "false" ;
VAL_ 3221225472 DTCIUnused3_77E 1 "true" 0 "false" ;
VAL_ 3221225472 DTCIUnused2_77E 1 "true" 0 "false" ;
VAL_ 3221225472 DTCIUnused1_77E 1 "true" 0 "false" ;
VAL_ 3221225472 DTCI_DTCFaultType_777 3 "Type C" 2 "Type B" 1 "Type A" 0 "Not Supported" ;
VAL_ 3221225472 DTCI_CodeSupported_777 1 "true" 0 "false" ;
VAL_ 3221225472 DTCI_CurrentStatus_777 1 "true" 0 "false" ;
VAL_ 3221225472 DTCI_TstNPsdCdClrdSt_777 1 "true" 0 "false" ;
VAL_ 3221225472 DTCI_TstFldCdClrdStat_777 1 "true" 0 "false" ;
VAL_ 3221225472 DTCI_HistStat_777 1 "true" 0 "false" ;
VAL_ 3221225472 DTCI_TstNPsdPwrUpSt_777 1 "true" 0 "false" ;
VAL_ 3221225472 DTCI_TstFldPwrUpSt_777 1 "true" 0 "false" ;
VAL_ 3221225472 DTCI_WrnIndRqdSt_777 1 "true" 0 "false" ;
VAL_ 3221225472 DTCI_DTCTriggered_777 1 "true" 0 "false" ;
VAL_ 3221225472 DTCIUnused7_777 1 "true" 0 "false" ;
VAL_ 3221225472 DTCIUnused6_777 1 "true" 0 "false" ;
VAL_ 3221225472 DTCIUnused5_777 1 "true" 0 "false" ;
VAL_ 3221225472 PTOAudExtAlertReq 1 "true" 0 "false" ;
VAL_ 3221225472 HybEstTransOilTmpM 1 "Use Data" 0 "Dont Use Data" ;
VAL_ 3221225472 TransCltch5FillCmd 0 "Exhaust Clutch" 1 "Fill Clutch" 2 "Lock Clutch" 3 "Prefill Clutch" ;
VAL_ 3221225472 TransCltch4FillCmd 0 "Exhaust Clutch" 1 "Fill Clutch" 2 "Lock Clutch" 3 "Prefill Clutch" ;
VAL_ 3221225472 TransCltch1FillCmd 0 "Exhaust Clutch" 1 "Fill Clutch" 2 "Lock Clutch" 3 "Prefill Clutch" ;
VAL_ 3221225472 TransCltch5CntlRq 3 "Locked" 2 "Passive Control" 1 "Active Control" 0 "No Control" ;
VAL_ 3221225472 TransCltch4CntlRq 3 "Locked" 2 "Passive Control" 1 "Active Control" 0 "No Control" ;
VAL_ 3221225472 TransCltch3CntlRq 3 "Locked" 2 "Passive Control" 1 "Active Control" 0 "No Control" ;
VAL_ 3221225472 TransCltch2CntlRq 3 "Locked" 2 "Passive Control" 1 "Active Control" 0 "No Control" ;
VAL_ 3221225472 TransCltch1CntlRq 3 "Locked" 2 "Passive Control" 1 "Active Control" 0 "No Control" ;
VAL_ 3221225472 TransAuxPmpPresDetcd 1 "true" 0 "false" ;
VAL_ 3221225472 TransCltch3FillCmd 0 "Exhaust Clutch" 1 "Fill Clutch" 2 "Lock Clutch" 3 "Prefill Clutch" ;
VAL_ 3221225472 DTCIUnused4_777 1 "true" 0 "false" ;
VAL_ 3221225472 DTCIUnused3_777 1 "true" 0 "false" ;
VAL_ 3221225472 DTCIUnused2_777 1 "true" 0 "false" ;
VAL_ 3221225472 DTCIUnused1_777 1 "true" 0 "false" ;
VAL_ 3221225472 EBrkAstStat 7 "Faulted" 6 "Temporarily Failed" 5 "Unused and Reserved 3" 4 "Unused and Reserved 2" 3 "Unused and Reserved 1" 2 "Normal" 1 "Initializing" 0 "Not Initialized" ;
VAL_ 3221225472 Sig1877 1 "true" 0 "false" ;
VAL_ 3221225472 TransCltch2FillCmd 0 "Exhaust Clutch" 1 "Fill Clutch" 2 "Lock Clutch" 3 "Prefill Clutch" ;
VAL_ 3221225472 HybTransStCmmnd 0 "Neutral" 1 "Mode 1" 2 "Mode 2" 3 "Mode 3" 4 "Mode 4" 5 "Gear 1" 6 "Gear 2" 7 "Gear 3" 8 "Gear 4" 9 "Pseudo Gear 1" 10 "Unused and Reserved 2" 11 "Unused and Reserved 3" 12 "Unused and Reserved 4" 13 "Unused and Reserved 5" 14 "Unused and Reserved 6" 15 "Unused and Reserved 7" ;
VAL_ 3221225472 HybTransStAchvd 0 "Neutral Stable State" 1 "EVT Mode 1 Stable State" 2 "EVT Mode 2 Stable State" 3 "EVT Mode 3 Stable State" 4 "EVT Mode 4 Stable State" 5 "Gear 1 Stable State" 6 "Gear 2 Stable State" 7 "Gear 3 Stable State" 8 "Gear 4 Stable State" 9 "Pseudo Gear 1 Stable State" 10 "Unused and Reserved 2" 11 "Unused and Reserved 3" 12 "Unused and Reserved 4" 13 "Unused and Reserved 5" 14 "Unused and Reserved 6" 15 "Unused and Reserved 7" ;
VAL_ 3221225472 TransFldPmpCmd 0 "Normal" 1 "Prime On" 2 "Off" 3 "On" ;
VAL_ 3221225472 TnsClchFlLnePrsBstRq 1 "true" 0 "false" ;
VAL_ 3221225472 TransAuxPumpAvail 1 "true" 0 "false" ;
VAL_ 3221225472 MtrBSpdV 1 "Invalid" 0 "Valid" ;
VAL_ 3221225472 MtrASpdV 1 "Invalid" 0 "Valid" ;
VAL_ 3221225472 HybColdSoakTempM 0 "Don't Use Data" 1 "Use Data" ;
VAL_ 3221225472 BrkSyCtl2EmsRldMlfAct 1 "true" 0 "false" ;
VAL_ 3221225472 BSC2ERDTC_SysDes 15 "U3-Network Codes Reserved" 14 "U2-Network Codes Reserved" 13 "U1-Network Codes MFG Controlled" 12 "U0-Network Codes SAE Controlled" 11 "B3-Body Codes Reserved" 10 "B2-Body Codes Reserved" 9 "B1-Body Codes MFG Controlled" 8 "B0-Body Codes SAE Controlled" 7 "C3-Chassis Codes Reserved" 6 "C2-Chassis Codes Reserved" 5 "C1-Chassis Codes MFG Controlled" 4 "C0-Chassis Codes SAE Controlled" 3 "P3-Powertrain Codes Reserved" 2 "P2-Powertrain Codes Reserved" 1 "P1-Powertrain Codes MFG Controlled" 0 "P0-Powertrain Codes SAE Controlled" ;
VAL_ 3221225472 RdGasFuelDevDisStat 3 "Reserved" 2 "Fault" 1 "Not Faulted" 0 "state0805" ;
VAL_ 3221225472 RdFInjCtrlMdIFltAct 1 "true" 0 "false" ;
VAL_ 3221225472 RdDistFuelMdReq 5 "Fault Transition Required" 4 "Fault Transition Requested" 3 "FICM" 2 "Dual" 1 "ECM" 0 "state0805" ;
VAL_ 3221225472 RdDistFuelMdCmdRes 3 "FICM" 2 "Dual" 1 "ECM" 0 "state0805" ;
VAL_ 3221225472 RdAltFuelSysStat 3 "Reserved" 2 "Fuel System Ready" 1 "Fuel System Priming" 0 "Fuel System Inactive" ;
VAL_ 3221225472 AltFuelInjRCRstOcc 1 "true" 0 "false" ;
VAL_ 3221225472 CltTmpCntlMdEmRMAct 1 "true" 0 "false" ;
VAL_ 3221225472 CTCMERDTC_SysDes 0 "P0-Powertrain Codes SAE Controlled" 1 "P1-Powertrain Codes MFG Controlled" 2 "P2-Powertrain Codes Reserved" 3 "P3-Powertrain Codes Reserved" 4 "C0-Chassis Codes SAE Controlled" 5 "C1-Chassis Codes MFG Controlled" 6 "C2-Chassis Codes Reserved" 7 "C3-Chassis Codes Reserved" 8 "B0-Body Codes SAE Controlled" 9 "B1-Body Codes MFG Controlled" 10 "B2-Body Codes Reserved" 11 "B3-Body Codes Reserved" 12 "U0-Network Codes SAE Controlled" 13 "U1-Network Codes MFG Controlled" 14 "U2- Network Codes Reserved" 15 "U3-Network Codes Reserved" ;
VAL_ 3221225472 RHCS_RdctHtrCCurrV 1 "Invalid" 0 "Valid" ;
VAL_ 3221225472 RHCS_RdctHtrBCurrV 1 "Invalid" 0 "Valid" ;
VAL_ 3221225472 RHCS_RdctHtrACurrV 1 "Invalid" 0 "Valid" ;
VAL_ 3221225472 FuelInjCntrlModInjFltAct 1 "true" 0 "false" ;
VAL_ 3221225472 AFRP_SnsTyp 3 "Gauge Pressure" 2 "Absolute Pressure" 1 "Pressure Relative Manifold Vacuum" 0 "Not Supported" ;
VAL_ 3221225472 FICMDS3_DTCStatus 4 "Diagnostic Failed" 3 "Diagnostic Passed" 2 "No Status to Report" 1 "Critically Disabled" 0 "Not Supported" ;
VAL_ 3221225472 FICMDS2_DTCStatus 4 "Diagnostic Failed" 3 "Diagnostic Passed" 2 "No Status to Report" 1 "Critically Disabled" 0 "Not Supported" ;
VAL_ 3221225472 FICMDS1_DTCStatus 4 "Diagnostic Failed" 3 "Diagnostic Passed" 2 "No Status to Report" 1 "Critically Disabled" 0 "Not Supported" ;
VAL_ 3221225472 BattThrmlCondOffTmeV 1 "Invalid" 0 "Valid" ;
VAL_ 3221225472 BattThrmlCondOffTmeM 1 "Use Data" 0 "Don't Use Data" ;
VAL_ 3221225472 OffBrdChrgOffTmeV 1 "Invalid" 0 "Valid" ;
VAL_ 3221225472 OffBrdChrgOffTmeM 1 "Use Data" 0 "Don't Use Data" ;
VAL_ 3221225472 RdctHtrCStat 0 "Off" 1 "On" ;
VAL_ 3221225472 RdctHtrBStat 0 "Off" 1 "On" ;
VAL_ 3221225472 RdctHtrAStat 0 "Off" 1 "On" ;
VAL_ 3221225472 GPCMDS2_DTCStatus 4 "Diagnostic Failed" 3 "Diagnostic Passed" 2 "No Status to Report" 1 "Critically Disabled" 0 "Not Supported" ;
VAL_ 3221225472 IntAirHtrPwrConsmpV 1 "Invalid" 0 "Valid" ;
VAL_ 3221225472 DslGlwPlgMdOvTmOD 1 "true" 0 "false" ;
VAL_ 3221225472 IQAI_InjIdInd 7 "Injector 8" 6 "Injector 7" 5 "Injector 6" 4 "Injector 5" 3 "Injector 4" 2 "Injector 3" 1 "Injector 2" 0 "Injector 1" ;
VAL_ 3221225472 IQAI_DataStat 1 "IQA Data Byte Stored" 0 "IQA Data Byte Not Stored" ;
VAL_ 3221225472 IntAirHtrTempSensVoltV 1 "Invalid" 0 "Valid" ;
VAL_ 3221225472 IntAirHtrSupVoltV 1 "Invalid" 0 "Valid" ;
VAL_ 3221225472 GPCMDS_DTCStatus 4 "Diagnostic Failed" 3 "Diagnostic Passed" 2 "No Status to Report" 1 "Critically Disabled" 0 "Not Supported" ;
VAL_ 3221225472 EngCoolFanOpEnbl 1 "true" 0 "false" ;
VAL_ 3221225472 DiagFreeRunCntrV 1 "Invalid" 0 "Valid" ;
VAL_ 3221225472 TransDirctnStV 1 "Invalid" 0 "Valid" ;
VAL_ 3221225472 TransDirctnSt 0 "Between Positions" 1 "Park" 2 "Reverse" 3 "Neutral" 4 "Drive" 5 "Unknown" ;
VAL_ 3221225472 AuxClntHtrVlvStat 7 "Unused and Reserved 2" 6 "De-Aeration Routine Active" 5 "Diagnostic Override" 4 "Re-Calibration" 3 "Fault Active" 2 "Engine Link" 1 "Transition" 0 "Engine Bypass" ;
VAL_ 3221225472 ClimCtrlHVDvcShtdwnCmd 1 "true" 0 "false" ;
VAL_ 3221225472 ThrmlRefCompSpdV 1 "Invalid" 0 "Valid" ;
VAL_ 3221225472 PTOTpStpSpdCsStAvl 1 "true" 0 "false" ;
VAL_ 3221225472 PTOTpStSpdCsCrStVal 0 "No Action" 1 "5 rpm" 2 "10 rpm" 3 "25 rpm" 4 "50 rpm" 5 "100 rpm" 6 "250 rpm" 7 "500 rpm" ;
VAL_ 3221225472 PTOStdbySpdCsStAvl 1 "true" 0 "false" ;
